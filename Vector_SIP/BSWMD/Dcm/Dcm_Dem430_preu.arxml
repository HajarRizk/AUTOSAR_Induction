AUTOSAR XML (schema 4-0-3)
# COPYRIGHT
# Copyright (c) 2017 by Vector Informatik GmbH. All rights reserved.
# This software is copyright protected and proprietary to Vector Informatik GmbH.
# Vector Informatik GmbH grants to you only those rights as set out in the license conditions.
package /MICROSAR  # DCM Use Case Preconfiguration for API Version Setting to 4.03.00
  module config Dcm_Pre: definition=Dcm
    DcmConfigSet
      DcmGeneral: DcmDemApiVersion=DCM_DEM_API_4_03_00
