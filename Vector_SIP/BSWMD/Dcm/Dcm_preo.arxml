AUTOSAR XML (schema 4-0-3)
package /MICROSAR
  module config Dcm_Pre: definition=Dcm
  module config Dcm_Rec: definition=Dcm, implementation-config-variant=VARIANT-PRE-COMPILE
