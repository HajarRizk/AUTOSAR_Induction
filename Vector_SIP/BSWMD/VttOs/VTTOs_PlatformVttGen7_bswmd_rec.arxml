AUTOSAR XML (schema 4-2-1)
package /MICROSAR/VTT
  module config VTTOs_Rec: definition=VTTOs
    OsOS: OsStackMonitoring=0, OsStackUsageMeasurement=0
