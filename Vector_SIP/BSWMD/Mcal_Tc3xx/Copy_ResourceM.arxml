AUTOSAR XML (schema 4-2-2)
package /AURIX2G/EcucDefs
  module definition ResourceM [0..*]: variants pre-compile  # Configuration of RM (Resource Manager) module.
    container ResourceMGeneral  # General container to select sub derivate.
      enumeration ResourceMSubDerivative: {TC397x}, origin=INFINEON_AURIX2G, set at pre-compile  # Parameter to configure Sub derivates
    container ResourceMMcalConfig  # General container to select Master Core and allocate resources
      enumeration ResourceMMasterCore: {CORE0, CORE1, CORE2, CORE3, CORE4, CORE5}, origin=INFINEON_AURIX2G, set at pre-compile, default-value=CORE0  # Select Master core.
      container ResourceMMcalCore [1..6]  # General container to allocate Mcal resources to cores
        enumeration ResourceMCoreID: {CORE0, CORE1, CORE2, CORE3, CORE4, CORE5}, origin=INFINEON_AURIX2G, set at pre-compile, default-value=CORE0  # Select Master core.
        container ResourceMAllocation [0..*]  # Container to allocate module resources.
          enumeration ResourceMModuleName: {ADC, PWM, ICU, GPT, DMA, CAN, STM, SPI}, origin=INFINEON_AURIX2G, set at pre-compile, default-value=ADC  # Module name.
          choice reference ResourceMResourceRef: scope=ECU, origin=INFINEON_AURIX2G, set at pre-compile, destination=[GptChannelConfiguration, PwmChannel, IcuChannel, DmaChannelConfig, CanController, AdcHwUnit, McuStmAllocationConf, SpiHwConfigurationQspi]  # This parameter contains reference to resource
