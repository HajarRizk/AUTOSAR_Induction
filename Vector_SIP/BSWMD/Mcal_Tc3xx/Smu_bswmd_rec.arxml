AUTOSAR XML (schema 4-2-2)
package /AURIX2G/EcucDefs
  module config Smu_Rec: definition=Smu
  bsw implementation Smu_Impl: programming-language=C, behavior=SmuBehavior, recommended-configuration=Smu_Rec, vendor-specific-module-def=Smu
