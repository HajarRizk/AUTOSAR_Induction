AUTOSAR XML (schema 4-2-2)
package /AURIX2G/EcucDefs
  module config Fee_Rec: definition=Fee
  bsw implementation Fee_Impl: programming-language=C, behavior=FeeBehavior, recommended-configuration=Fee_Rec, vendor-specific-module-def=Fee
