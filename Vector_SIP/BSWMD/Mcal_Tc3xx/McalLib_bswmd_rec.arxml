AUTOSAR XML (schema 4-2-2)
package /AURIX2G/EcucDefs
  module config McalLib_Rec: definition=McalLib
  bsw implementation McalLib_Impl: programming-language=C, behavior=McalLibBehavior, recommended-configuration=McalLib_Rec, vendor-specific-module-def=McalLib
