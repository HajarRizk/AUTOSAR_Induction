AUTOSAR XML (schema 4-2-2)
package /AURIX2G/EcucDefs
  module config Port_Rec: definition=Port
  bsw implementation Port_Impl: programming-language=C, behavior=PortBehavior, recommended-configuration=Port_Rec, vendor-specific-module-def=Port
