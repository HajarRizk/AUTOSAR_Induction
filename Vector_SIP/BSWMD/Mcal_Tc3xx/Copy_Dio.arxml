AUTOSAR XML (schema 4-2-2)
package /AURIX2G/EcucDefs
  module definition Dio [0..1]: post-build-variant-support=true, refined-module-def=Dio, variants link-time  # Configuration of the Dio (Digital IO) module.
    container DioConfig  # This container contains the configuration parameters and sub containers of the AUTOSAR DIO module.
      container DioPort [1..17]: multiplicity set at pre-compile  # Configuration of individual DIO ports, consisting of channels and possible channel groups.
        integer DioPortId: 0..40, scope=ECU, set at pre-compile, symbolic-name-value=true, default-value=0  # Numeric identifier of the DIO port. Not all MCU ports may be used for DIO, thus there may be "gaps" in the list of all IDs. This value will be
        container DioChannel [0..16]: multiplicity set at pre-compile  # Configuration of an individual DIO channel.
          integer DioChannelId: 0..15, scope=ECU, set at pre-compile, symbolic-name-value=true, default-value=0  # Channel Id of the DIO channel. This value will be assigned to the symbolic names.
        container DioChannelGroup [0..*]: multiplicity set at pre-compile  # Definition and configuration of DIO channel groups. A channel group represents several adjoining DIO channels represented by a logical group.
          string DioChannelGroupIdentification: scope=ECU, set at pre-compile, symbolic-name-value=true, default-value=DioChGrpId_P0_0  # The DIO channel group is identified in DIO API by a pointer to a data structure (of type Dio_ChannelGroupType). That data structure contains the channel group information.
          integer DioPortMask: 0..65535, set at pre-compile, default-value=0  # This shall be the mask which defines the positions of the channel
          integer DioPortOffset: 0..15, set at link, derivation=informal-formula=verbatim=l-5=position of the first bit of dioportmask which is set to '1' counted from lsb, default-value=0  # The position of the Channel Group on the port, counted
    container DioGeneral  # General DIO module configuration parameters.
      boolean DioDevErrorDetect: set at pre-compile, default-value=true  # Switches the Default Error Tracer (Det) detection and notification ON or OFF.
      boolean DioFlipChannelApi: set at pre-compile, default-value=false  # Adds / removes the service Dio_FlipChannel() from the code.
      boolean DioVersionInfoApi: set at pre-compile, default-value=false  # Adds / removes the service Dio_ GetVersionInfo() from the code.
      boolean DioSafetyEnable: origin=INFINEON_AURIX2G, set at pre-compile, default-value=true  # Enable/Disable the Safety check and all associated notifications.
    container CommonPublishedInformation  # Common container, aggregated by all modules. It contains published information about vendor and versions.
      integer ArMajorVersion: 0..255, origin=INFINEON_AURIX2G, set at published-information, default-value=4  # Major version number of AUTOSAR specification on which the appropriate implementation is based on.
      integer ArMinorVersion: 0..255, origin=INFINEON_AURIX2G, set at published-information, default-value=2  # Minor version number of AUTOSAR specification on which the appropriate implementation is based on.
      integer ArPatchVersion: 0..255, origin=INFINEON_AURIX2G, set at published-information, default-value=2  # Patch level version number of AUTOSAR specification on which the appropriate implementation is based on.
      integer SwMajorVersion: 0..255, origin=INFINEON_AURIX2G, set at published-information, default-value=10  # Major version number of the vendor specific implementation of the module. The numbering is vendor specific.
      integer SwMinorVersion: 0..255, origin=INFINEON_AURIX2G, set at published-information, default-value=10  # Minor version number of the vendor specific implementation of the module. The numbering is vendor specific.
      integer SwPatchVersion: 0..255, origin=INFINEON_AURIX2G, set at published-information, default-value=0  # Patch level version number of the vendor specific implementation of the module. The numbering is vendor specific.
      integer ModuleId: 0..65535, origin=INFINEON_AURIX2G, set at published-information, default-value=120  # Module ID of this module from Module List
      integer VendorId: 0..65535, origin=INFINEON_AURIX2G, set at published-information, default-value=17  # Vendor ID of the dedicated implementation of this module according to the AUTOSAR vendor list
      string Release: origin=INFINEON_AURIX2G, set at published-information, default-value=_TRICORE_TC397  # Aurix2G derivative used for the implementation
