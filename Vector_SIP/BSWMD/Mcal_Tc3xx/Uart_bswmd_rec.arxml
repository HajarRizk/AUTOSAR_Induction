AUTOSAR XML (schema 4-2-2)
package /AURIX2G/EcucDefs
  module config Uart_Rec: definition=Uart
  bsw implementation Uart_Impl: programming-language=C, behavior=UartBehavior, recommended-configuration=Uart_Rec, vendor-specific-module-def=Uart
