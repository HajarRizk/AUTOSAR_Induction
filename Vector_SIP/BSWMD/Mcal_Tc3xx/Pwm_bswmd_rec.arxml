AUTOSAR XML (schema 4-2-2)
package /AURIX2G/EcucDefs
  module config Pwm_Rec: definition=Pwm
  bsw implementation Pwm_Impl: programming-language=C, vendor-id=17, behavior=PwmBehavior, recommended-configuration=Pwm_Rec, vendor-api-infix=GtmCcu6, vendor-specific-module-def=Pwm
