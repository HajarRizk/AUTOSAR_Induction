AUTOSAR XML (schema 4-2-2)
package /AURIX2G/EcucDefs
  module definition Pwm [0..*]: post-build-variant-support=true, refined-module-def=Pwm, variants post-build  # Configuration of Pwm (Pulse Width Modulation) module.
    container PwmChannelConfigSet  # This container contains the configuration parameters and sub containers of the AUTOSAR Pwm module.
      container PwmChannel [1..*]: multiplicity set at pre-compile  # Configuration of an individual PWM channel.
        enumeration PwmChannelClass [0..1]: {PWM_FIXED_PERIOD, PWM_FIXED_PERIOD_SHIFTED, PWM_VARIABLE_PERIOD, PWM_FIXED_PERIOD_CENTER_ALIGNED}, multiplicity set at post-build, post-build-variant-multiplicity=true, post-build-variant-value=true, set at post-build, default-value=PWM_FIXED_PERIOD  # Class of PWM Channel. ImplementationType: Pwm_17_GtmCcu6_ChannelClassType.
        integer PwmChannelId: 0..255, set at pre-compile, symbolic-name-value=true, default-value=0  # Channel Id of the PWM channel. This value will be assigned to the symbolic name derived of the PwmChannel container short name.
        enumeration PwmAssignedHwUnit: {GTM, CCU6}, origin=INFINEON_AURIX2G, set at post-build, default-value=GTM  # The HW resource used for PWM Generation.
        integer PwmDutycycleDefault: 0..16777215, post-build-variant-value=true, set at post-build, default-value=0  # Value of duty cycle used for Initialization Depends on PwmDutyShiftInTicks parameter. When the PwmDutyShiftInTicks is OFF, the Dutycyle should be entered as percentage: 0, represents 0% 0x8000 represents 100% When the PwmDutyShiftInTicks is ON, the Dutycyle should be entered as absolute ticks: 0, represents 0% Same value as Period value represents 100%
        enumeration PwmIdleState: {PWM_HIGH, PWM_LOW}, post-build-variant-value=true, set at post-build, default-value=PWM_LOW  # The parameter PWM_IDLE_STATE represents the output state of the PWM after the signal is stopped (e.g. call of Pwm_SetOutputToIdle).
        function name PwmNotification [0..1]: multiplicity set at post-build, post-build-variant-multiplicity=true, post-build-variant-value=true, set at post-build, default-value=NULL_PTR  # Definition of the Callback function.
        integer PwmPeriodDefault: 0..16777215, post-build-variant-value=true, set at post-build, default-value=0  # Default Period of the channel. Input Value in absolute ticks. This parameter does not impact the channels of class PWM_FIXED_PERIOD_SHIFTED and PWM_FIXED_PERIOD_CENTER_ALIGNED.
        enumeration PwmPolarity: {PWM_HIGH, PWM_LOW}, post-build-variant-value=true, set at post-build, default-value=PWM_LOW  # Defines the starting polarity of each PWM channel.
        integer PwmShiftValue: 0..16777215, origin=INFINEON_AURIX2G, post-build-variant-value=true, set at post-build, default-value=0  # Shift Value for PWM_FIXED_PERIOD_SHIFTED Signal. Valid only when PwmChannelClass is PWM_FIXED_PERIOD_SHIFTED. This depends on PwmDutyShiftInTicks parameter. When the PwmDutyShiftInTicks is OFF, the Shift value should be entered as percentage: 0, represents 0% 0x8000 represents 100% When the PwmDutyShiftInTicks is ON, the Shift value should be entered as absolute ticks: 0, represents 0% Same value as Period value represents 100%
        boolean PwmCoherentUpdate [0..1]: multiplicity set at post-build, origin=INFINEON_AURIX2G, post-build-variant-value=true, set at post-build, default-value=false  # Setting this parameter to true determines channel is coherent ot not.
        reference PwmMcuClockReferencePoint: scope=ECU, post-build-variant-value=true, set at post-build, destination=McuClockReferencePoint  # This parameter contains reference to the McuClockReferencePoint
        reference PwmReferenceChannel: origin=INFINEON_AURIX2G, post-build-variant-value=true, set at post-build, destination=PwmChannel  # Reference channel for PWM_FIXED_PERIOD_SHIFTED, and PWM_FIXED_PERIOD_CENTER_ALIGNED. Reference should be a channel of PWM_FIXED_PERIOD Only.
        container GtmTimerOutputModuleConfiguration  # Choose GTM TOM/ATOM channel which will be used by this PWM Channel. Referred timer channel in MCU should have TomChannelUsage/ AtomChannelUsage as USED_BY_PWM_DRIVER
          enumeration GtmTimerClockSelect: {GTM_FIXED_CLOCK_0, GTM_FIXED_CLOCK_1, GTM_FIXED_CLOCK_2, GTM_FIXED_CLOCK_3, GTM_FIXED_CLOCK_4, GTM_CONFIGURABLE_CLOCK_0, GTM_CONFIGURABLE_CLOCK_1, GTM_CONFIGURABLE_CLOCK_2, GTM_CONFIGURABLE_CLOCK_3, GTM_CONFIGURABLE_CLOCK_4, GTM_CONFIGURABLE_CLOCK_5, GTM_CONFIGURABLE_CLOCK_6, GTM_CONFIGURABLE_CLOCK_7}, origin=INFINEON_AURIX2G, post-build-variant-value=true, set at post-build, default-value=GTM_FIXED_CLOCK_0  # This parameter decides the Clock Source for TOM/ATOM timer.
          enumeration GtmTimerPortPinSelect: {NONE, TOUT0_SELC_PORT02_PIN0, TOUT112_SELI_PORT01_PIN4, TOUT17_SELI_PORT00_PIN8, TOUT43_SELI_PORT23_PIN2, TOUT48_SELC_PORT22_PIN1, TOUT53_SELC_PORT21_PIN2, TOUT54_SELI_PORT21_PIN3, TOUT7_SELI_PORT02_PIN7, TOUT85_SELC_PORT14_PIN5, TOUT8_SELC_PORT02_PIN8, TOUT9_SELC_PORT00_PIN0, TOUT10_SELC_PORT00_PIN1, TOUT113_SELI_PORT01_PIN5, TOUT116_SELK_PORT02_PIN9, TOUT11_SELC_PORT00_PIN2, TOUT14_SELI_PORT00_PIN5, TOUT1_SELC_PORT02_PIN1, TOUT31_SELC_PORT33_PIN9, TOUT39_SELJ_PORT32_PIN3, TOUT41_SELI_PORT23_PIN0, TOUT47_SELC_PORT22_PIN0, TOUT4_SELI_PORT02_PIN4, TOUT50_SELK_PORT22_PIN3, TOUT53_SELI_PORT21_PIN2, TOUT54_SELC_PORT21_PIN3, TOUT55_SELI_PORT21_PIN4, TOUT57_SELK_PORT21_PIN6, TOUT61_SELK_PORT20_PIN3, TOUT84_SELC_PORT14_PIN4, TOUT114_SELI_PORT01_PIN6, TOUT117_SELK_PORT02_PIN10, TOUT12_SELC_PORT00_PIN3, TOUT15_SELI_PORT00_PIN6, TOUT23_SELK_PORT33_PIN1, TOUT2_SELC_PORT02_PIN2, TOUT33_SELC_PORT33_PIN11, TOUT40_SELJ_PORT32_PIN4, TOUT41_SELK_PORT23_PIN0, TOUT44_SELI_PORT23_PIN3, TOUT46_SELC_PORT23_PIN5, TOUT55_SELC_PORT21_PIN4, TOUT56_SELI_PORT21_PIN5, TOUT58_SELI_PORT21_PIN7, TOUT5_SELI_PORT02_PIN5, TOUT65_SELK_PORT20_PIN9, TOUT83_SELC_PORT14_PIN3, TOUT115_SELI_PORT01_PIN7, TOUT118_SELK_PORT02_PIN11, TOUT13_SELC_PORT00_PIN4, TOUT16_SELI_PORT00_PIN7, TOUT24_SELK_PORT33_PIN2, TOUT38_SELC_PORT32_PIN2, TOUT3_SELC_PORT02_PIN3, TOUT42_SELK_PORT23_PIN1, TOUT45_SELI_PORT23_PIN4, TOUT49_SELC_PORT22_PIN2, TOUT56_SELC_PORT21_PIN5, TOUT59_SELK_PORT20_PIN0, TOUT60_SELC_PORT20_PIN1, TOUT66_SELK_PORT20_PIN10, TOUT6_SELI_PORT02_PIN6, TOUT82_SELC_PORT14_PIN2, TOUT118_SELI_PORT02_PIN11, TOUT135_SELI_PORT22_PIN9, TOUT13_SELI_PORT00_PIN4, TOUT146_SELI_PORT34_PIN1, TOUT147_SELI_PORT34_PIN2, TOUT14_SELC_PORT00_PIN5, TOUT29_SELK_PORT33_PIN7, TOUT39_SELC_PORT32_PIN3, TOUT3_SELI_PORT02_PIN3, TOUT4_SELC_PORT02_PIN4, TOUT50_SELC_PORT22_PIN3, TOUT57_SELC_PORT21_PIN6, TOUT61_SELC_PORT20_PIN3, TOUT81_SELC_PORT14_PIN1, TOUT0_SELI_PORT02_PIN0, TOUT136_SELI_PORT22_PIN10, TOUT148_SELI_PORT34_PIN3, TOUT15_SELC_PORT00_PIN6, TOUT23_SELC_PORT33_PIN1, TOUT26_SELK_PORT33_PIN4, TOUT40_SELC_PORT32_PIN4, TOUT41_SELC_PORT23_PIN0, TOUT58_SELC_PORT21_PIN7, TOUT5_SELC_PORT02_PIN5, TOUT8_SELI_PORT02_PIN8, TOUT9_SELI_PORT00_PIN0, TOUT106_SELC_PORT10_PIN4, TOUT10_SELI_PORT00_PIN1, TOUT116_SELI_PORT02_PIN9, TOUT11_SELI_PORT00_PIN2, TOUT137_SELI_PORT22_PIN11, TOUT149_SELI_PORT34_PIN4, TOUT16_SELC_PORT00_PIN7, TOUT1_SELI_PORT02_PIN1, TOUT24_SELC_PORT33_PIN2, TOUT27_SELK_PORT33_PIN5, TOUT42_SELC_PORT23_PIN1, TOUT59_SELC_PORT20_PIN0, TOUT6_SELC_PORT02_PIN6, TOUT117_SELI_PORT02_PIN10, TOUT12_SELI_PORT00_PIN3, TOUT150_SELI_PORT34_PIN5, TOUT17_SELC_PORT00_PIN8, TOUT25_SELC_PORT33_PIN3, TOUT28_SELK_PORT33_PIN6, TOUT2_SELI_PORT02_PIN2, TOUT45_SELC_PORT23_PIN4, TOUT64_SELC_PORT20_PIN8, TOUT7_SELC_PORT02_PIN7, TOUT174_SELI_PORT31_PIN0, TOUT190_SELI_PORT30_PIN0, TOUT230_SELI_PORT24_PIN8, TOUT175_SELI_PORT31_PIN1, TOUT191_SELI_PORT30_PIN1, TOUT231_SELI_PORT24_PIN9, TOUT176_SELI_PORT31_PIN2, TOUT192_SELI_PORT30_PIN2, TOUT232_SELI_PORT24_PIN10, TOUT177_SELI_PORT31_PIN3, TOUT193_SELI_PORT30_PIN3, TOUT233_SELI_PORT24_PIN11, TOUT178_SELI_PORT31_PIN4, TOUT194_SELI_PORT30_PIN4, TOUT234_SELI_PORT24_PIN12, TOUT179_SELI_PORT31_PIN5, TOUT195_SELI_PORT30_PIN5, TOUT235_SELI_PORT24_PIN13, TOUT180_SELI_PORT31_PIN6, TOUT196_SELI_PORT30_PIN6, TOUT236_SELI_PORT24_PIN14, TOUT181_SELI_PORT31_PIN7, TOUT197_SELI_PORT30_PIN7, TOUT237_SELI_PORT24_PIN15, TOUT182_SELI_PORT31_PIN8, TOUT198_SELI_PORT30_PIN8, TOUT214_SELI_PORT25_PIN8, TOUT242_SELK_PORT15_PIN10, TOUT265_SELI_PORT10_PIN9, TOUT183_SELI_PORT31_PIN9, TOUT199_SELI_PORT30_PIN9, TOUT215_SELI_PORT25_PIN9, TOUT243_SELK_PORT15_PIN11, TOUT266_SELI_PORT10_PIN10, TOUT184_SELI_PORT31_PIN10, TOUT200_SELI_PORT30_PIN10, TOUT216_SELI_PORT25_PIN10, TOUT244_SELK_PORT15_PIN12, TOUT269_SELI_PORT10_PIN11, TOUT185_SELI_PORT31_PIN11, TOUT201_SELI_PORT30_PIN11, TOUT217_SELI_PORT25_PIN11, TOUT245_SELK_PORT15_PIN13, TOUT268_SELI_PORT10_PIN13, TOUT186_SELI_PORT31_PIN12, TOUT202_SELI_PORT30_PIN12, TOUT218_SELI_PORT25_PIN12, TOUT246_SELK_PORT15_PIN14, TOUT267_SELI_PORT10_PIN14, TOUT187_SELI_PORT31_PIN13, TOUT203_SELI_PORT30_PIN13, TOUT219_SELI_PORT25_PIN13, TOUT247_SELK_PORT15_PIN15, TOUT270_SELI_PORT10_PIN15, TOUT127_SELJ_PORT11_PIN15, TOUT188_SELI_PORT31_PIN14, TOUT204_SELI_PORT30_PIN14, TOUT220_SELI_PORT25_PIN14, TOUT126_SELJ_PORT11_PIN14, TOUT189_SELI_PORT31_PIN15, TOUT205_SELI_PORT30_PIN15, TOUT221_SELI_PORT25_PIN15, TOUT0_SELD_PORT02_PIN0, TOUT109_SELC_PORT10_PIN7, TOUT112_SELJ_PORT01_PIN4, TOUT17_SELJ_PORT00_PIN8, TOUT68_SELC_PORT20_PIN12, TOUT76_SELC_PORT15_PIN5, TOUT77_SELC_PORT15_PIN6, TOUT7_SELJ_PORT02_PIN7, TOUT87_SELC_PORT14_PIN7, TOUT8_SELD_PORT02_PIN8, TOUT9_SELD_PORT00_PIN0, TOUT102_SELI_PORT10_PIN0, TOUT103_SELC_PORT10_PIN1, TOUT10_SELD_PORT00_PIN1, TOUT113_SELJ_PORT01_PIN5, TOUT116_SELL_PORT02_PIN9, TOUT11_SELD_PORT00_PIN2, TOUT14_SELJ_PORT00_PIN5, TOUT1_SELD_PORT02_PIN1, TOUT31_SELD_PORT33_PIN9, TOUT39_SELK_PORT32_PIN3, TOUT4_SELJ_PORT02_PIN4, TOUT61_SELL_PORT20_PIN3, TOUT69_SELC_PORT20_PIN13, TOUT72_SELJ_PORT15_PIN1, TOUT78_SELC_PORT15_PIN7, TOUT79_SELC_PORT15_PIN8, TOUT86_SELC_PORT14_PIN6, TOUT104_SELC_PORT10_PIN2, TOUT107_SELC_PORT10_PIN5, TOUT110_SELI_PORT10_PIN8, TOUT114_SELJ_PORT01_PIN6, TOUT117_SELL_PORT02_PIN10, TOUT12_SELD_PORT00_PIN3, TOUT15_SELJ_PORT00_PIN6, TOUT23_SELL_PORT33_PIN1, TOUT2_SELD_PORT02_PIN2, TOUT33_SELD_PORT33_PIN11, TOUT40_SELK_PORT32_PIN4, TOUT41_SELL_PORT23_PIN0, TOUT5_SELJ_PORT02_PIN5, TOUT70_SELC_PORT20_PIN14, TOUT73_SELJ_PORT15_PIN2, TOUT80_SELC_PORT14_PIN0, TOUT105_SELC_PORT10_PIN3, TOUT106_SELI_PORT10_PIN4, TOUT108_SELC_PORT10_PIN6, TOUT115_SELJ_PORT01_PIN7, TOUT118_SELL_PORT02_PIN11, TOUT13_SELD_PORT00_PIN4, TOUT16_SELJ_PORT00_PIN7, TOUT24_SELL_PORT33_PIN2, TOUT38_SELD_PORT32_PIN2, TOUT3_SELD_PORT02_PIN3, TOUT42_SELL_PORT23_PIN1, TOUT60_SELD_PORT20_PIN1, TOUT6_SELJ_PORT02_PIN6, TOUT71_SELC_PORT15_PIN0, TOUT74_SELJ_PORT15_PIN3, TOUT102_SELC_PORT10_PIN0, TOUT105_SELI_PORT10_PIN3, TOUT108_SELI_PORT10_PIN6, TOUT118_SELJ_PORT02_PIN11, TOUT130_SELI_PORT22_PIN4, TOUT131_SELI_PORT22_PIN5, TOUT13_SELJ_PORT00_PIN4, TOUT146_SELJ_PORT34_PIN1, TOUT147_SELJ_PORT34_PIN2, TOUT14_SELD_PORT00_PIN5, TOUT29_SELL_PORT33_PIN7, TOUT39_SELD_PORT32_PIN3, TOUT3_SELJ_PORT02_PIN3, TOUT4_SELD_PORT02_PIN4, TOUT61_SELD_PORT20_PIN3, TOUT71_SELJ_PORT15_PIN0, TOUT72_SELC_PORT15_PIN1, TOUT75_SELJ_PORT15_PIN4, TOUT0_SELJ_PORT02_PIN0, TOUT109_SELI_PORT10_PIN7, TOUT110_SELC_PORT10_PIN8, TOUT132_SELI_PORT22_PIN6, TOUT148_SELJ_PORT34_PIN3, TOUT15_SELD_PORT00_PIN6, TOUT23_SELD_PORT33_PIN1, TOUT26_SELL_PORT33_PIN4, TOUT40_SELD_PORT32_PIN4, TOUT41_SELD_PORT23_PIN0, TOUT5_SELD_PORT02_PIN5, TOUT65_SELC_PORT20_PIN9, TOUT73_SELC_PORT15_PIN2, TOUT76_SELJ_PORT15_PIN5, TOUT77_SELJ_PORT15_PIN6, TOUT8_SELJ_PORT02_PIN8, TOUT9_SELJ_PORT00_PIN0, TOUT103_SELI_PORT10_PIN1, TOUT106_SELL_PORT10_PIN4, TOUT10_SELJ_PORT00_PIN1, TOUT116_SELJ_PORT02_PIN9, TOUT11_SELJ_PORT00_PIN2, TOUT133_SELI_PORT22_PIN7, TOUT149_SELJ_PORT34_PIN4, TOUT16_SELD_PORT00_PIN7, TOUT1_SELJ_PORT02_PIN1, TOUT24_SELD_PORT33_PIN2, TOUT27_SELL_PORT33_PIN5, TOUT42_SELD_PORT23_PIN1, TOUT66_SELC_PORT20_PIN10, TOUT6_SELD_PORT02_PIN6, TOUT74_SELC_PORT15_PIN3, TOUT78_SELJ_PORT15_PIN7, TOUT104_SELI_PORT10_PIN2, TOUT107_SELI_PORT10_PIN5, TOUT117_SELJ_PORT02_PIN10, TOUT12_SELJ_PORT00_PIN3, TOUT134_SELI_PORT22_PIN8, TOUT150_SELJ_PORT34_PIN5, TOUT17_SELD_PORT00_PIN8, TOUT25_SELD_PORT33_PIN3, TOUT28_SELL_PORT33_PIN6, TOUT2_SELJ_PORT02_PIN2, TOUT45_SELD_PORT23_PIN4, TOUT67_SELC_PORT20_PIN11, TOUT75_SELC_PORT15_PIN4, TOUT79_SELJ_PORT15_PIN8, TOUT7_SELD_PORT02_PIN7, TOUT101_SELJ_PORT11_PIN12, TOUT108_SELK_PORT10_PIN6, TOUT109_SELK_PORT10_PIN7, TOUT12_SELK_PORT00_PIN3, TOUT144_SELI_PORT33_PIN15, TOUT18_SELC_PORT00_PIN9, TOUT25_SELI_PORT33_PIN3, TOUT26_SELC_PORT33_PIN4, TOUT32_SELC_PORT33_PIN10, TOUT37_SELK_PORT32_PIN1, TOUT94_SELC_PORT13_PIN3, TOUT102_SELK_PORT10_PIN0, TOUT105_SELK_PORT10_PIN3, TOUT167_SELK_PORT00_PIN13, TOUT19_SELC_PORT00_PIN10, TOUT22_SELI_PORT33_PIN0, TOUT27_SELC_PORT33_PIN5, TOUT30_SELI_PORT33_PIN8, TOUT34_SELI_PORT33_PIN12, TOUT43_SELC_PORT23_PIN2, TOUT51_SELI_PORT21_PIN0, TOUT90_SELK_PORT14_PIN10, TOUT91_SELI_PORT13_PIN0, TOUT95_SELC_PORT11_PIN2, TOUT98_SELJ_PORT11_PIN9, TOUT9_SELK_PORT00_PIN0, TOUT103_SELK_PORT10_PIN1, TOUT106_SELK_PORT10_PIN4, TOUT10_SELK_PORT00_PIN1, TOUT114_SELK_PORT01_PIN6, TOUT138_SELK_PORT23_PIN6, TOUT166_SELK_PORT00_PIN14, TOUT20_SELC_PORT00_PIN11, TOUT23_SELI_PORT33_PIN1, TOUT28_SELC_PORT33_PIN6, TOUT31_SELJ_PORT33_PIN9, TOUT35_SELI_PORT33_PIN13, TOUT44_SELC_PORT23_PIN3, TOUT52_SELI_PORT21_PIN1, TOUT88_SELC_PORT14_PIN8, TOUT91_SELK_PORT13_PIN0, TOUT92_SELI_PORT13_PIN1, TOUT96_SELC_PORT11_PIN3, TOUT99_SELJ_PORT11_PIN10, TOUT100_SELJ_PORT11_PIN11, TOUT104_SELK_PORT10_PIN2, TOUT107_SELK_PORT10_PIN5, TOUT115_SELK_PORT01_PIN7, TOUT11_SELK_PORT00_PIN2, TOUT139_SELK_PORT23_PIN7, TOUT143_SELI_PORT33_PIN14, TOUT168_SELK_PORT00_PIN15, TOUT21_SELC_PORT00_PIN12, TOUT24_SELI_PORT33_PIN2, TOUT29_SELC_PORT33_PIN7, TOUT33_SELI_PORT33_PIN11, TOUT36_SELI_PORT32_PIN0, TOUT62_SELK_PORT20_PIN6, TOUT89_SELC_PORT14_PIN9, TOUT92_SELK_PORT13_PIN1, TOUT93_SELI_PORT13_PIN2, TOUT97_SELC_PORT11_PIN6, TOUT167_SELI_PORT00_PIN13, TOUT22_SELC_PORT33_PIN0, TOUT29_SELI_PORT33_PIN7, TOUT30_SELC_PORT33_PIN8, TOUT34_SELC_PORT33_PIN12, TOUT51_SELC_PORT21_PIN0, TOUT57_SELI_PORT21_PIN6, TOUT86_SELI_PORT14_PIN6, TOUT90_SELC_PORT14_PIN10, TOUT97_SELJ_PORT11_PIN6, TOUT98_SELC_PORT11_PIN9, TOUT120_SELJ_PORT11_PIN1, TOUT138_SELA_PORT23_PIN6, TOUT166_SELI_PORT00_PIN14, TOUT26_SELI_PORT33_PIN4, TOUT35_SELC_PORT33_PIN13, TOUT52_SELC_PORT21_PIN1, TOUT59_SELI_PORT20_PIN0, TOUT65_SELJ_PORT20_PIN9, TOUT87_SELI_PORT14_PIN7, TOUT91_SELC_PORT13_PIN0, TOUT94_SELJ_PORT13_PIN3, TOUT99_SELC_PORT11_PIN10, TOUT100_SELC_PORT11_PIN11, TOUT139_SELA_PORT23_PIN7, TOUT143_SELK_PORT33_PIN14, TOUT168_SELI_PORT00_PIN15, TOUT27_SELI_PORT33_PIN5, TOUT36_SELC_PORT32_PIN0, TOUT60_SELI_PORT20_PIN1, TOUT62_SELC_PORT20_PIN6, TOUT88_SELI_PORT14_PIN8, TOUT92_SELC_PORT13_PIN1, TOUT95_SELJ_PORT11_PIN2, TOUT101_SELC_PORT11_PIN12, TOUT140_SELA_PORT32_PIN5, TOUT28_SELI_PORT33_PIN6, TOUT37_SELC_PORT32_PIN1, TOUT61_SELI_PORT20_PIN3, TOUT63_SELC_PORT20_PIN7, TOUT89_SELI_PORT14_PIN9, TOUT93_SELC_PORT13_PIN2, TOUT96_SELJ_PORT11_PIN3, TOUT101_SELI_PORT11_PIN12, TOUT144_SELJ_PORT33_PIN15, TOUT17_SELK_PORT00_PIN8, TOUT18_SELD_PORT00_PIN9, TOUT25_SELJ_PORT33_PIN3, TOUT26_SELD_PORT33_PIN4, TOUT32_SELD_PORT33_PIN10, TOUT37_SELL_PORT32_PIN1, TOUT63_SELK_PORT20_PIN7, TOUT65_SELI_PORT20_PIN9, TOUT76_SELI_PORT15_PIN5, TOUT94_SELD_PORT13_PIN3, TOUT111_SELC_PORT01_PIN3, TOUT128_SELK_PORT12_PIN0, TOUT14_SELK_PORT00_PIN5, TOUT167_SELL_PORT00_PIN13, TOUT19_SELD_PORT00_PIN10, TOUT22_SELJ_PORT33_PIN0, TOUT27_SELD_PORT33_PIN5, TOUT30_SELJ_PORT33_PIN8, TOUT34_SELJ_PORT33_PIN12, TOUT43_SELD_PORT23_PIN2, TOUT51_SELK_PORT21_PIN0, TOUT64_SELI_PORT20_PIN8, TOUT79_SELI_PORT15_PIN8, TOUT90_SELL_PORT14_PIN10, TOUT91_SELJ_PORT13_PIN0, TOUT95_SELD_PORT11_PIN2, TOUT98_SELI_PORT11_PIN9, TOUT112_SELA_PORT01_PIN4, TOUT114_SELL_PORT01_PIN6, TOUT15_SELK_PORT00_PIN6, TOUT166_SELL_PORT00_PIN14, TOUT20_SELD_PORT00_PIN11, TOUT23_SELJ_PORT33_PIN1, TOUT28_SELD_PORT33_PIN6, TOUT31_SELK_PORT33_PIN9, TOUT35_SELJ_PORT33_PIN13, TOUT44_SELD_PORT23_PIN3, TOUT52_SELK_PORT21_PIN1, TOUT63_SELI_PORT20_PIN7, TOUT78_SELI_PORT15_PIN7, TOUT88_SELD_PORT14_PIN8, TOUT91_SELL_PORT13_PIN0, TOUT92_SELJ_PORT13_PIN1, TOUT96_SELD_PORT11_PIN3, TOUT99_SELI_PORT11_PIN10, TOUT100_SELI_PORT11_PIN11, TOUT113_SELA_PORT01_PIN5, TOUT115_SELL_PORT01_PIN7, TOUT143_SELJ_PORT33_PIN14, TOUT168_SELL_PORT00_PIN15, TOUT16_SELK_PORT00_PIN7, TOUT21_SELD_PORT00_PIN12, TOUT24_SELJ_PORT33_PIN2, TOUT29_SELD_PORT33_PIN7, TOUT33_SELJ_PORT33_PIN11, TOUT36_SELJ_PORT32_PIN0, TOUT62_SELL_PORT20_PIN6, TOUT77_SELI_PORT15_PIN6, TOUT89_SELD_PORT14_PIN9, TOUT92_SELL_PORT13_PIN1, TOUT93_SELJ_PORT13_PIN2, TOUT97_SELD_PORT11_PIN6, TOUT114_SELA_PORT01_PIN6, TOUT131_SELD_PORT22_PIN5, TOUT135_SELD_PORT22_PIN9, TOUT167_SELJ_PORT00_PIN13, TOUT21_SELI_PORT00_PIN12, TOUT22_SELD_PORT33_PIN0, TOUT29_SELJ_PORT33_PIN7, TOUT30_SELD_PORT33_PIN8, TOUT34_SELD_PORT33_PIN12, TOUT51_SELD_PORT21_PIN0, TOUT57_SELJ_PORT21_PIN6, TOUT86_SELJ_PORT14_PIN6, TOUT90_SELD_PORT14_PIN10, TOUT97_SELI_PORT11_PIN6, TOUT98_SELD_PORT11_PIN9, TOUT115_SELA_PORT01_PIN7, TOUT120_SELK_PORT11_PIN1, TOUT132_SELD_PORT22_PIN6, TOUT136_SELD_PORT22_PIN10, TOUT166_SELJ_PORT00_PIN14, TOUT18_SELI_PORT00_PIN9, TOUT26_SELJ_PORT33_PIN4, TOUT35_SELD_PORT33_PIN13, TOUT52_SELD_PORT21_PIN1, TOUT59_SELJ_PORT20_PIN0, TOUT64_SELJ_PORT20_PIN8, TOUT87_SELJ_PORT14_PIN7, TOUT91_SELD_PORT13_PIN0, TOUT94_SELI_PORT13_PIN3, TOUT99_SELD_PORT11_PIN10, TOUT100_SELD_PORT11_PIN11, TOUT133_SELD_PORT22_PIN7, TOUT137_SELD_PORT22_PIN11, TOUT143_SELL_PORT33_PIN14, TOUT168_SELJ_PORT00_PIN15, TOUT19_SELI_PORT00_PIN10, TOUT27_SELJ_PORT33_PIN5, TOUT36_SELD_PORT32_PIN0, TOUT60_SELJ_PORT20_PIN1, TOUT62_SELD_PORT20_PIN6, TOUT88_SELJ_PORT14_PIN8, TOUT92_SELD_PORT13_PIN1, TOUT95_SELI_PORT11_PIN2, TOUT101_SELD_PORT11_PIN12, TOUT134_SELD_PORT22_PIN8, TOUT20_SELI_PORT00_PIN11, TOUT28_SELJ_PORT33_PIN6, TOUT37_SELD_PORT32_PIN1, TOUT61_SELJ_PORT20_PIN3, TOUT63_SELD_PORT20_PIN7, TOUT89_SELJ_PORT14_PIN9, TOUT93_SELD_PORT13_PIN2, TOUT96_SELI_PORT11_PIN3, TOUT109_SELD_PORT10_PIN7, TOUT39_SELI_PORT32_PIN3, TOUT48_SELD_PORT22_PIN1, TOUT53_SELD_PORT21_PIN2, TOUT68_SELD_PORT20_PIN12, TOUT76_SELD_PORT15_PIN5, TOUT77_SELD_PORT15_PIN6, TOUT85_SELD_PORT14_PIN5, TOUT87_SELK_PORT14_PIN7, TOUT102_SELJ_PORT10_PIN0, TOUT103_SELD_PORT10_PIN1, TOUT41_SELJ_PORT23_PIN0, TOUT44_SELK_PORT23_PIN3, TOUT47_SELD_PORT22_PIN0, TOUT50_SELJ_PORT22_PIN3, TOUT53_SELJ_PORT21_PIN2, TOUT54_SELD_PORT21_PIN3, TOUT57_SELL_PORT21_PIN6, TOUT69_SELD_PORT20_PIN13, TOUT72_SELK_PORT15_PIN1, TOUT78_SELD_PORT15_PIN7, TOUT79_SELD_PORT15_PIN8, TOUT84_SELD_PORT14_PIN4, TOUT85_SELI_PORT14_PIN5, TOUT86_SELK_PORT14_PIN6, TOUT104_SELD_PORT10_PIN2, TOUT107_SELD_PORT10_PIN5, TOUT110_SELJ_PORT10_PIN8, TOUT42_SELJ_PORT23_PIN1, TOUT45_SELK_PORT23_PIN4, TOUT46_SELD_PORT23_PIN5, TOUT52_SELJ_PORT21_PIN1, TOUT55_SELD_PORT21_PIN4, TOUT58_SELJ_PORT21_PIN7, TOUT65_SELL_PORT20_PIN9, TOUT70_SELD_PORT20_PIN14, TOUT73_SELK_PORT15_PIN2, TOUT80_SELD_PORT14_PIN0, TOUT81_SELI_PORT14_PIN1, TOUT83_SELD_PORT14_PIN3, TOUT105_SELD_PORT10_PIN3, TOUT106_SELJ_PORT10_PIN4, TOUT108_SELD_PORT10_PIN6, TOUT43_SELJ_PORT23_PIN2, TOUT46_SELK_PORT23_PIN5, TOUT49_SELD_PORT22_PIN2, TOUT51_SELJ_PORT21_PIN0, TOUT56_SELD_PORT21_PIN5, TOUT59_SELL_PORT20_PIN0, TOUT66_SELL_PORT20_PIN10, TOUT71_SELD_PORT15_PIN0, TOUT74_SELK_PORT15_PIN3, TOUT80_SELI_PORT14_PIN0, TOUT82_SELD_PORT14_PIN2, TOUT102_SELD_PORT10_PIN0, TOUT105_SELJ_PORT10_PIN3, TOUT108_SELJ_PORT10_PIN6, TOUT111_SELI_PORT01_PIN3, TOUT131_SELJ_PORT22_PIN5, TOUT132_SELJ_PORT22_PIN6, TOUT21_SELJ_PORT00_PIN12, TOUT264_SELJ_PORT13_PIN15, TOUT44_SELJ_PORT23_PIN3, TOUT50_SELD_PORT22_PIN3, TOUT56_SELJ_PORT21_PIN5, TOUT57_SELD_PORT21_PIN6, TOUT71_SELK_PORT15_PIN0, TOUT72_SELD_PORT15_PIN1, TOUT75_SELK_PORT15_PIN4, TOUT81_SELD_PORT14_PIN1, TOUT95_SELK_PORT11_PIN2, TOUT109_SELJ_PORT10_PIN7, TOUT110_SELD_PORT10_PIN8, TOUT116_SELA_PORT02_PIN9, TOUT121_SELK_PORT11_PIN4, TOUT128_SELJ_PORT12_PIN0, TOUT130_SELJ_PORT22_PIN4, TOUT133_SELJ_PORT22_PIN7, TOUT18_SELJ_PORT00_PIN9, TOUT45_SELJ_PORT23_PIN4, TOUT56_SELK_PORT21_PIN5, TOUT58_SELD_PORT21_PIN7, TOUT65_SELD_PORT20_PIN9, TOUT73_SELD_PORT15_PIN2, TOUT76_SELK_PORT15_PIN5, TOUT77_SELK_PORT15_PIN6, TOUT103_SELJ_PORT10_PIN1, TOUT106_SELD_PORT10_PIN4, TOUT117_SELA_PORT02_PIN10, TOUT129_SELJ_PORT12_PIN1, TOUT134_SELJ_PORT22_PIN8, TOUT139_SELJ_PORT23_PIN7, TOUT19_SELJ_PORT00_PIN10, TOUT46_SELJ_PORT23_PIN5, TOUT59_SELD_PORT20_PIN0, TOUT66_SELD_PORT20_PIN10, TOUT74_SELD_PORT15_PIN3, TOUT78_SELK_PORT15_PIN7, TOUT97_SELK_PORT11_PIN6, TOUT104_SELJ_PORT10_PIN2, TOUT107_SELJ_PORT10_PIN5, TOUT118_SELA_PORT02_PIN11, TOUT119_SELJ_PORT11_PIN0, TOUT124_SELK_PORT11_PIN8, TOUT135_SELJ_PORT22_PIN9, TOUT138_SELJ_PORT23_PIN6, TOUT20_SELJ_PORT00_PIN11, TOUT40_SELI_PORT32_PIN4, TOUT64_SELD_PORT20_PIN8, TOUT67_SELD_PORT20_PIN11, TOUT75_SELD_PORT15_PIN4, TOUT79_SELK_PORT15_PIN8, TOUT119_SELC_PORT11_PIN0, TOUT126_SELI_PORT11_PIN14, TOUT130_SELK_PORT22_PIN4, TOUT134_SELL_PORT22_PIN8, TOUT146_SELK_PORT34_PIN1, TOUT150_SELL_PORT34_PIN5, TOUT155_SELC_PORT01_PIN0, TOUT161_SELI_PORT01_PIN13, TOUT162_SELI_PORT01_PIN8, TOUT174_SELC_PORT31_PIN0, TOUT181_SELK_PORT31_PIN7, TOUT206_SELC_PORT25_PIN0, TOUT213_SELK_PORT25_PIN7, TOUT249_SELC_PORT13_PIN12, TOUT258_SELI_PORT14_PIN11, TOUT261_SELI_PORT14_PIN12, TOUT264_SELI_PORT13_PIN15, TOUT120_SELC_PORT11_PIN1, TOUT123_SELI_PORT11_PIN7, TOUT128_SELI_PORT12_PIN0, TOUT131_SELK_PORT22_PIN5, TOUT135_SELL_PORT22_PIN9, TOUT140_SELK_PORT32_PIN5, TOUT147_SELK_PORT34_PIN2, TOUT156_SELC_PORT01_PIN2, TOUT158_SELI_PORT01_PIN12, TOUT164_SELI_PORT01_PIN14, TOUT175_SELC_PORT31_PIN1, TOUT178_SELK_PORT31_PIN4, TOUT207_SELC_PORT25_PIN1, TOUT210_SELK_PORT25_PIN4, TOUT242_SELC_PORT15_PIN10, TOUT245_SELI_PORT15_PIN13, TOUT260_SELI_PORT14_PIN13, TOUT265_SELC_PORT10_PIN9, TOUT121_SELC_PORT11_PIN4, TOUT124_SELI_PORT11_PIN8, TOUT132_SELK_PORT22_PIN6, TOUT136_SELL_PORT22_PIN10, TOUT141_SELK_PORT32_PIN6, TOUT148_SELK_PORT34_PIN3, TOUT152_SELI_PORT02_PIN15, TOUT157_SELC_PORT01_PIN15, TOUT159_SELI_PORT01_PIN1, TOUT176_SELC_PORT31_PIN2, TOUT179_SELK_PORT31_PIN5, TOUT208_SELC_PORT25_PIN2, TOUT211_SELK_PORT25_PIN5, TOUT243_SELC_PORT15_PIN11, TOUT246_SELI_PORT15_PIN14, TOUT254_SELI_PORT13_PIN5, TOUT259_SELI_PORT14_PIN14, TOUT266_SELC_PORT10_PIN10, TOUT122_SELC_PORT11_PIN5, TOUT123_SELK_PORT11_PIN7, TOUT125_SELI_PORT11_PIN13, TOUT133_SELK_PORT22_PIN7, TOUT137_SELL_PORT22_PIN11, TOUT142_SELK_PORT32_PIN7, TOUT149_SELK_PORT34_PIN4, TOUT160_SELI_PORT01_PIN9, TOUT163_SELI_PORT01_PIN10, TOUT165_SELC_PORT01_PIN11, TOUT177_SELC_PORT31_PIN3, TOUT180_SELK_PORT31_PIN6, TOUT209_SELC_PORT25_PIN3, TOUT212_SELK_PORT25_PIN6, TOUT212_SELK_PORT26_PIN0, TOUT244_SELC_PORT15_PIN12, TOUT247_SELI_PORT15_PIN15, TOUT255_SELI_PORT13_PIN6, TOUT263_SELI_PORT14_PIN15, TOUT267_SELC_PORT10_PIN14, TOUT122_SELI_PORT11_PIN5, TOUT123_SELC_PORT11_PIN7, TOUT129_SELI_PORT12_PIN1, TOUT134_SELK_PORT22_PIN8, TOUT150_SELK_PORT34_PIN5, TOUT158_SELC_PORT01_PIN12, TOUT163_SELK_PORT01_PIN10, TOUT165_SELI_PORT01_PIN11, TOUT177_SELK_PORT31_PIN3, TOUT178_SELC_PORT31_PIN4, TOUT209_SELK_PORT25_PIN3, TOUT210_SELC_PORT25_PIN4, TOUT245_SELC_PORT15_PIN13, TOUT248_SELI_PORT13_PIN9, TOUT268_SELC_PORT10_PIN13, TOUT119_SELI_PORT11_PIN0, TOUT124_SELC_PORT11_PIN8, TOUT135_SELK_PORT22_PIN9, TOUT140_SELJ_PORT32_PIN5, TOUT155_SELI_PORT01_PIN0, TOUT159_SELC_PORT01_PIN1, TOUT162_SELK_PORT01_PIN8, TOUT174_SELK_PORT31_PIN0, TOUT179_SELC_PORT31_PIN5, TOUT206_SELK_PORT25_PIN0, TOUT211_SELC_PORT25_PIN5, TOUT246_SELC_PORT15_PIN14, TOUT250_SELI_PORT13_PIN11, TOUT269_SELC_PORT10_PIN11, TOUT120_SELI_PORT11_PIN1, TOUT125_SELC_PORT11_PIN13, TOUT136_SELK_PORT22_PIN10, TOUT141_SELJ_PORT32_PIN6, TOUT156_SELI_PORT01_PIN2, TOUT158_SELK_PORT01_PIN12, TOUT160_SELC_PORT01_PIN9, TOUT175_SELK_PORT31_PIN1, TOUT180_SELC_PORT31_PIN6, TOUT207_SELK_PORT25_PIN1, TOUT212_SELC_PORT25_PIN6, TOUT212_SELC_PORT26_PIN0, TOUT247_SELC_PORT15_PIN15, TOUT249_SELI_PORT13_PIN12, TOUT270_SELC_PORT10_PIN15, TOUT96_SELK_PORT11_PIN3, TOUT121_SELI_PORT11_PIN4, TOUT126_SELC_PORT11_PIN14, TOUT137_SELK_PORT22_PIN11, TOUT142_SELJ_PORT32_PIN7, TOUT152_SELK_PORT02_PIN15, TOUT157_SELI_PORT01_PIN15, TOUT161_SELC_PORT01_PIN13, TOUT176_SELK_PORT31_PIN2, TOUT181_SELC_PORT31_PIN7, TOUT208_SELK_PORT25_PIN2, TOUT213_SELC_PORT25_PIN7, TOUT248_SELC_PORT13_PIN9, TOUT127_SELC_PORT11_PIN15, TOUT141_SELC_PORT32_PIN6, TOUT155_SELD_PORT01_PIN0, TOUT161_SELJ_PORT01_PIN13, TOUT162_SELJ_PORT01_PIN8, TOUT182_SELC_PORT31_PIN8, TOUT189_SELJ_PORT31_PIN15, TOUT214_SELC_PORT25_PIN8, TOUT221_SELJ_PORT25_PIN15, TOUT242_SELI_PORT15_PIN10, TOUT250_SELC_PORT13_PIN11, TOUT264_SELK_PORT13_PIN15, TOUT128_SELC_PORT12_PIN0, TOUT142_SELC_PORT32_PIN7, TOUT156_SELD_PORT01_PIN2, TOUT158_SELJ_PORT01_PIN12, TOUT164_SELJ_PORT01_PIN14, TOUT183_SELC_PORT31_PIN9, TOUT186_SELJ_PORT31_PIN12, TOUT215_SELC_PORT25_PIN9, TOUT218_SELJ_PORT25_PIN12, TOUT251_SELC_PORT13_PIN10, TOUT254_SELK_PORT13_PIN5, TOUT258_SELC_PORT14_PIN11, TOUT261_SELK_PORT14_PIN12, TOUT129_SELC_PORT12_PIN1, TOUT143_SELC_PORT33_PIN14, TOUT152_SELJ_PORT02_PIN15, TOUT157_SELD_PORT01_PIN15, TOUT159_SELJ_PORT01_PIN1, TOUT184_SELC_PORT31_PIN10, TOUT187_SELJ_PORT31_PIN13, TOUT216_SELC_PORT25_PIN10, TOUT219_SELJ_PORT25_PIN13, TOUT252_SELC_PORT13_PIN14, TOUT255_SELK_PORT13_PIN6, TOUT259_SELC_PORT14_PIN14, TOUT111_SELJ_PORT01_PIN3, TOUT144_SELC_PORT33_PIN15, TOUT160_SELJ_PORT01_PIN9, TOUT163_SELJ_PORT01_PIN10, TOUT165_SELD_PORT01_PIN11, TOUT185_SELC_PORT31_PIN11, TOUT188_SELJ_PORT31_PIN14, TOUT217_SELC_PORT25_PIN11, TOUT220_SELJ_PORT25_PIN14, TOUT253_SELC_PORT13_PIN4, TOUT256_SELK_PORT13_PIN7, TOUT260_SELC_PORT14_PIN13, TOUT263_SELK_PORT14_PIN15, TOUT140_SELI_PORT32_PIN5, TOUT143_SELD_PORT33_PIN14, TOUT158_SELD_PORT01_PIN12, TOUT163_SELL_PORT01_PIN10, TOUT165_SELJ_PORT01_PIN11, TOUT185_SELJ_PORT31_PIN11, TOUT186_SELC_PORT31_PIN12, TOUT217_SELJ_PORT25_PIN11, TOUT218_SELC_PORT25_PIN12, TOUT253_SELK_PORT13_PIN4, TOUT254_SELC_PORT13_PIN5, TOUT260_SELK_PORT14_PIN13, TOUT261_SELC_PORT14_PIN12, TOUT31_SELI_PORT33_PIN9, TOUT146_SELC_PORT34_PIN1, TOUT155_SELJ_PORT01_PIN0, TOUT159_SELD_PORT01_PIN1, TOUT162_SELL_PORT01_PIN8, TOUT182_SELJ_PORT31_PIN8, TOUT187_SELC_PORT31_PIN13, TOUT214_SELJ_PORT25_PIN8, TOUT219_SELC_PORT25_PIN13, TOUT250_SELJ_PORT13_PIN11, TOUT255_SELC_PORT13_PIN6, TOUT262_SELC_PORT13_PIN13, TOUT147_SELC_PORT34_PIN2, TOUT156_SELJ_PORT01_PIN2, TOUT158_SELL_PORT01_PIN12, TOUT160_SELD_PORT01_PIN9, TOUT183_SELJ_PORT31_PIN9, TOUT188_SELC_PORT31_PIN14, TOUT215_SELJ_PORT25_PIN9, TOUT220_SELC_PORT25_PIN14, TOUT251_SELK_PORT13_PIN10, TOUT256_SELC_PORT13_PIN7, TOUT258_SELK_PORT14_PIN11, TOUT263_SELC_PORT14_PIN15, TOUT148_SELC_PORT34_PIN3, TOUT152_SELL_PORT02_PIN15, TOUT157_SELJ_PORT01_PIN15, TOUT161_SELD_PORT01_PIN13, TOUT184_SELJ_PORT31_PIN10, TOUT189_SELC_PORT31_PIN15, TOUT216_SELJ_PORT25_PIN10, TOUT221_SELC_PORT25_PIN15, TOUT252_SELK_PORT13_PIN14, TOUT259_SELK_PORT14_PIN14, TOUT264_SELC_PORT13_PIN15, TOUT149_SELC_PORT34_PIN4, TOUT162_SELC_PORT01_PIN8, TOUT190_SELC_PORT30_PIN0, TOUT222_SELC_PORT24_PIN0, TOUT249_SELD_PORT13_PIN12, TOUT258_SELJ_PORT14_PIN11, TOUT150_SELC_PORT34_PIN5, TOUT163_SELC_PORT01_PIN10, TOUT191_SELC_PORT30_PIN1, TOUT223_SELC_PORT24_PIN1, TOUT242_SELD_PORT15_PIN10, TOUT245_SELJ_PORT15_PIN13, TOUT265_SELD_PORT10_PIN9, TOUT164_SELC_PORT01_PIN14, TOUT192_SELC_PORT30_PIN2, TOUT224_SELC_PORT24_PIN2, TOUT243_SELD_PORT15_PIN11, TOUT246_SELJ_PORT15_PIN14, TOUT254_SELJ_PORT13_PIN5, TOUT266_SELD_PORT10_PIN10, TOUT166_SELC_PORT00_PIN14, TOUT193_SELC_PORT30_PIN3, TOUT225_SELC_PORT24_PIN3, TOUT244_SELD_PORT15_PIN12, TOUT247_SELJ_PORT15_PIN15, TOUT255_SELJ_PORT13_PIN6, TOUT267_SELD_PORT10_PIN14, TOUT167_SELC_PORT00_PIN13, TOUT194_SELC_PORT30_PIN4, TOUT226_SELC_PORT24_PIN4, TOUT245_SELD_PORT15_PIN13, TOUT248_SELJ_PORT13_PIN9, TOUT268_SELD_PORT10_PIN13, TOUT168_SELC_PORT00_PIN15, TOUT195_SELC_PORT30_PIN5, TOUT227_SELC_PORT24_PIN5, TOUT246_SELD_PORT15_PIN14, TOUT251_SELJ_PORT13_PIN10, TOUT269_SELD_PORT10_PIN11, TOUT151_SELC_PORT02_PIN12, TOUT153_SELC_PORT02_PIN13, TOUT196_SELC_PORT30_PIN6, TOUT228_SELC_PORT24_PIN6, TOUT247_SELD_PORT15_PIN15, TOUT249_SELJ_PORT13_PIN12, TOUT270_SELD_PORT10_PIN15, TOUT152_SELC_PORT02_PIN15, TOUT154_SELC_PORT02_PIN14, TOUT161_SELK_PORT01_PIN13, TOUT197_SELC_PORT30_PIN7, TOUT229_SELC_PORT24_PIN7, TOUT248_SELD_PORT13_PIN9, TOUT261_SELJ_PORT14_PIN12, TOUT162_SELD_PORT01_PIN8, TOUT198_SELC_PORT30_PIN8, TOUT230_SELC_PORT24_PIN8, TOUT242_SELJ_PORT15_PIN10, TOUT250_SELD_PORT13_PIN11, TOUT163_SELD_PORT01_PIN10, TOUT199_SELC_PORT30_PIN9, TOUT231_SELC_PORT24_PIN9, TOUT251_SELD_PORT13_PIN10, TOUT258_SELD_PORT14_PIN11, TOUT164_SELD_PORT01_PIN14, TOUT200_SELC_PORT30_PIN10, TOUT232_SELC_PORT24_PIN10, TOUT252_SELD_PORT13_PIN14, TOUT259_SELD_PORT14_PIN14, TOUT166_SELD_PORT00_PIN14, TOUT201_SELC_PORT30_PIN11, TOUT233_SELC_PORT24_PIN11, TOUT253_SELD_PORT13_PIN4, TOUT260_SELD_PORT14_PIN13, TOUT167_SELD_PORT00_PIN13, TOUT202_SELC_PORT30_PIN12, TOUT234_SELC_PORT24_PIN12, TOUT254_SELD_PORT13_PIN5, TOUT261_SELD_PORT14_PIN12, TOUT168_SELD_PORT00_PIN15, TOUT203_SELC_PORT30_PIN13, TOUT235_SELC_PORT24_PIN13, TOUT243_SELJ_PORT15_PIN11, TOUT255_SELD_PORT13_PIN6, TOUT262_SELD_PORT13_PIN13, TOUT151_SELD_PORT02_PIN12, TOUT153_SELD_PORT02_PIN13, TOUT204_SELC_PORT30_PIN14, TOUT236_SELC_PORT24_PIN14, TOUT256_SELD_PORT13_PIN7, TOUT263_SELD_PORT14_PIN15, TOUT152_SELD_PORT02_PIN15, TOUT154_SELD_PORT02_PIN14, TOUT161_SELL_PORT01_PIN13, TOUT205_SELC_PORT30_PIN15, TOUT237_SELC_PORT24_PIN15, TOUT244_SELJ_PORT15_PIN12, TOUT264_SELD_PORT13_PIN15, TOUT206_SELI_PORT25_PIN0, TOUT222_SELI_PORT24_PIN0, TOUT207_SELI_PORT25_PIN1, TOUT223_SELI_PORT24_PIN1, TOUT208_SELI_PORT25_PIN2, TOUT224_SELI_PORT24_PIN2, TOUT209_SELI_PORT25_PIN3, TOUT225_SELI_PORT24_PIN3, TOUT210_SELI_PORT25_PIN4, TOUT226_SELI_PORT24_PIN4, TOUT211_SELI_PORT25_PIN5, TOUT227_SELI_PORT24_PIN5, TOUT212_SELI_PORT25_PIN6, TOUT212_SELI_PORT26_PIN0, TOUT228_SELI_PORT24_PIN6, TOUT213_SELI_PORT25_PIN7, TOUT229_SELI_PORT24_PIN7, TOUT0_SELE_PORT02_PIN0, TOUT106_SELE_PORT10_PIN4, TOUT109_SELA_PORT10_PIN7, TOUT151_SELG_PORT02_PIN12, TOUT17_SELE_PORT00_PIN8, TOUT18_SELA_PORT00_PIN9, TOUT25_SELE_PORT33_PIN3, TOUT26_SELA_PORT33_PIN4, TOUT32_SELA_PORT33_PIN10, TOUT34_SELE_PORT33_PIN12, TOUT51_SELF_PORT21_PIN0, TOUT53_SELA_PORT21_PIN2, TOUT61_SELF_PORT20_PIN3, TOUT72_SELE_PORT15_PIN1, TOUT76_SELA_PORT15_PIN5, TOUT77_SELA_PORT15_PIN6, TOUT7_SELE_PORT02_PIN7, TOUT85_SELA_PORT14_PIN5, TOUT87_SELA_PORT14_PIN7, TOUT91_SELE_PORT13_PIN0, TOUT9_SELE_PORT00_PIN0, TOUT12_SELA_PORT00_PIN3, TOUT2_SELA_PORT02_PIN2, TOUT41_SELA_PORT23_PIN0, TOUT46_SELA_PORT23_PIN5, TOUT96_SELA_PORT11_PIN3, TOUT13_SELA_PORT00_PIN4, TOUT3_SELA_PORT02_PIN3, TOUT43_SELA_PORT23_PIN2, TOUT49_SELA_PORT22_PIN2, TOUT97_SELA_PORT11_PIN6, TOUT14_SELA_PORT00_PIN5, TOUT44_SELA_PORT23_PIN3, TOUT4_SELA_PORT02_PIN4, TOUT50_SELA_PORT22_PIN3, TOUT98_SELA_PORT11_PIN9, TOUT15_SELA_PORT00_PIN6, TOUT5_SELA_PORT02_PIN5, TOUT99_SELA_PORT11_PIN10, TOUT100_SELA_PORT11_PIN11, TOUT16_SELA_PORT00_PIN7, TOUT6_SELA_PORT02_PIN6, TOUT101_SELA_PORT11_PIN12, TOUT17_SELA_PORT00_PIN8, TOUT42_SELB_PORT23_PIN1, TOUT7_SELA_PORT02_PIN7, TOUT103_SELA_PORT10_PIN1, TOUT107_SELE_PORT10_PIN5, TOUT10_SELE_PORT00_PIN1, TOUT116_SELG_PORT02_PIN9, TOUT14_SELE_PORT00_PIN5, TOUT19_SELA_PORT00_PIN10, TOUT1_SELE_PORT02_PIN1, TOUT22_SELE_PORT33_PIN0, TOUT27_SELA_PORT33_PIN5, TOUT30_SELE_PORT33_PIN8, TOUT31_SELA_PORT33_PIN9, TOUT35_SELE_PORT33_PIN13, TOUT39_SELG_PORT32_PIN3, TOUT4_SELE_PORT02_PIN4, TOUT52_SELF_PORT21_PIN1, TOUT54_SELA_PORT21_PIN3, TOUT57_SELE_PORT21_PIN6, TOUT73_SELE_PORT15_PIN2, TOUT78_SELA_PORT15_PIN7, TOUT86_SELA_PORT14_PIN6, TOUT90_SELE_PORT14_PIN10, TOUT92_SELE_PORT13_PIN1, TOUT104_SELA_PORT10_PIN2, TOUT107_SELA_PORT10_PIN5, TOUT108_SELE_PORT10_PIN6, TOUT117_SELG_PORT02_PIN10, TOUT11_SELE_PORT00_PIN2, TOUT143_SELG_PORT33_PIN14, TOUT15_SELE_PORT00_PIN6, TOUT20_SELA_PORT00_PIN11, TOUT23_SELE_PORT33_PIN1, TOUT28_SELA_PORT33_PIN6, TOUT2_SELE_PORT02_PIN2, TOUT33_SELA_PORT33_PIN11, TOUT40_SELG_PORT32_PIN4, TOUT55_SELA_PORT21_PIN4, TOUT58_SELE_PORT21_PIN7, TOUT5_SELE_PORT02_PIN5, TOUT74_SELE_PORT15_PIN3, TOUT79_SELA_PORT15_PIN8, TOUT88_SELA_PORT14_PIN8, TOUT93_SELE_PORT13_PIN2, TOUT105_SELA_PORT10_PIN3, TOUT108_SELA_PORT10_PIN6, TOUT109_SELE_PORT10_PIN7, TOUT118_SELG_PORT02_PIN11, TOUT12_SELE_PORT00_PIN3, TOUT144_SELG_PORT33_PIN15, TOUT16_SELE_PORT00_PIN7, TOUT21_SELA_PORT00_PIN12, TOUT24_SELE_PORT33_PIN2, TOUT29_SELA_PORT33_PIN7, TOUT38_SELA_PORT32_PIN2, TOUT3_SELE_PORT02_PIN3, TOUT42_SELG_PORT23_PIN1, TOUT56_SELA_PORT21_PIN5, TOUT59_SELE_PORT20_PIN0, TOUT60_SELE_PORT20_PIN1, TOUT6_SELE_PORT02_PIN6, TOUT75_SELE_PORT15_PIN4, TOUT80_SELA_PORT14_PIN0, TOUT89_SELA_PORT14_PIN9, TOUT94_SELE_PORT13_PIN3, TOUT0_SELG_PORT02_PIN0, TOUT102_SELA_PORT10_PIN0, TOUT10_SELG_PORT00_PIN1, TOUT124_SELF_PORT11_PIN8, TOUT143_SELE_PORT33_PIN14, TOUT147_SELE_PORT34_PIN2, TOUT1_SELG_PORT02_PIN1, TOUT22_SELA_PORT33_PIN0, TOUT29_SELE_PORT33_PIN7, TOUT30_SELA_PORT33_PIN8, TOUT36_SELE_PORT32_PIN0, TOUT37_SELE_PORT32_PIN1, TOUT39_SELA_PORT32_PIN3, TOUT53_SELG_PORT21_PIN2, TOUT54_SELG_PORT21_PIN3, TOUT56_SELE_PORT21_PIN5, TOUT57_SELA_PORT21_PIN6, TOUT64_SELF_PORT20_PIN8, TOUT65_SELF_PORT20_PIN9, TOUT72_SELG_PORT15_PIN1, TOUT73_SELG_PORT15_PIN2, TOUT81_SELA_PORT14_PIN1, TOUT89_SELE_PORT14_PIN9, TOUT8_SELG_PORT02_PIN8, TOUT90_SELA_PORT14_PIN10, TOUT94_SELG_PORT13_PIN3, TOUT95_SELF_PORT11_PIN2, TOUT96_SELG_PORT11_PIN3, TOUT9_SELG_PORT00_PIN0, TOUT110_SELA_PORT10_PIN8, TOUT11_SELG_PORT00_PIN2, TOUT121_SELG_PORT11_PIN4, TOUT128_SELG_PORT12_PIN0, TOUT12_SELG_PORT00_PIN3, TOUT144_SELE_PORT33_PIN15, TOUT148_SELE_PORT34_PIN3, TOUT23_SELA_PORT33_PIN1, TOUT26_SELE_PORT33_PIN4, TOUT27_SELG_PORT33_PIN5, TOUT28_SELG_PORT33_PIN6, TOUT2_SELG_PORT02_PIN2, TOUT32_SELE_PORT33_PIN10, TOUT37_SELG_PORT32_PIN1, TOUT3_SELG_PORT02_PIN3, TOUT40_SELA_PORT32_PIN4, TOUT53_SELE_PORT21_PIN2, TOUT55_SELG_PORT21_PIN4, TOUT56_SELG_PORT21_PIN5, TOUT58_SELA_PORT21_PIN7, TOUT66_SELF_PORT20_PIN10, TOUT67_SELF_PORT20_PIN11, TOUT74_SELG_PORT15_PIN3, TOUT76_SELG_PORT15_PIN5, TOUT77_SELF_PORT15_PIN6, TOUT82_SELA_PORT14_PIN2, TOUT87_SELE_PORT14_PIN7, TOUT91_SELA_PORT13_PIN0, TOUT96_SELF_PORT11_PIN3, TOUT97_SELF_PORT11_PIN6, TOUT106_SELA_PORT10_PIN4, TOUT129_SELG_PORT12_PIN1, TOUT13_SELG_PORT00_PIN4, TOUT149_SELE_PORT34_PIN4, TOUT14_SELG_PORT00_PIN5, TOUT24_SELA_PORT33_PIN2, TOUT27_SELE_PORT33_PIN5, TOUT29_SELG_PORT33_PIN7, TOUT30_SELG_PORT33_PIN8, TOUT31_SELE_PORT33_PIN9, TOUT38_SELE_PORT32_PIN2, TOUT40_SELE_PORT32_PIN4, TOUT42_SELA_PORT23_PIN1, TOUT48_SELG_PORT22_PIN1, TOUT49_SELG_PORT22_PIN2, TOUT4_SELG_PORT02_PIN4, TOUT54_SELE_PORT21_PIN3, TOUT59_SELA_PORT20_PIN0, TOUT5_SELG_PORT02_PIN5, TOUT68_SELF_PORT20_PIN12, TOUT69_SELF_PORT20_PIN13, TOUT78_SELF_PORT15_PIN7, TOUT80_SELE_PORT14_PIN0, TOUT82_SELE_PORT14_PIN2, TOUT83_SELA_PORT14_PIN3, TOUT86_SELE_PORT14_PIN6, TOUT91_SELG_PORT13_PIN0, TOUT92_SELA_PORT13_PIN1, TOUT97_SELG_PORT11_PIN6, TOUT98_SELF_PORT11_PIN9, TOUT99_SELF_PORT11_PIN10, TOUT100_SELF_PORT11_PIN11, TOUT101_SELF_PORT11_PIN12, TOUT119_SELG_PORT11_PIN0, TOUT123_SELG_PORT11_PIN7, TOUT130_SELG_PORT22_PIN4, TOUT150_SELE_PORT34_PIN5, TOUT15_SELG_PORT00_PIN6, TOUT16_SELG_PORT00_PIN7, TOUT25_SELA_PORT33_PIN3, TOUT28_SELE_PORT33_PIN6, TOUT31_SELG_PORT33_PIN9, TOUT32_SELG_PORT33_PIN10, TOUT33_SELE_PORT33_PIN11, TOUT39_SELE_PORT32_PIN3, TOUT42_SELE_PORT23_PIN1, TOUT45_SELA_PORT23_PIN4, TOUT50_SELG_PORT22_PIN3, TOUT55_SELE_PORT21_PIN4, TOUT6_SELG_PORT02_PIN6, TOUT70_SELF_PORT20_PIN14, TOUT71_SELG_PORT15_PIN0, TOUT79_SELF_PORT15_PIN8, TOUT7_SELG_PORT02_PIN7, TOUT81_SELE_PORT14_PIN1, TOUT84_SELA_PORT14_PIN4, TOUT88_SELE_PORT14_PIN8, TOUT92_SELG_PORT13_PIN1, TOUT93_SELA_PORT13_PIN2, TOUT0_SELA_PORT02_PIN0, TOUT48_SELA_PORT22_PIN1, TOUT51_SELA_PORT21_PIN0, TOUT8_SELA_PORT02_PIN8, TOUT94_SELA_PORT13_PIN3, TOUT95_SELA_PORT11_PIN2, TOUT9_SELA_PORT00_PIN0, TOUT10_SELA_PORT00_PIN1, TOUT11_SELA_PORT00_PIN2, TOUT1_SELA_PORT02_PIN1, TOUT47_SELA_PORT22_PIN0, TOUT52_SELA_PORT21_PIN1, TOUT0_SELF_PORT02_PIN0, TOUT17_SELF_PORT00_PIN8, TOUT18_SELB_PORT00_PIN9, TOUT25_SELF_PORT33_PIN3, TOUT26_SELB_PORT33_PIN4, TOUT32_SELB_PORT33_PIN10, TOUT34_SELF_PORT33_PIN12, TOUT68_SELA_PORT20_PIN12, TOUT75_SELF_PORT15_PIN4, TOUT76_SELB_PORT15_PIN5, TOUT77_SELB_PORT15_PIN6, TOUT7_SELF_PORT02_PIN7, TOUT85_SELB_PORT14_PIN5, TOUT8_SELB_PORT02_PIN8, TOUT9_SELB_PORT00_PIN0, TOUT143_SELA_PORT33_PIN14, TOUT266_SELA_PORT10_PIN10, TOUT2_SELB_PORT02_PIN2, TOUT62_SELA_PORT20_PIN6, TOUT144_SELA_PORT33_PIN15, TOUT267_SELA_PORT10_PIN14, TOUT3_SELB_PORT02_PIN3, TOUT60_SELA_PORT20_PIN1, TOUT63_SELA_PORT20_PIN7, TOUT268_SELA_PORT10_PIN13, TOUT34_SELA_PORT33_PIN12, TOUT4_SELB_PORT02_PIN4, TOUT61_SELA_PORT20_PIN3, TOUT146_SELA_PORT34_PIN1, TOUT269_SELA_PORT10_PIN11, TOUT35_SELA_PORT33_PIN13, TOUT5_SELB_PORT02_PIN5, TOUT65_SELA_PORT20_PIN9, TOUT147_SELA_PORT34_PIN2, TOUT270_SELA_PORT10_PIN15, TOUT36_SELA_PORT32_PIN0, TOUT66_SELA_PORT20_PIN10, TOUT6_SELB_PORT02_PIN6, TOUT148_SELA_PORT34_PIN3, TOUT150_SELA_PORT34_PIN5, TOUT37_SELA_PORT32_PIN1, TOUT67_SELA_PORT20_PIN11, TOUT7_SELB_PORT02_PIN7, TOUT10_SELB_PORT00_PIN1, TOUT116_SELE_PORT02_PIN9, TOUT11_SELB_PORT00_PIN2, TOUT14_SELF_PORT00_PIN5, TOUT19_SELB_PORT00_PIN10, TOUT1_SELF_PORT02_PIN1, TOUT22_SELF_PORT33_PIN0, TOUT242_SELA_PORT15_PIN10, TOUT245_SELG_PORT15_PIN13, TOUT27_SELB_PORT33_PIN5, TOUT30_SELF_PORT33_PIN8, TOUT31_SELB_PORT33_PIN9, TOUT35_SELF_PORT33_PIN13, TOUT39_SELH_PORT32_PIN3, TOUT4_SELF_PORT02_PIN4, TOUT69_SELA_PORT20_PIN13, TOUT72_SELF_PORT15_PIN1, TOUT78_SELB_PORT15_PIN7, TOUT86_SELB_PORT14_PIN6, TOUT117_SELE_PORT02_PIN10, TOUT12_SELB_PORT00_PIN3, TOUT143_SELH_PORT33_PIN14, TOUT15_SELF_PORT00_PIN6, TOUT20_SELB_PORT00_PIN11, TOUT23_SELF_PORT33_PIN1, TOUT243_SELA_PORT15_PIN11, TOUT246_SELG_PORT15_PIN14, TOUT28_SELB_PORT33_PIN6, TOUT2_SELF_PORT02_PIN2, TOUT33_SELB_PORT33_PIN11, TOUT40_SELH_PORT32_PIN4, TOUT41_SELF_PORT23_PIN0, TOUT5_SELF_PORT02_PIN5, TOUT70_SELA_PORT20_PIN14, TOUT73_SELF_PORT15_PIN2, TOUT79_SELB_PORT15_PIN8, TOUT118_SELE_PORT02_PIN11, TOUT13_SELB_PORT00_PIN4, TOUT144_SELH_PORT33_PIN15, TOUT16_SELF_PORT00_PIN7, TOUT21_SELB_PORT00_PIN12, TOUT244_SELA_PORT15_PIN12, TOUT247_SELG_PORT15_PIN15, TOUT24_SELF_PORT33_PIN2, TOUT29_SELB_PORT33_PIN7, TOUT38_SELB_PORT32_PIN2, TOUT3_SELF_PORT02_PIN3, TOUT43_SELG_PORT23_PIN2, TOUT6_SELF_PORT02_PIN6, TOUT71_SELA_PORT15_PIN0, TOUT74_SELF_PORT15_PIN3, TOUT80_SELB_PORT14_PIN0, TOUT0_SELH_PORT02_PIN0, TOUT10_SELH_PORT00_PIN1, TOUT124_SELH_PORT11_PIN8, TOUT13_SELF_PORT00_PIN4, TOUT143_SELF_PORT33_PIN14, TOUT147_SELF_PORT34_PIN2, TOUT14_SELB_PORT00_PIN5, TOUT1_SELH_PORT02_PIN1, TOUT21_SELF_PORT00_PIN12, TOUT22_SELB_PORT33_PIN0, TOUT244_SELG_PORT15_PIN12, TOUT245_SELA_PORT15_PIN13, TOUT29_SELF_PORT33_PIN7, TOUT30_SELB_PORT33_PIN8, TOUT36_SELF_PORT32_PIN0, TOUT37_SELF_PORT32_PIN1, TOUT39_SELB_PORT32_PIN3, TOUT53_SELH_PORT21_PIN2, TOUT54_SELH_PORT21_PIN3, TOUT64_SELG_PORT20_PIN8, TOUT65_SELG_PORT20_PIN9, TOUT71_SELF_PORT15_PIN0, TOUT72_SELA_PORT15_PIN1, TOUT73_SELH_PORT15_PIN2, TOUT81_SELB_PORT14_PIN1, TOUT8_SELH_PORT02_PIN8, TOUT94_SELH_PORT13_PIN3, TOUT95_SELH_PORT11_PIN2, TOUT9_SELH_PORT00_PIN0, TOUT11_SELH_PORT00_PIN2, TOUT12_SELH_PORT00_PIN3, TOUT144_SELF_PORT33_PIN15, TOUT148_SELF_PORT34_PIN3, TOUT15_SELB_PORT00_PIN6, TOUT18_SELF_PORT00_PIN9, TOUT23_SELB_PORT33_PIN1, TOUT246_SELA_PORT15_PIN14, TOUT26_SELF_PORT33_PIN4, TOUT27_SELH_PORT33_PIN5, TOUT28_SELH_PORT33_PIN6, TOUT2_SELH_PORT02_PIN2, TOUT32_SELF_PORT33_PIN10, TOUT37_SELH_PORT32_PIN1, TOUT3_SELH_PORT02_PIN3, TOUT40_SELB_PORT32_PIN4, TOUT41_SELB_PORT23_PIN0, TOUT55_SELH_PORT21_PIN4, TOUT56_SELH_PORT21_PIN5, TOUT66_SELG_PORT20_PIN10, TOUT67_SELG_PORT20_PIN11, TOUT73_SELA_PORT15_PIN2, TOUT74_SELH_PORT15_PIN3, TOUT76_SELH_PORT15_PIN5, TOUT77_SELG_PORT15_PIN6, TOUT82_SELB_PORT14_PIN2, TOUT96_SELH_PORT11_PIN3, TOUT97_SELH_PORT11_PIN6, TOUT9_SELF_PORT00_PIN0, TOUT10_SELF_PORT00_PIN1, TOUT11_SELF_PORT00_PIN2, TOUT13_SELH_PORT00_PIN4, TOUT149_SELF_PORT34_PIN4, TOUT14_SELH_PORT00_PIN5, TOUT16_SELB_PORT00_PIN7, TOUT19_SELF_PORT00_PIN10, TOUT242_SELG_PORT15_PIN10, TOUT247_SELA_PORT15_PIN15, TOUT24_SELB_PORT33_PIN2, TOUT27_SELF_PORT33_PIN5, TOUT29_SELH_PORT33_PIN7, TOUT30_SELH_PORT33_PIN8, TOUT31_SELF_PORT33_PIN9, TOUT38_SELF_PORT32_PIN2, TOUT40_SELF_PORT32_PIN4, TOUT43_SELB_PORT23_PIN2, TOUT48_SELH_PORT22_PIN1, TOUT49_SELH_PORT22_PIN2, TOUT4_SELH_PORT02_PIN4, TOUT5_SELH_PORT02_PIN5, TOUT68_SELG_PORT20_PIN12, TOUT69_SELG_PORT20_PIN13, TOUT74_SELA_PORT15_PIN3, TOUT78_SELG_PORT15_PIN7, TOUT80_SELF_PORT14_PIN0, TOUT82_SELF_PORT14_PIN2, TOUT83_SELB_PORT14_PIN3, TOUT91_SELH_PORT13_PIN0, TOUT98_SELH_PORT11_PIN9, TOUT99_SELH_PORT11_PIN10, TOUT100_SELH_PORT11_PIN11, TOUT101_SELH_PORT11_PIN12, TOUT12_SELF_PORT00_PIN3, TOUT130_SELH_PORT22_PIN4, TOUT150_SELF_PORT34_PIN5, TOUT15_SELH_PORT00_PIN6, TOUT16_SELH_PORT00_PIN7, TOUT17_SELB_PORT00_PIN8, TOUT20_SELF_PORT00_PIN11, TOUT243_SELG_PORT15_PIN11, TOUT248_SELA_PORT13_PIN9, TOUT25_SELB_PORT33_PIN3, TOUT28_SELF_PORT33_PIN6, TOUT31_SELH_PORT33_PIN9, TOUT32_SELH_PORT33_PIN10, TOUT33_SELF_PORT33_PIN11, TOUT39_SELF_PORT32_PIN3, TOUT42_SELF_PORT23_PIN1, TOUT44_SELB_PORT23_PIN3, TOUT45_SELB_PORT23_PIN4, TOUT50_SELH_PORT22_PIN3, TOUT64_SELA_PORT20_PIN8, TOUT6_SELH_PORT02_PIN6, TOUT70_SELG_PORT20_PIN14, TOUT71_SELH_PORT15_PIN0, TOUT75_SELA_PORT15_PIN4, TOUT79_SELG_PORT15_PIN8, TOUT7_SELH_PORT02_PIN7, TOUT81_SELF_PORT14_PIN1, TOUT84_SELB_PORT14_PIN4, TOUT92_SELH_PORT13_PIN1, TOUT93_SELH_PORT13_PIN2, TOUT0_SELB_PORT02_PIN0, TOUT128_SELA_PORT12_PIN0, TOUT141_SELA_PORT32_PIN6, TOUT249_SELA_PORT13_PIN12, TOUT129_SELA_PORT12_PIN1, TOUT142_SELA_PORT32_PIN7, TOUT1_SELB_PORT02_PIN1, TOUT265_SELA_PORT10_PIN9, TOUT101_SELE_PORT11_PIN12, TOUT119_SELA_PORT11_PIN0, TOUT126_SELG_PORT11_PIN14, TOUT250_SELA_PORT13_PIN11, TOUT264_SELE_PORT13_PIN15, TOUT43_SELE_PORT23_PIN2, TOUT48_SELB_PORT22_PIN1, TOUT51_SELE_PORT21_PIN0, TOUT53_SELB_PORT21_PIN2, TOUT61_SELE_PORT20_PIN3, TOUT65_SELE_PORT20_PIN9, TOUT76_SELE_PORT15_PIN5, TOUT87_SELB_PORT14_PIN7, TOUT91_SELF_PORT13_PIN0, TOUT94_SELB_PORT13_PIN3, TOUT104_SELB_PORT10_PIN2, TOUT107_SELB_PORT10_PIN5, TOUT133_SELA_PORT22_PIN7, TOUT260_SELA_PORT14_PIN13, TOUT62_SELB_PORT20_PIN6, TOUT70_SELB_PORT20_PIN14, TOUT105_SELB_PORT10_PIN3, TOUT108_SELB_PORT10_PIN6, TOUT134_SELA_PORT22_PIN8, TOUT261_SELA_PORT14_PIN12, TOUT63_SELB_PORT20_PIN7, TOUT71_SELB_PORT15_PIN0, TOUT102_SELB_PORT10_PIN0, TOUT135_SELA_PORT22_PIN9, TOUT262_SELA_PORT13_PIN13, TOUT34_SELB_PORT33_PIN12, TOUT72_SELB_PORT15_PIN1, TOUT110_SELB_PORT10_PIN8, TOUT136_SELA_PORT22_PIN10, TOUT263_SELA_PORT14_PIN15, TOUT35_SELB_PORT33_PIN13, TOUT65_SELB_PORT20_PIN9, TOUT73_SELB_PORT15_PIN2, TOUT137_SELA_PORT22_PIN11, TOUT264_SELA_PORT13_PIN15, TOUT36_SELB_PORT32_PIN0, TOUT66_SELB_PORT20_PIN10, TOUT74_SELB_PORT15_PIN3, TOUT149_SELA_PORT34_PIN4, TOUT37_SELB_PORT32_PIN1, TOUT67_SELB_PORT20_PIN11, TOUT75_SELB_PORT15_PIN4, TOUT120_SELA_PORT11_PIN1, TOUT123_SELE_PORT11_PIN7, TOUT124_SELG_PORT11_PIN8, TOUT127_SELE_PORT11_PIN15, TOUT251_SELA_PORT13_PIN10, TOUT254_SELE_PORT13_PIN5, TOUT44_SELE_PORT23_PIN3, TOUT47_SELB_PORT22_PIN0, TOUT50_SELF_PORT22_PIN3, TOUT52_SELE_PORT21_PIN1, TOUT54_SELB_PORT21_PIN3, TOUT57_SELF_PORT21_PIN6, TOUT61_SELG_PORT20_PIN3, TOUT64_SELE_PORT20_PIN8, TOUT79_SELE_PORT15_PIN8, TOUT90_SELF_PORT14_PIN10, TOUT92_SELF_PORT13_PIN1, TOUT95_SELB_PORT11_PIN2, TOUT98_SELE_PORT11_PIN9, TOUT121_SELA_PORT11_PIN4, TOUT124_SELE_PORT11_PIN8, TOUT125_SELE_PORT11_PIN13, TOUT252_SELA_PORT13_PIN14, TOUT255_SELE_PORT13_PIN6, TOUT46_SELB_PORT23_PIN5, TOUT50_SELE_PORT22_PIN3, TOUT55_SELB_PORT21_PIN4, TOUT58_SELF_PORT21_PIN7, TOUT63_SELE_PORT20_PIN7, TOUT78_SELE_PORT15_PIN7, TOUT88_SELB_PORT14_PIN8, TOUT93_SELF_PORT13_PIN2, TOUT96_SELB_PORT11_PIN3, TOUT99_SELE_PORT11_PIN10, TOUT100_SELE_PORT11_PIN11, TOUT106_SELG_PORT10_PIN4, TOUT122_SELA_PORT11_PIN5, TOUT126_SELE_PORT11_PIN14, TOUT253_SELA_PORT13_PIN4, TOUT256_SELE_PORT13_PIN7, TOUT45_SELE_PORT23_PIN4, TOUT49_SELB_PORT22_PIN2, TOUT56_SELB_PORT21_PIN5, TOUT59_SELF_PORT20_PIN0, TOUT60_SELB_PORT20_PIN1, TOUT62_SELE_PORT20_PIN6, TOUT77_SELE_PORT15_PIN6, TOUT89_SELB_PORT14_PIN9, TOUT97_SELB_PORT11_PIN6, TOUT102_SELF_PORT10_PIN0, TOUT106_SELF_PORT10_PIN4, TOUT120_SELF_PORT11_PIN1, TOUT122_SELE_PORT11_PIN5, TOUT123_SELA_PORT11_PIN7, TOUT126_SELF_PORT11_PIN14, TOUT253_SELE_PORT13_PIN4, TOUT254_SELA_PORT13_PIN5, TOUT50_SELB_PORT22_PIN3, TOUT56_SELF_PORT21_PIN5, TOUT57_SELB_PORT21_PIN6, TOUT60_SELF_PORT20_PIN1, TOUT61_SELB_PORT20_PIN3, TOUT89_SELF_PORT14_PIN9, TOUT90_SELB_PORT14_PIN10, TOUT97_SELE_PORT11_PIN6, TOUT98_SELB_PORT11_PIN9, TOUT103_SELF_PORT10_PIN1, TOUT107_SELF_PORT10_PIN5, TOUT119_SELE_PORT11_PIN0, TOUT124_SELA_PORT11_PIN8, TOUT132_SELE_PORT22_PIN6, TOUT136_SELE_PORT22_PIN10, TOUT250_SELE_PORT13_PIN11, TOUT255_SELA_PORT13_PIN6, TOUT53_SELF_PORT21_PIN2, TOUT58_SELB_PORT21_PIN7, TOUT87_SELF_PORT14_PIN7, TOUT91_SELB_PORT13_PIN0, TOUT94_SELF_PORT13_PIN3, TOUT99_SELB_PORT11_PIN10, TOUT100_SELB_PORT11_PIN11, TOUT104_SELF_PORT10_PIN2, TOUT106_SELB_PORT10_PIN4, TOUT108_SELF_PORT10_PIN6, TOUT120_SELE_PORT11_PIN1, TOUT122_SELG_PORT11_PIN5, TOUT125_SELA_PORT11_PIN13, TOUT131_SELE_PORT22_PIN5, TOUT135_SELE_PORT22_PIN9, TOUT251_SELE_PORT13_PIN10, TOUT256_SELA_PORT13_PIN7, TOUT54_SELF_PORT21_PIN3, TOUT59_SELB_PORT20_PIN0, TOUT86_SELF_PORT14_PIN6, TOUT92_SELB_PORT13_PIN1, TOUT95_SELE_PORT11_PIN2, TOUT101_SELB_PORT11_PIN12, TOUT105_SELF_PORT10_PIN3, TOUT109_SELF_PORT10_PIN7, TOUT121_SELE_PORT11_PIN4, TOUT126_SELA_PORT11_PIN14, TOUT130_SELA_PORT22_PIN4, TOUT134_SELE_PORT22_PIN8, TOUT252_SELE_PORT13_PIN14, TOUT55_SELF_PORT21_PIN4, TOUT64_SELB_PORT20_PIN8, TOUT88_SELF_PORT14_PIN8, TOUT93_SELB_PORT13_PIN2, TOUT96_SELE_PORT11_PIN3, TOUT98_SELG_PORT11_PIN9, TOUT109_SELB_PORT10_PIN7, TOUT127_SELA_PORT11_PIN15, TOUT131_SELA_PORT22_PIN5, TOUT258_SELA_PORT14_PIN11, TOUT51_SELB_PORT21_PIN0, TOUT68_SELB_PORT20_PIN12, TOUT103_SELB_PORT10_PIN1, TOUT132_SELA_PORT22_PIN6, TOUT259_SELA_PORT14_PIN14, TOUT52_SELB_PORT21_PIN1, TOUT69_SELB_PORT20_PIN13, TOUT110_SELE_PORT10_PIN8, TOUT115_SELF_PORT01_PIN7, TOUT130_SELF_PORT22_PIN4, TOUT134_SELG_PORT22_PIN8, TOUT155_SELA_PORT01_PIN0, TOUT161_SELE_PORT01_PIN13, TOUT162_SELE_PORT01_PIN8, TOUT174_SELA_PORT31_PIN0, TOUT181_SELE_PORT31_PIN7, TOUT206_SELA_PORT25_PIN0, TOUT213_SELE_PORT25_PIN7, TOUT8_SELF_PORT02_PIN8, TOUT164_SELA_PORT01_PIN14, TOUT184_SELA_PORT31_PIN10, TOUT188_SELE_PORT31_PIN14, TOUT216_SELA_PORT25_PIN10, TOUT220_SELE_PORT25_PIN14, TOUT266_SELB_PORT10_PIN10, TOUT166_SELA_PORT00_PIN14, TOUT185_SELA_PORT31_PIN11, TOUT189_SELE_PORT31_PIN15, TOUT217_SELA_PORT25_PIN11, TOUT221_SELE_PORT25_PIN15, TOUT267_SELB_PORT10_PIN14, TOUT167_SELA_PORT00_PIN13, TOUT186_SELA_PORT31_PIN12, TOUT218_SELA_PORT25_PIN12, TOUT268_SELB_PORT10_PIN13, TOUT138_SELB_PORT23_PIN6, TOUT168_SELA_PORT00_PIN15, TOUT187_SELA_PORT31_PIN13, TOUT219_SELA_PORT25_PIN13, TOUT269_SELB_PORT10_PIN11, TOUT139_SELB_PORT23_PIN7, TOUT151_SELA_PORT02_PIN12, TOUT153_SELA_PORT02_PIN13, TOUT188_SELA_PORT31_PIN14, TOUT220_SELA_PORT25_PIN14, TOUT270_SELB_PORT10_PIN15, TOUT140_SELB_PORT32_PIN5, TOUT152_SELA_PORT02_PIN15, TOUT154_SELA_PORT02_PIN14, TOUT189_SELA_PORT31_PIN15, TOUT221_SELA_PORT25_PIN15, TOUT111_SELA_PORT01_PIN3, TOUT116_SELF_PORT02_PIN9, TOUT131_SELF_PORT22_PIN5, TOUT135_SELG_PORT22_PIN9, TOUT158_SELE_PORT01_PIN12, TOUT163_SELE_PORT01_PIN10, TOUT175_SELA_PORT31_PIN1, TOUT178_SELE_PORT31_PIN4, TOUT207_SELA_PORT25_PIN1, TOUT210_SELE_PORT25_PIN4, TOUT242_SELB_PORT15_PIN10, TOUT245_SELF_PORT15_PIN13, TOUT265_SELE_PORT10_PIN9, TOUT268_SELE_PORT10_PIN13, TOUT112_SELB_PORT01_PIN4, TOUT117_SELF_PORT02_PIN10, TOUT132_SELF_PORT22_PIN6, TOUT136_SELG_PORT22_PIN10, TOUT157_SELA_PORT01_PIN15, TOUT159_SELE_PORT01_PIN1, TOUT164_SELE_PORT01_PIN14, TOUT176_SELA_PORT31_PIN2, TOUT179_SELE_PORT31_PIN5, TOUT208_SELA_PORT25_PIN2, TOUT211_SELE_PORT25_PIN5, TOUT243_SELB_PORT15_PIN11, TOUT246_SELF_PORT15_PIN14, TOUT266_SELE_PORT10_PIN10, TOUT267_SELE_PORT10_PIN14, TOUT113_SELB_PORT01_PIN5, TOUT118_SELF_PORT02_PIN11, TOUT133_SELF_PORT22_PIN7, TOUT137_SELG_PORT22_PIN11, TOUT165_SELA_PORT01_PIN11, TOUT177_SELA_PORT31_PIN3, TOUT180_SELE_PORT31_PIN6, TOUT209_SELA_PORT25_PIN3, TOUT212_SELE_PORT25_PIN6, TOUT212_SELE_PORT26_PIN0, TOUT244_SELB_PORT15_PIN12, TOUT247_SELF_PORT15_PIN15, TOUT269_SELE_PORT10_PIN11, TOUT270_SELE_PORT10_PIN15, TOUT110_SELF_PORT10_PIN8, TOUT111_SELF_PORT01_PIN3, TOUT114_SELB_PORT01_PIN6, TOUT134_SELF_PORT22_PIN8, TOUT151_SELF_PORT02_PIN12, TOUT158_SELA_PORT01_PIN12, TOUT165_SELE_PORT01_PIN11, TOUT177_SELE_PORT31_PIN3, TOUT178_SELA_PORT31_PIN4, TOUT209_SELE_PORT25_PIN3, TOUT210_SELA_PORT25_PIN4, TOUT244_SELF_PORT15_PIN12, TOUT245_SELB_PORT15_PIN13, TOUT115_SELB_PORT01_PIN7, TOUT135_SELF_PORT22_PIN9, TOUT153_SELF_PORT02_PIN13, TOUT155_SELE_PORT01_PIN0, TOUT159_SELA_PORT01_PIN1, TOUT166_SELF_PORT00_PIN14, TOUT174_SELE_PORT31_PIN0, TOUT179_SELA_PORT31_PIN5, TOUT206_SELE_PORT25_PIN0, TOUT211_SELA_PORT25_PIN5, TOUT246_SELB_PORT15_PIN14, TOUT265_SELF_PORT10_PIN9, TOUT268_SELF_PORT10_PIN13, TOUT136_SELF_PORT22_PIN10, TOUT154_SELF_PORT02_PIN14, TOUT156_SELE_PORT01_PIN2, TOUT160_SELA_PORT01_PIN9, TOUT175_SELE_PORT31_PIN1, TOUT180_SELA_PORT31_PIN6, TOUT207_SELE_PORT25_PIN1, TOUT212_SELA_PORT25_PIN6, TOUT212_SELA_PORT26_PIN0, TOUT242_SELF_PORT15_PIN10, TOUT247_SELB_PORT15_PIN15, TOUT266_SELF_PORT10_PIN10, TOUT267_SELF_PORT10_PIN14, TOUT137_SELF_PORT22_PIN11, TOUT152_SELF_PORT02_PIN15, TOUT157_SELE_PORT01_PIN15, TOUT161_SELA_PORT01_PIN13, TOUT176_SELE_PORT31_PIN2, TOUT181_SELA_PORT31_PIN7, TOUT208_SELE_PORT25_PIN2, TOUT213_SELA_PORT25_PIN7, TOUT243_SELF_PORT15_PIN11, TOUT248_SELB_PORT13_PIN9, TOUT269_SELF_PORT10_PIN11, TOUT270_SELF_PORT10_PIN15, TOUT182_SELA_PORT31_PIN8, TOUT186_SELE_PORT31_PIN12, TOUT214_SELA_PORT25_PIN8, TOUT218_SELE_PORT25_PIN12, TOUT249_SELB_PORT13_PIN12, TOUT183_SELA_PORT31_PIN9, TOUT187_SELE_PORT31_PIN13, TOUT215_SELA_PORT25_PIN9, TOUT219_SELE_PORT25_PIN13, TOUT265_SELB_PORT10_PIN9, TOUT155_SELB_PORT01_PIN0, TOUT161_SELF_PORT01_PIN13, TOUT162_SELF_PORT01_PIN8, TOUT167_SELE_PORT00_PIN13, TOUT190_SELA_PORT30_PIN0, TOUT197_SELE_PORT30_PIN7, TOUT222_SELA_PORT24_PIN0, TOUT229_SELE_PORT24_PIN7, TOUT250_SELB_PORT13_PIN11, TOUT264_SELF_PORT13_PIN15, TOUT164_SELB_PORT01_PIN14, TOUT200_SELA_PORT30_PIN10, TOUT204_SELE_PORT30_PIN14, TOUT232_SELA_PORT24_PIN10, TOUT260_SELB_PORT14_PIN13, TOUT166_SELB_PORT00_PIN14, TOUT201_SELA_PORT30_PIN11, TOUT205_SELE_PORT30_PIN15, TOUT233_SELA_PORT24_PIN11, TOUT261_SELB_PORT14_PIN12, TOUT167_SELB_PORT00_PIN13, TOUT202_SELA_PORT30_PIN12, TOUT230_SELE_PORT24_PIN8, TOUT234_SELA_PORT24_PIN12, TOUT262_SELB_PORT13_PIN13, TOUT168_SELB_PORT00_PIN15, TOUT203_SELA_PORT30_PIN13, TOUT231_SELE_PORT24_PIN9, TOUT235_SELA_PORT24_PIN13, TOUT263_SELB_PORT14_PIN15, TOUT151_SELB_PORT02_PIN12, TOUT153_SELB_PORT02_PIN13, TOUT204_SELA_PORT30_PIN14, TOUT232_SELE_PORT24_PIN10, TOUT236_SELA_PORT24_PIN14, TOUT264_SELB_PORT13_PIN15, TOUT152_SELB_PORT02_PIN15, TOUT154_SELB_PORT02_PIN14, TOUT205_SELA_PORT30_PIN15, TOUT233_SELE_PORT24_PIN11, TOUT237_SELA_PORT24_PIN15, TOUT156_SELB_PORT01_PIN2, TOUT158_SELF_PORT01_PIN12, TOUT163_SELF_PORT01_PIN10, TOUT166_SELE_PORT00_PIN14, TOUT191_SELA_PORT30_PIN1, TOUT194_SELE_PORT30_PIN4, TOUT223_SELA_PORT24_PIN1, TOUT226_SELE_PORT24_PIN4, TOUT251_SELB_PORT13_PIN10, TOUT254_SELF_PORT13_PIN5, TOUT157_SELB_PORT01_PIN15, TOUT159_SELF_PORT01_PIN1, TOUT164_SELF_PORT01_PIN14, TOUT192_SELA_PORT30_PIN2, TOUT195_SELE_PORT30_PIN5, TOUT224_SELA_PORT24_PIN2, TOUT227_SELE_PORT24_PIN5, TOUT252_SELB_PORT13_PIN14, TOUT255_SELF_PORT13_PIN6, TOUT160_SELF_PORT01_PIN9, TOUT165_SELB_PORT01_PIN11, TOUT193_SELA_PORT30_PIN3, TOUT196_SELE_PORT30_PIN6, TOUT225_SELA_PORT24_PIN3, TOUT228_SELE_PORT24_PIN6, TOUT253_SELB_PORT13_PIN4, TOUT256_SELF_PORT13_PIN7, TOUT111_SELE_PORT01_PIN3, TOUT112_SELE_PORT01_PIN4, TOUT151_SELE_PORT02_PIN12, TOUT158_SELB_PORT01_PIN12, TOUT165_SELF_PORT01_PIN11, TOUT193_SELE_PORT30_PIN3, TOUT194_SELA_PORT30_PIN4, TOUT225_SELE_PORT24_PIN3, TOUT226_SELA_PORT24_PIN4, TOUT253_SELF_PORT13_PIN4, TOUT254_SELB_PORT13_PIN5, TOUT8_SELE_PORT02_PIN8, TOUT113_SELE_PORT01_PIN5, TOUT116_SELB_PORT02_PIN9, TOUT153_SELE_PORT02_PIN13, TOUT155_SELF_PORT01_PIN0, TOUT159_SELB_PORT01_PIN1, TOUT190_SELE_PORT30_PIN0, TOUT195_SELA_PORT30_PIN5, TOUT222_SELE_PORT24_PIN0, TOUT227_SELA_PORT24_PIN5, TOUT250_SELF_PORT13_PIN11, TOUT255_SELB_PORT13_PIN6, TOUT114_SELE_PORT01_PIN6, TOUT117_SELB_PORT02_PIN10, TOUT154_SELE_PORT02_PIN14, TOUT156_SELF_PORT01_PIN2, TOUT160_SELB_PORT01_PIN9, TOUT191_SELE_PORT30_PIN1, TOUT196_SELA_PORT30_PIN6, TOUT223_SELE_PORT24_PIN1, TOUT228_SELA_PORT24_PIN6, TOUT251_SELF_PORT13_PIN10, TOUT256_SELB_PORT13_PIN7, TOUT115_SELE_PORT01_PIN7, TOUT118_SELB_PORT02_PIN11, TOUT152_SELE_PORT02_PIN15, TOUT157_SELF_PORT01_PIN15, TOUT161_SELB_PORT01_PIN13, TOUT192_SELE_PORT30_PIN2, TOUT197_SELA_PORT30_PIN7, TOUT224_SELE_PORT24_PIN2, TOUT229_SELA_PORT24_PIN7, TOUT252_SELF_PORT13_PIN14, TOUT162_SELB_PORT01_PIN8, TOUT198_SELA_PORT30_PIN8, TOUT202_SELE_PORT30_PIN12, TOUT230_SELA_PORT24_PIN8, TOUT258_SELB_PORT14_PIN11, TOUT163_SELB_PORT01_PIN10, TOUT199_SELA_PORT30_PIN9, TOUT203_SELE_PORT30_PIN13, TOUT231_SELA_PORT24_PIN9, TOUT259_SELB_PORT14_PIN14, TOUT140_SELE_PORT32_PIN5, TOUT174_SELB_PORT31_PIN0, TOUT190_SELB_PORT30_PIN0, TOUT206_SELB_PORT25_PIN0, TOUT222_SELB_PORT24_PIN0, TOUT242_SELE_PORT15_PIN10, TOUT184_SELB_PORT31_PIN10, TOUT188_SELF_PORT31_PIN14, TOUT200_SELB_PORT30_PIN10, TOUT204_SELF_PORT30_PIN14, TOUT216_SELB_PORT25_PIN10, TOUT220_SELF_PORT25_PIN14, TOUT232_SELB_PORT24_PIN10, TOUT185_SELB_PORT31_PIN11, TOUT189_SELF_PORT31_PIN15, TOUT201_SELB_PORT30_PIN11, TOUT205_SELF_PORT30_PIN15, TOUT217_SELB_PORT25_PIN11, TOUT221_SELF_PORT25_PIN15, TOUT233_SELB_PORT24_PIN11, TOUT186_SELB_PORT31_PIN12, TOUT202_SELB_PORT30_PIN12, TOUT218_SELB_PORT25_PIN12, TOUT230_SELF_PORT24_PIN8, TOUT234_SELB_PORT24_PIN12, TOUT187_SELB_PORT31_PIN13, TOUT203_SELB_PORT30_PIN13, TOUT219_SELB_PORT25_PIN13, TOUT231_SELF_PORT24_PIN9, TOUT235_SELB_PORT24_PIN13, TOUT188_SELB_PORT31_PIN14, TOUT204_SELB_PORT30_PIN14, TOUT220_SELB_PORT25_PIN14, TOUT232_SELF_PORT24_PIN10, TOUT236_SELB_PORT24_PIN14, TOUT189_SELB_PORT31_PIN15, TOUT205_SELB_PORT30_PIN15, TOUT221_SELB_PORT25_PIN15, TOUT233_SELF_PORT24_PIN11, TOUT237_SELB_PORT24_PIN15, TOUT141_SELE_PORT32_PIN6, TOUT175_SELB_PORT31_PIN1, TOUT191_SELB_PORT30_PIN1, TOUT207_SELB_PORT25_PIN1, TOUT223_SELB_PORT24_PIN1, TOUT243_SELE_PORT15_PIN11, TOUT142_SELE_PORT32_PIN7, TOUT176_SELB_PORT31_PIN2, TOUT192_SELB_PORT30_PIN2, TOUT208_SELB_PORT25_PIN2, TOUT224_SELB_PORT24_PIN2, TOUT244_SELE_PORT15_PIN12, TOUT138_SELE_PORT23_PIN6, TOUT177_SELB_PORT31_PIN3, TOUT193_SELB_PORT30_PIN3, TOUT209_SELB_PORT25_PIN3, TOUT212_SELJ_PORT25_PIN6, TOUT212_SELJ_PORT26_PIN0, TOUT225_SELB_PORT24_PIN3, TOUT258_SELE_PORT14_PIN11, TOUT139_SELE_PORT23_PIN7, TOUT178_SELB_PORT31_PIN4, TOUT194_SELB_PORT30_PIN4, TOUT210_SELB_PORT25_PIN4, TOUT226_SELB_PORT24_PIN4, TOUT261_SELE_PORT14_PIN12, TOUT179_SELB_PORT31_PIN5, TOUT195_SELB_PORT30_PIN5, TOUT211_SELB_PORT25_PIN5, TOUT227_SELB_PORT24_PIN5, TOUT260_SELE_PORT14_PIN13, TOUT180_SELB_PORT31_PIN6, TOUT196_SELB_PORT30_PIN6, TOUT212_SELB_PORT25_PIN6, TOUT212_SELB_PORT26_PIN0, TOUT228_SELB_PORT24_PIN6, TOUT259_SELE_PORT14_PIN14, TOUT181_SELB_PORT31_PIN7, TOUT197_SELB_PORT30_PIN7, TOUT213_SELB_PORT25_PIN7, TOUT229_SELB_PORT24_PIN7, TOUT263_SELE_PORT14_PIN15, TOUT182_SELB_PORT31_PIN8, TOUT186_SELF_PORT31_PIN12, TOUT198_SELB_PORT30_PIN8, TOUT202_SELF_PORT30_PIN12, TOUT214_SELB_PORT25_PIN8, TOUT218_SELF_PORT25_PIN12, TOUT230_SELB_PORT24_PIN8, TOUT183_SELB_PORT31_PIN9, TOUT187_SELF_PORT31_PIN13, TOUT199_SELB_PORT30_PIN9, TOUT203_SELF_PORT30_PIN13, TOUT215_SELB_PORT25_PIN9, TOUT219_SELF_PORT25_PIN13, TOUT231_SELB_PORT24_PIN9, TOUT137_SELE_PORT22_PIN11, TOUT133_SELE_PORT22_PIN7, TOUT122_SELF_PORT11_PIN5, TOUT46_SELE_PORT23_PIN5, TOUT95_SELG_PORT11_PIN2, TOUT120_SELG_PORT11_PIN1, TOUT84_SELF_PORT14_PIN4, TOUT72_SELH_PORT15_PIN1, TOUT93_SELG_PORT13_PIN2, TOUT84_SELE_PORT14_PIN4, TOUT71_SELE_PORT15_PIN0, TOUT42_SELI_PORT23_PIN1, TOUT32_SELI_PORT33_PIN10, TOUT90_SELI_PORT14_PIN10, TOUT144_SELK_PORT33_PIN15, TOUT37_SELI_PORT32_PIN1, TOUT32_SELJ_PORT33_PIN10, TOUT90_SELJ_PORT14_PIN10, TOUT62_SELI_PORT20_PIN6, TOUT94_SELK_PORT13_PIN3, TOUT144_SELL_PORT33_PIN15, TOUT37_SELJ_PORT32_PIN1, TOUT87_SELD_PORT14_PIN7, TOUT86_SELD_PORT14_PIN6, TOUT114_SELF_PORT01_PIN6}, origin=INFINEON_AURIX2G, post-build-variant-value=true, set at post-build, default-value=NONE  # This parameter decides the output port and pin for the GTM timer.
          choice reference GtmTimerUsed: scope=ECU, origin=INFINEON_AURIX2G, post-build-variant-value=true, set at post-build, destination=[McuGtmTomChannelAllocationConf, McuGtmAtomChannelAllocationConf]  # This parameter lists all the GTM timer channels (TOM/ATOM).
        container CCU6CC6Configuration  # Choose CCU6 T12/T13 channel which will be used by this PWM Channel. Referred timer channel in MCU should have CCU6ChannelUsage as USED_BY_PWM_DRIVER
          enumeration CCU6TimerUsed: {T12, T13}, origin=INFINEON_AURIX2G, post-build-variant-value=true, set at post-build, default-value=T12  # Selects Timer T12/T13. Note: Kernel selection is done in parameter CCU6KernelUsed..
          enumeration Cc6xChannel: {Cc60, Cc61, Cc62}, origin=INFINEON_AURIX2G, post-build-variant-value=true, set at post-build, default-value=Cc60  # Cc6 channel selection from the selected kernel
          enumeration CCU6TimerClockSelect: {CCU6_CONFIGURABLE_CLOCK_0, CCU6_CONFIGURABLE_CLOCK_1, CCU6_CONFIGURABLE_CLOCK_2, CCU6_CONFIGURABLE_CLOCK_3, CCU6_CONFIGURABLE_CLOCK_4, CCU6_CONFIGURABLE_CLOCK_6, CCU6_CONFIGURABLE_CLOCK_5, CCU6_CONFIGURABLE_CLOCK_7}, origin=INFINEON_AURIX2G, post-build-variant-value=true, set at post-build, default-value=CCU6_CONFIGURABLE_CLOCK_0  # This parameter decides the Clock Source for T12/T13 timer.
          boolean CCU6TimerPrescalarEnabled: origin=INFINEON_AURIX2G, post-build-variant-value=true, set at post-build, default-value=false  # if CCU6TimerPrescalarEnabled is false then T12/T13 Clock = fcc6 divided by (2 power CCU6TimerClockSelect) if CCU6TimerPrescalarEnabled is false then T12/T13 Clock = fcc6 divided by (2 power (CCU6TimerClockSelect+8) )
          reference CCU6KernelUsed: scope=ECU, origin=INFINEON_AURIX2G, post-build-variant-value=true, set at post-build, destination=McuCcu6ModuleAllocationConf  # This parameter lists all the CCU6 kernels. Note: CCU6 resource allocation is done at kernel level for each module. Once the kernel is allocated to the module, T12 or T13 timer of the kernel can only be assigned to one of the channels within the module.
    container PwmConfigurationOfOptApiServices  # This container has global switches of PWM APIs.
      boolean PwmDeInitApi: set at pre-compile, default-value=false  # Adds / removes the service Pwm_DeInit() from the code.
      boolean PwmGetOutputState: set at pre-compile, default-value=false  # Adds / removes the service Pwm_GetOutputState() from the code.
      boolean PwmSetDutyCycle: set at pre-compile, default-value=false  # Adds / removes the service Pwm_SetDutyCycle() from the code.
      boolean PwmSetOutputToIdle: set at pre-compile, default-value=false  # Adds / removes the service Pwm_SetOutputToIdle() from the code.
      boolean PwmSetPeriodAndDuty: set at pre-compile, default-value=false  # Adds / removes the service Pwm_SetPeriodAndDuty() from the code.
      boolean PwmVersionInfoApi: set at pre-compile, default-value=false  # Switch to indicate that the Pwm_ GetVersionInfo is supported
    container PwmGeneral  # General settings for the PWM driver.
      boolean PwmDevErrorDetect: set at pre-compile, default-value=true  # Switches the Default Error Tracer (Det) detection and notification ON or OFF.
      boolean PwmMultiCoreErrorDetect: origin=INFINEON_AURIX2G, set at pre-compile, default-value=true  # Switches the Multicore error detection and notification ON or OFF.
      boolean PwmDutycycleUpdatedEndperiod [0..1]: multiplicity set at pre-compile, set at pre-compile, default-value=false  # Switch for enabling the update of the duty cycle parameter at the end of the current period. PWM_VARIABLE_PERIOD channel class will not get affected with this parameter setting.
      integer PwmIndex: 0..4294967295, set at pre-compile, default-value=0  # Specifies the InstanceId of this module instance. If only one instance is present it shall have the Id 0.
      boolean PwmLowPowerStatesSupport [0..1]: multiplicity set at pre-compile, set at pre-compile, default-value=false  # Adds / removes all power state management related APIs (PWM_SetPowerState, PWM_GetCurrentPowerState, PWM_GetTargetPowerState, PWM_PreparePowerState, PWM_Main_PowerTransitionManager), indicating if the HW offers low power state management.
      boolean PwmNotificationSupported: set at pre-compile, default-value=false  # Switch to indicate that the notifications are supported
      boolean PwmPeriodUpdatedEndperiod [0..1]: multiplicity set at pre-compile, set at pre-compile, default-value=false  # Switch for enabling the update of the period parameter at the end of the current period. PWM_FIXED_PERIOD, PWM_FIXED_PERIOD_SHIFTED and PWM_FIXED_PERIOD_CENTER_ALIGNED channel class will not get affected with this parameter setting.
      boolean PwmChannelCoherentSelection: origin=INFINEON_AURIX2G, set at pre-compile, default-value=false  # Switch for enabling the update of the period / duty parameter at the end of the current period channel wise. Switching on this parameter obsoletes PwmDutycycleUpdatedEndperiod and PwmPeriodUpdatedEndperiod.
      boolean PwmHandleShiftByOffset: origin=INFINEON_AURIX2G, set at pre-compile, default-value=false  # Switch for enabling Speacial handling for shifted channels.
      boolean PwmDutyShiftInTicks: origin=INFINEON_AURIX2G, set at pre-compile, default-value=false  # Switch for Pwm Duty Cycle type: Disabled - Duty Cycle and Shift value in percentage. Enabled - Duty Cycle and Shift value in timer ticks. User has to take care of entering the right values for PwmDutycycleDefault and PwmShiftValue based on this selection.
      boolean PwmEnable0Or100DutyNotification: origin=INFINEON_AURIX2G, set at pre-compile, default-value=false  # Switch to enable notification for 0% and 100% duty for variable and fixed period channels.
      boolean PwmPowerStateAsynchTransitionMode: set at pre-compile, default-value=false  # Enables / disables support of the PWM Driver to the asynchronous power state transition.
      boolean PwmSafetyEnable: origin=INFINEON_AURIX2G, set at pre-compile, default-value=true  # Enable/Disable the Safety check and all associated notifications.
      boolean PwmInitCheckApi: origin=INFINEON_AURIX2G, set at pre-compile, default-value=true  # Adds / removes the service Pwm_17_GtmCcu6_InitCheck() from the code.
      container PwmPowerStateConfig [0..*]: multiplicity set at pre-compile  # Each instance of this parameter defines a power state and the callback to be called when this power state is reached.
        integer PwmPowerState: 0..9223372036854775807, set at pre-compile, symbolic-name-value=true, default-value=0  # Each instance of this parameter describes a different power state supported by the PWM HW. It should be defined by the HW supplier and used by the PWMDriver to reference specific HW configurations which set the PWM HW module in the referenced power state.
        function name PwmPowerStateReadyCbkRef: set at pre-compile, default-value=PwmPowerStateCbk  # Each instance of this parameter contains a reference to a power mode callback defined in a CDD or IoHwAbs component.
    container CommonPublishedInformation  # Common container, aggregated by all modules. It contains published information about vendor and versions.
      integer ArMajorVersion: 0..255, origin=INFINEON_AURIX2G, set at pre-compile, default-value=4  # Major version number of AUTOSAR specification on which the appropriate implementation is based on.
      integer ArMinorVersion: 0..255, origin=INFINEON_AURIX2G, set at pre-compile, default-value=2  # Minor version number of AUTOSAR specification on which the appropriate implementation is based on.
      integer ArPatchVersion: 0..255, origin=INFINEON_AURIX2G, set at pre-compile, default-value=2  # Patch level version number of AUTOSAR specification on which the appropriate implementation is based on.
      integer SwMajorVersion: 0..255, origin=INFINEON_AURIX2G, set at pre-compile, default-value=10  # Major version number of the vendor specific implementation of the module. The numbering is vendor specific.
      integer SwMinorVersion: 0..255, origin=INFINEON_AURIX2G, set at pre-compile, default-value=10  # Minor version number of the vendor specific implementation of the module. The numbering is vendor specific.
      integer SwPatchVersion: 0..255, origin=INFINEON_AURIX2G, set at pre-compile, default-value=1  # Patch level version number of the vendor specific implementation of the module. The numbering is vendor specific.
      integer ModuleId: 0..65535, origin=INFINEON_AURIX2G, set at pre-compile, default-value=121  # Module ID of this module from Module List
      integer VendorId: 0..65535, origin=INFINEON_AURIX2G, set at pre-compile, default-value=17  # Vendor ID of the dedicated implementation of this module according to the AUTOSAR vendor list
      string VendorApiInfix: origin=INFINEON_AURIX2G, set at pre-compile, default-value=GtmCcu6  # In driver modules which can be instantiated several times on a single ECU, BSW00347 requires that the name of APIs is extended by the VendorId and a vendor specific name. This parameter is used to specify the vendor specific name. In total, the implementation specific name is generated as follows: <ModuleName>_>VendorId>_<VendorApiInfix><Api name from SWS>. E.g. assuming that the VendorId of the implementor is 123 and the implementer chose a VendorApiInfix of "v11r456" a api name Can_Write defined in the SWS will translate to Can_123_v11r456Write. This parameter is mandatory for all modules with upper multiplicity > 1. It shall not be used for modules with upper multiplicity =1.
      string Release: origin=INFINEON_AURIX2G, set at published-information, default-value=_TRICORE_TC397  # Aurix2G derivative used for the implementation
