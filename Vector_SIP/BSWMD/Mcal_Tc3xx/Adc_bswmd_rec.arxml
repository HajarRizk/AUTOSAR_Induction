AUTOSAR XML (schema 4-2-2)
package /AURIX2G/EcucDefs
  module config Adc_Rec: definition=Adc
  bsw implementation Adc_Impl: programming-language=C, behavior=AdcBehavior, recommended-configuration=Adc_Rec, vendor-specific-module-def=Adc
