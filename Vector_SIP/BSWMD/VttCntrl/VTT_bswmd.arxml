AUTOSAR XML (schema 4-0-3)
package /MICROSAR/VTT
  module definition VTTCntrl: category=VENDOR_SPECIFIC_MODULE_DEFINITION, variants pre-compile/post-build-selectable
    container VttGeneral
      function name VttEntryPointName: set at pre-compile, origin=Vector Informatik, default-value=main  # Defines the entry point of the node layer DLL.
      string VttHeaderFile: set at pre-compile, origin=Vector Informatik  # Defines the header file for the entry point of the node layer DLL.
      string VttPreferredInputAsrVersion: set at pre-compile, origin=Vector Informatik  # Specifies the AUTOSAR version which should be used for input extracts. This parameter is only relevant for VTT Pro.
      string VttRequiredEcucGeneratorVersion: set at pre-compile, origin=Vector Informatik  # Specifies the version of VTT's built-in ECU-C generator which is required for the SIP. This parameter is only relevant for VTT Pro.
      boolean VttUserCalloutOnStateChange: set at pre-compile, default-value=false  # Specified whether VTTCntrl should provide the callout VttCntrl_UserCallout_OnStateChange. This callout allows user code to, e.g., perform work when the VTT DLL is loaded.
      string VttDllName: set at post-build in variant post-build-selectable / pre-compile in variant pre-compile, origin=Vector Informatik, default-value=MyECU.dll  # Defines the DLL file name (including .dll extension) of the node layer DLL. This parameter is used by the vVIRTUALtarget Tool to adapt the generated solution accordingly.
      boolean VttCalculateRteVfbHooks [0..1]: set at pre-compile, origin=Vector Informatik, default-value=true  # Calculate RTE VFB Hooks | If enabled VTT is called during calculation phase of this generator to generate a partial RTE configuration file with VTT VFB hooks. This configuration file is then merged into the actual RTE configuration of the project. Only disable this option if you have previously generated this module and since then no changes have been made to OS and RTE configuration.
    container VttSystemVariables [0..1]
      container VttSysVarType [0..*]
      container VttSysVar [0..*]
        linker symbol VttSysVarNotificationFunctionName [0..1]: set at pre-compile, origin=Vector Informatik  # Notification Function Name | Name of the notification callback function. When this value is empty or undefined, notifications are disabled for this System Variable. Note: Notification functions are called in the context of an ISR.
        reference VttSysVarInstanceTypeRef: set at pre-compile, origin=Vector Informatik, destination=VttSysVarType  # References the data type of this system variable.
        reference VttSysVarNamespaceRef [0..1]: set at pre-compile, origin=Vector Informatik, destination=VttSysVarNamespace  # References a namespace in CANoe, under which this system Variable is displayed. Note: The C implementation does not use namespaces. Namespaces are used for CANoe only.
        choice container VttSysVarInitialValue [0..1]  # Define an initial value for this system variable.
          container VttInitValueUint64 [0..1]  # An initial value of type uint64.
            integer VttInitValueUint64Value: 0..18446744073709551616, set at pre-compile, origin=Vector Informatik, default-value=0  # The initial value for this system variable.
          container VttInitValueSint64 [0..1]  # An initial value of type sint64.
            integer VttInitValueSint64Value: -9223372036854775807..9223372036854775808, set at pre-compile, origin=Vector Informatik, default-value=0  # The initial value for this system variable
          container VttInitValueFloat64 [0..1]  # An initial value of type float64.
            float VttInitValueFloat64Value: set at pre-compile, origin=Vector Informatik, default-value=0  # The initial value for this system variable
      container VttSysVarNamespace [0..*]  # Defines a namespace for system variables in CANoe. This namespace can be references in Parameter /VTTCntrl/VttSystemVariables/VttSysVar/VttSysVarNamespaceRef to place a system variable in the according namespace. Note: The C implementation does not use namespaces. Namespaces are used for CANoe only.
  bsw implementation VTTCntrl_Impl: programming-language=C, used-code-generator=DaVinci Configurator, vendor-id=30, preconfigured-configuration=VTTCntrl_Pre, recommended-configuration=VTTCntrl_Rec, vendor-specific-module-def=VTTCntrl
  module config VTTCntrl_Pre: definition=VTTCntrl
    VttGeneral: VttPreferredInputAsrVersion=4.2.1, VttRequiredEcucGeneratorVersion=1.0
    VttSystemVariables
      3 x VttSysVarType:
        sint64
        float64
        uint64
