AUTOSAR XML (schema 4-2-1)
package /MICROSAR
  module config Os_Pre: definition=Os
    OSDEFAULTAPPMODE (OsAppMode)
    OsPublishedInformation: OsKernelVersion=7, OsPlatformName=TriCoreAurix
