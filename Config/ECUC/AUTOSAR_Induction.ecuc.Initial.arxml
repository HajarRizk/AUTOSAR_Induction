AUTOSAR XML (schema 4-2-2)
package /InitialEcuC
  ecuc value collection InitialEcuC: ecuc-values=[Can, CanIf, CanSM, Com, ComM, EcuC, EcuM, PduR]
  module config Can
    CanConfigSet
      Controller_eJAD_AC_ECU_7f252cc98424769f_6e3aa728 (CanController):
        CanControllerActivation = true
        CanControllerDefaultBaudrate = CanControllerBaudrateConfig
        CanControllerSystemRef = Controller_eJAD_AC_ECU_7f252cc98424769f
        CanWakeupSourceRef = EcuMCommonConfiguration/Connector_eJAD_AC_ECU_5f730b4d60fd8937_17d2a688
        CanControllerBaudrateConfig: CanControllerBaudRate=500, CanControllerPropSeg=0, CanControllerSeg1=15, CanControllerSeg2=15
      Connector_eJAD_AC_ECU_5f730b4d60fd8937_17d2a688_Tx (CanHardwareObject): CanHandleType=BASIC, CanIdValue=0, CanObjectType=TRANSMIT, CanControllerRef=CanConfigSet/Controller_eJAD_AC_ECU_7f252cc98424769f_6e3aa728
      Connector_eJAD_AC_ECU_5f730b4d60fd8937_6b2462b8_Rx (CanHardwareObject):
        CanHandleType = BASIC
        CanIdType = STANDARD
        CanIdValue = 0
        CanObjectType = RECEIVE
        CanControllerRef = CanConfigSet/Controller_eJAD_AC_ECU_7f252cc98424769f_6e3aa728
    CanGeneral: CanIndex=0
  module config CanIf
    CanIfCtrlDrvCfg_7d254554 (CanIfCtrlDrvCfg): CanIfCtrlDrvInitHohConfigRef=CanIfInitHohCfg, CanIfCtrlDrvNameRef=CanGeneral
      Controller_eJAD_AC_ECU_7f252cc98424769f_6e3aa728 (CanIfCtrlCfg): CanIfCtrlCanCtrlRef=CanConfigSet/Controller_eJAD_AC_ECU_7f252cc98424769f_6e3aa728
    CanIfInitCfg
      CAR_BackBone_becaaf5c (CanIfBufferCfg): CanIfBufferSize=0, CanIfBufferHthRef=CanIfInitHohCfg/Connector_eJAD_AC_ECU_5f730b4d60fd8937_17d2a688_Tx
      CanIfInitHohCfg: CanIfInitRefCfgSet=CanConfigSet
        Connector_eJAD_AC_ECU_5f730b4d60fd8937_6b2462b8_Rx (CanIfHrhCfg):
          CanIfHrhCanCtrlIdRef = CanIfCtrlDrvCfg_7d254554/Controller_eJAD_AC_ECU_7f252cc98424769f_6e3aa728
          CanIfHrhIdSymRef = CanConfigSet/Connector_eJAD_AC_ECU_5f730b4d60fd8937_6b2462b8_Rx
        Connector_eJAD_AC_ECU_5f730b4d60fd8937_17d2a688_Tx (CanIfHthCfg):
          CanIfHthCanCtrlIdRef = CanIfCtrlDrvCfg_7d254554/Controller_eJAD_AC_ECU_7f252cc98424769f_6e3aa728
          CanIfHthIdSymRef = CanConfigSet/Connector_eJAD_AC_ECU_5f730b4d60fd8937_17d2a688_Tx
      3 x CanIfRxPduCfg, all with CanIfRxPduCanIdType=STANDARD_CAN, CanIfRxPduUserRxIndicationName=PduR_CanIfRxIndication, CanIfRxPduUserRxIndicationUL=PDUR, CanIfRxPduHrhIdRef=CanIfInitHohCfg/Connector_eJAD_AC_ECU_5f730b4d60fd8937_6b2462b8_Rx:
        AmbTempInCar_PDU_13f20e25_Rx: CanIfRxPduCanId=578, CanIfRxPduDlc=8, CanIfRxPduRef=EcucPduCollection/AmbTempInCar_PDU_74d62fd9_Rx
        AmbTempOutCar_PDU_76ec967d_Rx: CanIfRxPduCanId=423, CanIfRxPduDlc=12, CanIfRxPduRef=EcucPduCollection/AmbTempOutCar_PDU_b808f076_Rx
        UserControls_PDU_7e5bc196_Rx: CanIfRxPduCanId=360, CanIfRxPduDlc=8, CanIfRxPduRef=EcucPduCollection/UserControls_PDU_47f3742d_Rx
      ACFanSpeed_PDU_215f0eb2_Tx (CanIfTxPduCfg):
        CanIfTxPduCanId = 252
        CanIfTxPduCanIdType = STANDARD_CAN
        CanIfTxPduDlc = 8
        CanIfTxPduUserTxConfirmationName = PduR_CanIfTxConfirmation
        CanIfTxPduUserTxConfirmationUL = PDUR
        CanIfTxPduBufferRef = CanIfInitCfg/CAR_BackBone_becaaf5c
        CanIfTxPduRef = EcucPduCollection/ACFanSpeed_PDU_33daf8c1_Tx
    CanIfPrivateCfg: CanIfPrivateSoftwareFilterType=LINEAR
    CanIfPublicCfg: CanIfPublicPnSupport=false
  module config CanSM
    CanSMConfiguration
      CAR_BackBone_becaaf5c (CanSMManagerNetwork): CanSMComMNetworkHandleRef=ComMConfigSet/Connector_eJAD_AC_ECU_5f730b4d60fd8937_17d2a688
        Controller_eJAD_AC_ECU_7f252cc98424769f_96f26c3c (CanSMController): CanSMControllerId=CanIfCtrlDrvCfg_7d254554/Controller_eJAD_AC_ECU_7f252cc98424769f_6e3aa728
  module config Com
    ComConfig
      4 x ComIPdu, all with ComIPduType=NORMAL:
        ACFanSpeed_PDU_9dd02bc4_Tx: ComIPduDirection=SEND, ComIPduSignalRef=ACCompPow_b4e01f19_Tx, ComIPduSignalRef=ACExhaustState_8c8df521_Tx, ComIPduSignalRef=ACFanSpeed_PDU_NewSignal_17764525_Tx, ComPduIdRef=EcucPduCollection/ACFanSpeed_PDU_9dd02bc4_Tx
          ComTxIPdu
        AmbTempInCar_PDU_5a566260_Rx: ComIPduDirection=RECEIVE, ComIPduSignalRef=AmbTempInCar_PDU_Signal_dff5af2c_Rx, ComPduIdRef=EcucPduCollection/AmbTempInCar_PDU_5a566260_Rx
        AmbTempOutCar_PDU_dccc009c_Rx: ComIPduDirection=RECEIVE, ComIPduSignalRef=AmbTempOutCar_PDU_Signal_c27be2af_Rx, ComPduIdRef=EcucPduCollection/AmbTempOutCar_PDU_dccc009c_Rx
        UserControls_PDU_5c89b54e_Rx: ComIPduDirection=RECEIVE, ComIPduSignalRef=AC_UC_AirCirc_e0001df6_Rx, ComIPduSignalRef=AC_UC_Power_level_7de4e9a1_Rx, ComIPduSignalRef=AC_UC_TargetTemp_abfdd769_Rx, ComPduIdRef=EcucPduCollection/UserControls_PDU_5c89b54e_Rx
      8 x ComSignal, all with ComSignalEndianness=LITTLE_ENDIAN, ComSignalType=UINT16:
        ACCompPow_b4e01f19_Tx: ComBitPosition=8, ComBitSize=10, ComSystemTemplateSystemSignalRef=SignalPduMapping_d96710a1a58e7aec
        ACExhaustState_8c8df521_Tx: ComBitPosition=32, ComBitSize=1, ComSystemTemplateSystemSignalRef=SignalPduMapping_f21c0ab8898fb710
        ACFanSpeed_PDU_NewSignal_17764525_Tx: ComBitPosition=0, ComBitSize=8, ComSystemTemplateSystemSignalRef=SignalPduMapping_2ccc2b059ce59571
        AC_UC_AirCirc_e0001df6_Rx: ComBitPosition=13, ComBitSize=1, ComSystemTemplateSystemSignalRef=SignalPduMapping_3ee2dc727776d388
        AC_UC_Power_level_7de4e9a1_Rx: ComBitPosition=4, ComBitSize=3, ComSystemTemplateSystemSignalRef=SignalPduMapping_2a6976e05a548784
        AC_UC_TargetTemp_abfdd769_Rx: ComBitPosition=7, ComBitSize=6, ComSystemTemplateSystemSignalRef=SignalPduMapping_707eb2ecdc8d0331
        AmbTempInCar_PDU_Signal_dff5af2c_Rx: ComBitPosition=10, ComBitSize=12, ComSystemTemplateSystemSignalRef=SignalPduMapping_a5b6478d8fce26ee
        AmbTempOutCar_PDU_Signal_c27be2af_Rx: ComBitPosition=0, ComBitSize=12, ComSystemTemplateSystemSignalRef=SignalPduMapping_27ddf6cf53bfe8ff
    ComGeneral
  module config ComM
    ComMConfigSet: ComMPncEnabled=false
      Connector_eJAD_AC_ECU_5f730b4d60fd8937_17d2a688 (ComMChannel): ComMBusType=COMM_BUS_TYPE_CAN, ComMChannelId=0
        ComMNetworkManagement: ComMNmVariant=NONE
        Connector_eJAD_AC_ECU_5f730b4d60fd8937_76433822 (ComMUserPerChannel): ComMUserChannel=Connector_eJAD_AC_ECU_5f730b4d60fd8937_1ac2290f
      Connector_eJAD_AC_ECU_5f730b4d60fd8937_1ac2290f (ComMUser): ComMUserIdentifier=0
    ComMGeneral: ComMPncIdCounting=COMM_PNC_ID_COUNT_FROM_NM_MESSAGE, ComMPncSupport=false
  module config EcuC
    EcucPduCollection: PduIdTypeEnum=UINT8, PduLengthTypeEnum=UINT8
      8 x Pdu, all with PduLength=8:
        ACFanSpeed_PDU_33daf8c1_Tx: SysTPduToFrameMappingRef=PduToFrameMapping_4b0bcc7affe88c61
        ACFanSpeed_PDU_9dd02bc4_Tx
        AmbTempInCar_PDU_5a566260_Rx
        AmbTempInCar_PDU_74d62fd9_Rx: SysTPduToFrameMappingRef=PduToFrameMapping_b18a915f7936e63c
        AmbTempOutCar_PDU_b808f076_Rx: SysTPduToFrameMappingRef=PduToFrameMapping_3834b85e703fcba0
        AmbTempOutCar_PDU_dccc009c_Rx
        UserControls_PDU_47f3742d_Rx: SysTPduToFrameMappingRef=PduToFrameMapping_f802b4eaa6c1cd0b
        UserControls_PDU_5c89b54e_Rx
  module config EcuM
    EcuMConfiguration
      EcuMCommonConfiguration
        EcuMDriverInitListOne
        EcuMDriverRestartList
        Connector_eJAD_AC_ECU_5f730b4d60fd8937_17d2a688 (EcuMWakeupSource): EcuMWakeupSourceId=5, EcuMComMChannelRef=ComMConfigSet/Connector_eJAD_AC_ECU_5f730b4d60fd8937_17d2a688
      EcuMFlexConfiguration: EcuMFlexModuleConfigurationRef=CanConfigSet
  module config PduR
    PduRGeneral
    PduRRoutingTables
      PduRRoutingTable
        4 x PduRRoutingPath:
          ACFanSpeed_PDU_9dd02bc4_Tx
            ACFanSpeed_PDU_33daf8c1_Tx (PduRDestPdu): PduRDestPduRef=EcucPduCollection/ACFanSpeed_PDU_33daf8c1_Tx
            PduRSrcPdu_8f6eaf74 (PduRSrcPdu): PduRSrcPduRef=EcucPduCollection/ACFanSpeed_PDU_9dd02bc4_Tx
          AmbTempInCar_PDU_74d62fd9_Rx
            AmbTempInCar_PDU_74d62fd9_Rx_c8ac1b77_Rx (PduRDestPdu): PduRDestPduRef=EcucPduCollection/AmbTempInCar_PDU_5a566260_Rx
            PduRSrcPdu_c8ac1b77 (PduRSrcPdu): PduRSrcPduRef=EcucPduCollection/AmbTempInCar_PDU_74d62fd9_Rx
          AmbTempOutCar_PDU_b808f076_Rx
            AmbTempOutCar_PDU_b808f076_Rx_e3f99b79_Rx (PduRDestPdu): PduRDestPduRef=EcucPduCollection/AmbTempOutCar_PDU_dccc009c_Rx
            PduRSrcPdu_e3f99b79 (PduRSrcPdu): PduRSrcPduRef=EcucPduCollection/AmbTempOutCar_PDU_b808f076_Rx
          UserControls_PDU_47f3742d_Rx
            UserControls_PDU_47f3742d_Rx_4b41d348_Rx (PduRDestPdu): PduRDestPduRef=EcucPduCollection/UserControls_PDU_5c89b54e_Rx
            PduRSrcPdu_4b41d348 (PduRSrcPdu): PduRSrcPduRef=EcucPduCollection/UserControls_PDU_47f3742d_Rx
