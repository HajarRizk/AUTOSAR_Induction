AUTOSAR XML (schema 00046)
package /InitialEcuC
  ecuc value collection InitialEcuC
