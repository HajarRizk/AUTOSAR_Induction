AUTOSAR XML (schema 4-2-2)
package /ActiveEcuC
  module config VTTMcu: implementation-config-variant=VARIANT-PRE-COMPILE, module-description=VTTMcu_Impl
    McuGeneralConfiguration:
      McuDevErrorDetect = true
      McuGetRamStateApi = false
      McuInitClock = true
      McuNoPll = false
      McuPerformResetApi = false
      McuVersionInfoApi = false
      McuSafeBswChecks = false
    McuPublishedInformation
    McuModuleConfiguration: McuNumberOfMcuModes=1, McuRamSectors=0, McuClockSrcFailureNotification=DISABLED
      McuModeSettingConf: McuMode=0, McuVttMode=VTTMCU_MODE_NORMAL
      McuClockSettingConfig: McuClockSettingId=0
        McuClockReferencePoint: McuClockReferencePointFrequency=40000000
