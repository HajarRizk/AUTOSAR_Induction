AUTOSAR XML (schema 4-2-2)
package /ActiveEcuC
  module config CanIf: implementation-config-variant=VARIANT-PRE-COMPILE, module-description=CanIf_Impl
    CanIfCtrlDrvCfg_7d254554 (CanIfCtrlDrvCfg): CanIfCtrlDrvTxCancellation=false, CanIfCtrlDrvInitHohConfigRef=CanIfInitHohCfg, CanIfCtrlDrvNameRef=CanGeneral
      Controller_eJAD_AC_ECU_7f252cc98424769f_6e3aa728 (CanIfCtrlCfg):
        CanIfCtrlId = 0
        CanIfCtrlWakeupSupport = false
        CanIfCtrlJ1939DynAddrSupport = DISABLED
        CanIfCtrlCanCtrlRef = Controller_eJAD_AC_ECU_7f252cc98424769f_6e3aa728
    CanIfDispatchCfg:
      CanIfDispatchUserCtrlBusOffName = CanSM_ControllerBusOff
      CanIfDispatchUserCtrlBusOffUL = CAN_SM
      CanIfDispatchUserCtrlModeIndicationName = CanSM_ControllerModeIndication
      CanIfDispatchUserCtrlModeIndicationUL = CAN_SM
    CanIfInitCfg
      ACFanSpeed_PDU_215f0eb2_Tx (CanIfTxPduCfg):
        CanIfTxPduCanId = 252
        CanIfTxPduCanIdType = STANDARD_CAN
        CanIfTxPduDlc = 8
        CanIfTxPduUserTxConfirmationName = PduR_CanIfTxConfirmation
        CanIfTxPduUserTxConfirmationUL = PDUR
        CanIfTxPduId = 1
        CanIfTxPduReadNotifyStatus = false
        CanIfTxPduType = STATIC
        CanIfTxPduBufferRef = CAR_BackBone_becaaf5c
        CanIfTxPduRef = ACFanSpeed_PDU_33daf8c1_Tx
      AmbTempOutCar_PDU_76ec967d_Rx (CanIfRxPduCfg):
        CanIfRxPduCanId = 423
        CanIfRxPduCanIdType = STANDARD_CAN
        CanIfRxPduDlc = 8
        CanIfRxPduUserRxIndicationName = PduR_CanIfRxIndication
        CanIfRxPduUserRxIndicationUL = PDUR
        CanIfRxPduId = 1
        CanIfRxPduReadData = false
        CanIfRxPduReadNotifyStatus = false
        CanIfRxPduDlcCheck = true
        CanIfRxPduHrhIdRef = Connector_eJAD_AC_ECU_5f730b4d60fd8937_6b2462b8_Rx
        CanIfRxPduRef = AmbTempOutCar_PDU_b808f076_Rx
      UserControls_PDU_7e5bc196_Rx (CanIfRxPduCfg):
        CanIfRxPduCanId = 360
        CanIfRxPduCanIdType = STANDARD_CAN
        CanIfRxPduDlc = 8
        CanIfRxPduUserRxIndicationName = PduR_CanIfRxIndication
        CanIfRxPduUserRxIndicationUL = PDUR
        CanIfRxPduId = 2
        CanIfRxPduReadData = false
        CanIfRxPduReadNotifyStatus = false
        CanIfRxPduDlcCheck = true
        CanIfRxPduHrhIdRef = Connector_eJAD_AC_ECU_5f730b4d60fd8937_6b2462b8_Rx
        CanIfRxPduRef = UserControls_PDU_47f3742d_Rx
      CanIfInitHohCfg: CanIfInitRefCfgSet=CanConfigSet
        Connector_eJAD_AC_ECU_5f730b4d60fd8937_6b2462b8_Rx (CanIfHrhCfg):
          CanIfHrhSoftwareFilter = true
          CanIfHrhCanCtrlIdRef = Controller_eJAD_AC_ECU_7f252cc98424769f_6e3aa728
          CanIfHrhIdSymRef = Connector_eJAD_AC_ECU_5f730b4d60fd8937_6b2462b8_Rx
        Connector_eJAD_AC_ECU_5f730b4d60fd8937_17d2a688_Tx (CanIfHthCfg): CanIfHthCanCtrlIdRef=Controller_eJAD_AC_ECU_7f252cc98424769f_6e3aa728, CanIfHthIdSymRef=Connector_eJAD_AC_ECU_5f730b4d60fd8937_17d2a688_Tx
      CAR_BackBone_becaaf5c (CanIfBufferCfg):
        CanIfBufferSize = 2
        CanIfTxBufferHandlingType = PRIO_BY_CANID
        CanIfTxBufferMappedTxPdus = 2
        CanIfTxBufferMaxPduLength = 8
        CanIfBufferHthRef = Connector_eJAD_AC_ECU_5f730b4d60fd8937_17d2a688_Tx
      AmbTempInCar_PDU_13f20e25_Rx (CanIfRxPduCfg):
        CanIfRxPduCanId = 578
        CanIfRxPduCanIdType = STANDARD_CAN
        CanIfRxPduDlc = 8
        CanIfRxPduUserRxIndicationName = PduR_CanIfRxIndication
        CanIfRxPduUserRxIndicationUL = PDUR
        CanIfRxPduId = 0
        CanIfRxPduReadData = false
        CanIfRxPduReadNotifyStatus = false
        CanIfRxPduDlcCheck = true
        CanIfRxPduHrhIdRef = Connector_eJAD_AC_ECU_5f730b4d60fd8937_6b2462b8_Rx
        CanIfRxPduRef = AmbTempInCar_PDU_74d62fd9_Rx
      DiagRequest (CanIfRxPduCfg):
        CanIfRxPduCanIdType = STANDARD_CAN
        CanIfRxPduDlc = 8
        CanIfRxPduId = 3
        CanIfRxPduReadData = false
        CanIfRxPduReadNotifyStatus = false
        CanIfRxPduUserRxIndicationName = CanTp_RxIndication
        CanIfRxPduUserRxIndicationUL = CAN_TP
        CanIfRxPduDlcCheck = false
        CanIfRxPduCanId = 263
        CanIfRxPduDataChecksumPdu = false
        CanIfRxPduHrhIdRef = Connector_eJAD_AC_ECU_5f730b4d60fd8937_6b2462b8_Rx
        CanIfRxPduRef = Diag_Request_CanIF
      DiagResponse (CanIfTxPduCfg):
        CanIfTxPduCanId = 262
        CanIfTxPduCanIdType = STANDARD_CAN
        CanIfTxPduDlc = 8
        CanIfTxPduId = 0
        CanIfTxPduReadNotifyStatus = false
        CanIfTxPduType = STATIC
        CanIfTxPduUserTxConfirmationUL = CAN_TP
        CanIfTxPduUserTxConfirmationName = CanTp_TxConfirmation
        CanIfTxPduBufferRef = CAR_BackBone_becaaf5c
        CanIfTxPduRef = DiagRespnse_CanIF
    CanIfPrivateCfg:
      CanIfPrivateSoftwareFilterType = LINEAR
      CanIfPrivateDlcCheck = true
      CanIfSupportTTCAN = false
      CanIfTransceiverMapping = false
      CanIfTransceiverHandling = false
      CanIfSupportExtendedIds = false
      CanIfSupportNmOsek = false
      CanIfTxBufferType = BYTE_QUEUE
      CanIfOptimizeOneController = true
      CanIfWakeupSupport = false
      CanIfStaticFdTxBufferSupport = false
      CanIfRxSearchConsiderMsgType = false
      CanIfTxBufferFifoSupport = false
      CanIfSetPduReceptionModeSupport = false
      CanIfDataChecksumRxSupport = false
      CanIfDataChecksumTxSupport = false
    CanIfPublicCfg:
      CanIfPublicPnSupport = false
      CanIfPublicCancelTransmitSupport = false
      CanIfPublicDevErrorDetect = true
      CanIfPublicHandleTypeEnum = UINT8
      CanIfPublicMultipleDrvSupport = false
      CanIfPublicNumberOfCanHwUnits = 1
      CanIfPublicReadRxPduDataApi = false
      CanIfPublicReadRxPduNotifyStatusApi = false
      CanIfPublicReadTxPduNotifyStatusApi = false
      CanIfPublicSetDynamicTxIdApi = false
      CanIfPublicTxBuffering = true
      CanIfPublicTxConfirmPollingSupport = false
      CanIfPublicVersionInfoApi = false
      CanIfPublicWakeupCheckValidSupport = false
      CanIfPnWakeupTxPduFilterSupport = false
      CanIfPnTrcvHandlingSupport = false
      CanIfJ1939DynAddrSupport = DISABLED
      CanIfSafeBswChecks = false
      CanIfBusMirroringSupport = false
      CanIfSetBaudrateApi = false
