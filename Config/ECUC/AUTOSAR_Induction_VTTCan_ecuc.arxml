AUTOSAR XML (schema 4-2-2)
package /ActiveEcuC
  module config VTTCan: implementation-config-variant=VARIANT-PRE-COMPILE, module-description=VTTCan_Impl
    CanGeneral:
      CanChangeBaudrateApi = false
      CanDevErrorDetection = true
      CanHardwareCancellation = false
      CanIdenticalIdCancellation = false
      CanIndex = 0
      CanMainFunctionBusoffPeriod = 0.01
      CanMainFunctionModePeriod = 0.01
      CanMainFunctionWakeupPeriod = 0.01
      CanMultiplexedTransmission = false
      CanSetBaudrateApi = false
      CanTimeoutDuration = 0.01
      CanVersionInfoApi = false
      CanGenericPrecopy = false
      CanHardwareLoopCheck = false
      CanRxFullCANSupport = false
      CanTxFullCANSupport = false
      CanRxBasicCANSupport = true
      CanUseNestedCANInterrupts = false
      CanHardwareCancelByAppl = false
      CanIndividualProcessing = false
      CanGenericConfirmation = false
      CanGenericConfirmationAPI2 = false
      CanRxQueue = false
      CanSupportMixedID = false
      CanRxQueueSize = 10
      CanMultipleBasicCANObjects = false
      CanMultipleBasicCANTxObjects = false
      CanHardwareHandleType = UINT8
      CanOptimizeOneController = true
      CanInterruptCategory = CATEGORY2
      CanGetStatus = false
      CanInterruptLock = DRIVER
      CanWakeupSupport = false
      CanRamCheck = None
      CanOverrunNotification = DET
      CanReinitStart = false
      CanGenericPreTransmit = false
      CanFdSupport = NONE
      CanRuntimeMeasurementSupport = false
      CanMaxRxDataLen = 8
      CanMaxTxDataLen = 8
      CanUsePeripheralAccessApi = false
      CanMirrorModeSupport = false
      CanUseOsInterruptControl = false
      CanSafeBswChecks = false
      CanSilentModeSupport = false
      CanHwTxFifoSupport = false
      CanCheckWakeupCanRetType = false
      CanFdHardwareBufferOptimization = false
      CanMainFunctionRWPeriods: CanMainFunctionReadPeriod=0.01, CanMainFunctionWritePeriod=0.01
    CanConfigSet
      Connector_eJAD_AC_ECU_5f730b4d60fd8937_6b2462b8_Rx (CanHardwareObject):
        CanHandleType = BASIC
        CanIdType = STANDARD
        CanIdValue = 0
        CanObjectId = 1
        CanObjectType = RECEIVE
        CanHwProcessing = true
        CanObjectHwSize = 5
        CanObjectHwHandle = 1
        CanMaxDataLen = 8
        CanFdPaddingValue = 0
        CanObjectMultiplexedTransmission = false
        CanObjectHwFifo = false
        CanControllerRef = Controller_eJAD_AC_ECU_7f252cc98424769f_6e3aa728
        CanFilterMaskRef = CanFilterMask
      Connector_eJAD_AC_ECU_5f730b4d60fd8937_17d2a688_Tx (CanHardwareObject):
        CanHandleType = BASIC
        CanIdType = STANDARD
        CanIdValue = 0
        CanObjectId = 0
        CanObjectType = TRANSMIT
        CanHwProcessing = true
        CanObjectHwSize = 1
        CanObjectHwHandle = 0
        CanMaxDataLen = 8
        CanFdPaddingValue = 0
        CanObjectMultiplexedTransmission = false
        CanObjectHwFifo = false
        CanControllerRef = Controller_eJAD_AC_ECU_7f252cc98424769f_6e3aa728
      Controller_eJAD_AC_ECU_7f252cc98424769f_6e3aa728 (CanController):
        CanBusoffProcessing = POLLING
        CanControllerActivation = true
        CanControllerBaseAddress = 0
        CanControllerId = 0
        CanRxProcessing = POLLING
        CanTxProcessing = POLLING
        CanWakeupProcessing = POLLING
        CanWakeupSupport = false
        CanWakeupSourceId = 0
        CanBusName = CAN
        CanControllerDefaultBaudrate = CanControllerBaudrateConfig
        CanWakeupSourceRef = Connector_eJAD_AC_ECU_5f730b4d60fd8937_17d2a688
        CanControllerBaudrateConfig:
          CanControllerBaudRate = 500
          CanControllerBaudRateConfigID = 0
          CanControllerPropSeg = 7
          CanControllerSeg1 = 4
          CanControllerSeg2 = 4
          CanControllerSyncJumpWidth = 1
          CanBaudrateClock = 8000
          CanBaudratePrescaler = 1
          CanSamplingMode = OneSample
        CanFilterMask: CanFilterMaskValue=0, CanFilterCodeValue=0, IsLocked=false
