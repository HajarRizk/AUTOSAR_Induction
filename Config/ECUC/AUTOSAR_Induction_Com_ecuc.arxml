AUTOSAR XML (schema 4-2-2)
package /ActiveEcuC
  module config Com: implementation-config-variant=VARIANT-PRE-COMPILE, module-description=Com_Impl
    ComGeneration:
      ComOutOfBoundsWriteProtectionStrategy = NONE
      ComOutOfBoundsWriteSanitizer = false
      ComOutOfBoundsReadSanitizer = false
      ComReduceConstantData2Define = false
      ComBoolDataInArrayOfStructStrategy = BOOLEAN
      ComDeduplicateIndirectedData = true
      ComDataDeduplicationStrategy = WITH_CAST
      ComReduceBoolDataByNegationThreshold = 2
      ComReduceBoolDataByNumericalComparisonThreshold = 2
      ComReduceBoolDataByNumericalRelationThreshold = 2
      ComReduceBoolDataByNumericalOperandStrategy = WITH_ANY_VALUE
      ComReduceNumericalDataByOffsetThreshold = 2
      ComReduceNumericalDataByArraySubtractionThreshold = 2
      ComReduceDataByStreaming = false
      ComShortSymbols = false
      ComInterfacesForDeactivatedData = false
      ComReferringKeysInComments = false
    ComOptimization:
      ComTxCyclicProcessingISRLockThreshold = 1
      ComTxDeadlineMonitoringISRLockThreshold = 1
      ComTxProcessingISRLockThreshold = 1
      ComRxDeadlineMonitoringISRLockThreshold = 1
      ComRxDeferredProcessingISRLockThreshold = 1
      ComGatewayProcessingISRLockThreshold = 1
      ComGatewayDescriptionProcessingISRLockThreshold = 1
      ComIPduGroupISRLockThreshold = 1
    ComConfig: ComConfigurationId=0, ComRxDeferredNotificationCacheSize=1, ComRxImmediateNotificationCacheSize=0
      AmbTempOutCar_PDU_dccc009c_Rx (ComIPdu):
        ComIPduDirection = RECEIVE
        ComIPduType = NORMAL
        ComIPduHandleId = 1
        ComIPduSignalProcessing = DEFERRED
        ComIPduCancellationSupport = false
        ComIPduSignalRef = AmbTempOutCar_PDU_Signal_c27be2af_Rx
        ComPduIdRef = AmbTempOutCar_PDU_dccc009c_Rx
      ComTimeBase: ComRxTimeBase=0.01, ComTxTimeBase=0.01, ComGwTimeBase=0.01
      AC_UC_TargetTemp_abfdd769_Rx (ComSignal):
        ComBitPosition = 7
        ComBitSize = 6
        ComSignalEndianness = LITTLE_ENDIAN
        ComSignalType = UINT16
        ComSignalInitValue = 0
        ComSignalAccess = ACCESS_UNCLEAR
        ComHandleId = 2
        ComSystemTemplateSystemSignalRef = SignalPduMapping_707eb2ecdc8d0331
      AmbTempInCar_PDU_Signal_dff5af2c_Rx (ComSignal):
        ComBitPosition = 10
        ComBitSize = 12
        ComSignalEndianness = LITTLE_ENDIAN
        ComSignalType = UINT16
        ComSignalInitValue = 0
        ComSignalAccess = ACCESS_UNCLEAR
        ComHandleId = 3
        ComSystemTemplateSystemSignalRef = SignalPduMapping_a5b6478d8fce26ee
      ACFanSpeed_PDU_9dd02bc4_Tx (ComIPdu):
        ComIPduDirection = SEND
        ComIPduType = NORMAL
        ComIPduHandleId = 0
        ComIPduSignalProcessing = DEFERRED
        ComIPduCancellationSupport = false
        ComIPduSignalRef = ACCompPow_b4e01f19_Tx
        ComIPduSignalRef = ACExhaustState_8c8df521_Tx
        ComIPduSignalRef = ACFanSpeed_PDU_NewSignal_17764525_Tx
        ComPduIdRef = ACFanSpeed_PDU_9dd02bc4_Tx
        ComTxIPdu: ComMinimumDelayTime=0, ComTxIPduUnusedAreasDefault=0
          ComTxModeTrue
            ComTxMode: ComTxModeMode=DIRECT, ComTxModeNumberOfRepetitions=0
          ComTxModeFalse
            ComTxMode: ComTxModeMode=DIRECT, ComTxModeNumberOfRepetitions=0
      6 x ComSignal, all with ComSignalEndianness=LITTLE_ENDIAN, ComSignalType=UINT16, ComSignalInitValue=0:
        AC_UC_Power_level_7de4e9a1_Rx: ComBitPosition=4, ComBitSize=3, ComSignalAccess=ACCESS_UNCLEAR, ComHandleId=1, ComSystemTemplateSystemSignalRef=SignalPduMapping_2a6976e05a548784
        AmbTempOutCar_PDU_Signal_c27be2af_Rx: ComBitPosition=0, ComBitSize=12, ComSignalAccess=ACCESS_UNCLEAR, ComHandleId=4, ComSystemTemplateSystemSignalRef=SignalPduMapping_27ddf6cf53bfe8ff
        AC_UC_AirCirc_e0001df6_Rx: ComBitPosition=13, ComBitSize=16, ComSignalAccess=ACCESS_NEEDED_BY_SWC_OR_COM, ComHandleId=0, ComNotification=Rte_COMCbk_AC_UC_AirCirc_e0001df6_Rx, ComSystemTemplateSystemSignalRef=SignalPduMapping_3ee2dc727776d388
        ACFanSpeed_PDU_NewSignal_17764525_Tx: ComBitPosition=0, ComBitSize=8, ComSignalAccess=ACCESS_UNCLEAR, ComHandleId=2, ComTransferProperty=PENDING, ComSystemTemplateSystemSignalRef=SignalPduMapping_2ccc2b059ce59571
        ACCompPow_b4e01f19_Tx: ComBitPosition=8, ComBitSize=16, ComSignalAccess=ACCESS_NEEDED_BY_SWC_OR_COM, ComHandleId=0, ComTransferProperty=TRIGGERED, ComSystemTemplateSystemSignalRef=SignalPduMapping_d96710a1a58e7aec
        ACExhaustState_8c8df521_Tx: ComBitPosition=32, ComBitSize=1, ComSignalAccess=ACCESS_UNCLEAR, ComHandleId=1, ComTransferProperty=PENDING, ComSystemTemplateSystemSignalRef=SignalPduMapping_f21c0ab8898fb710
      AmbTempInCar_PDU_5a566260_Rx (ComIPdu):
        ComIPduDirection = RECEIVE
        ComIPduType = NORMAL
        ComIPduHandleId = 0
        ComIPduSignalProcessing = DEFERRED
        ComIPduCancellationSupport = false
        ComIPduSignalRef = AmbTempInCar_PDU_Signal_dff5af2c_Rx
        ComPduIdRef = AmbTempInCar_PDU_5a566260_Rx
      UserControls_PDU_5c89b54e_Rx (ComIPdu):
        ComIPduDirection = RECEIVE
        ComIPduType = NORMAL
        ComIPduHandleId = 2
        ComIPduSignalProcessing = DEFERRED
        ComIPduCancellationSupport = false
        ComIPduSignalRef = AC_UC_AirCirc_e0001df6_Rx
        ComIPduSignalRef = AC_UC_Power_level_7de4e9a1_Rx
        ComIPduSignalRef = AC_UC_TargetTemp_abfdd769_Rx
        ComPduIdRef = UserControls_PDU_5c89b54e_Rx
    ComGeneral:
      ComConfigurationUseDet = true
      ComSafeBswChecks = false
      ComEnableSignalGroupArrayApi = false
      ComRetryFailedTransmitRequests = false
      ComSupportedIPduGroups = 1
      ComVersionInfoApi = false
      ComAdvancedIPduCallouts = true
      ComOptimizedIPduGroupHandling = false
      ComMetaDataSupport = false
      ComReceiveSignalMacroAPI = false
      ComDeferredEventCacheSupport = false
      ComMainfunctionTimingDomainSupport = false
      ComSignalGateway = false
      ComDescriptionGateway = false
      ComDescriptionRoutingCodeGeneration = false
      ComUserCbkHeaderFile = Rte_Cbk.h
