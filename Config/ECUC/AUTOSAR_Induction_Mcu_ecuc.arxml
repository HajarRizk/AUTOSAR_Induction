AUTOSAR XML (schema 4-2-2)
package /ActiveEcuC
  module config Mcu: implementation-config-variant=VARIANT-POST-BUILD, module-description=Mcu_Impl
    McuModuleConfiguration: McuClockSrcFailureNotification=DISABLED, McuNumberOfMcuModes=1, McuRamSectors=0
      GtmGlobalConfiguration
        McuGtmClockManagementConf: GtmCmuGlobalClockNumerator=1, GtmCmuGlobalClockDenominator=1
          GtmFixedClockSetting: GtmCmuFixedClockEnable=true, GtmCmuFixedClockSel=CMU_GLOBAL_CLOCK_SEL0
          GtmExtClockSetting:
            GtmCmuExtClock0Enable = false
            GtmCmuExtClock0Numerator = 1
            GtmCmuExtClock0Denominator = 1
            GtmCmuExtClock1Enable = false
            GtmCmuExtClock1Numerator = 1
            GtmCmuExtClock1Denominator = 1
            GtmCmuExtClock2Enable = false
            GtmCmuExtClock2Numerator = 1
            GtmCmuExtClock2Denominator = 1
          GtmConfigClockSetting:
            GtmCmuConfigClock0Enable = true
            GtmCmuConfigClock0Div = 0
            GtmCmuConfigClock1Enable = true
            GtmCmuConfigClock1Div = 0
            GtmCmuConfigClock2Enable = true
            GtmCmuConfigClock2Div = 0
            GtmCmuConfigClock3Enable = true
            GtmCmuConfigClock3Div = 0
            GtmCmuConfigClock4Enable = true
            GtmCmuConfigClock4Div = 0
            GtmCmuConfigClock5Enable = true
            GtmCmuConfigClock5Div = 0
            GtmCmuConfigClock6Enable = true
            GtmCmuConfigClock6Div = 0
            GtmCmuConfigClock7Enable = true
            GtmCmuConfigClock7Div = 0
      McuTrapSettingConf:
        McuCPU{0..5}ESR0TrapEnable = false
        McuCPU{0..5}ESR1TrapEnable = false
        McuCPU{0..5}Trap2Enable = false
        McuCPU{0..5}SMUTrapEnable = false
      McuEruGlobalConf: McuEruInputFilterRegVal=0
      McuResetSettingConf:
        McuESR0ResetConf = MCU_ESR0_NO_RESET_SEL0
        McuESR1ResetConf = MCU_ESR1_NO_RESET_SEL0
        McuSWResetConf = MCU_SW_NO_RESET_SEL0
        McuSMUResetConf = MCU_SMU_NO_RESET_SEL0
        McuSTM{0..5}ResetConf = MCU_STM{0..5}_NO_RESET_SEL0
        McuSTM{0..5}ResetOnApplResetEnable = true
      McuModeSettingConf: McuMode=0, McuEvrcLPMOnSleepReqEnable=false
        McuStdbyModeSettingConf:
          McuStdbyModePortTriStateEnable = false
          McuStdbyModeESR0TriStateEnable = false
          McuStdbyModeWakeupFromPORST = true
          McuStdbyModePORSTFilterEnable = false
          McuStdbyModeWakeupFromEVR = false
          McuStdbyModeWakeupFromSCR = false
          McuStdbyModeClkSelection = OSC_CLOCK_100KHZ_ONLY_SEL0
          McuStdbyModeBlankingFilterDelay = DELAY_0_MS_SEL0
          McuStdbyModeRamEnable = MCU_STANDBYRAM_DISABLED_SEL0
          McuStdbyModeESR0Conf: McuStdbyModeESR0WakeupEnable=false, McuStdbyModeESR0FltEnable=false, McuStdbyModeESR0EdgeDetection=ESR0_TRIG_RISING_EDGE_SEL1
          McuStdbyModeESR1Conf: McuStdbyModeESR1WakeupEnable=false, McuStdbyModeESR1FltEnable=false, McuStdbyModeESR1EdgeDetection=ESR1_TRIG_RISING_EDGE_SEL1
          McuStdbyModePinAConf: McuStdbyModePinAWakeupEnable=false, McuStdbyModePinAFltEnable=false, McuStdbyModePinAEdgeDetection=PINA_TRIG_RISING_EDGE_SEL1
          McuStdbyModePinBConf: McuStdbyModePinBWakeupEnable=false, McuStdbyModePinBFltEnable=false, McuStdbyModePinBEdgeDetection=PINB_TRIG_RISING_EDGE_SEL1
          McuStdbyModeWakeupTimerConf:
            McuStdbyModeWakeupTimerEnable = false
            McuStdbyModeWakeupTimerValue = 16777215
            McuStdbyModeWakeupTimerClkDiv = WUT_100KHZ_NO_DIV_CLK_SEL0
            McuStdbyModeWakeupTimerMode = WUT_AUTO_RELOAD_MODE_SEL0
      McuClockSettingConfig: McuClockSettingId=0
        McuClockReferencePointConfig
          McuSystemPllSettingConfig:
            McuPllInputSrcSelection = OSC_CLOCK_SRC_SELECT_SEL1
            McuSystemPllPDivider = 0
            McuSystemPllNDivider = 29
            McuSystemPllK2Divider = 1
            McuSysPllK2DivStepUpChangeDelay = 10
            McuSysPllK2DivStepDownChangeDelay = 10
            McuFmPllEnable = false
            McuFMPllModAmp = 1.25
            McuClockReferencePointFrequency0 = 300000000
          McuPeripheralPllSettingConfig:
            McuPeripheralPllPDivider = 0
            McuPeripheralPllNDivider = 39
            McuPeripheralPllK2Divider = 4
            McuPerPllK2DivStepUpChangeDelay = 10
            McuPerPllK2DivStepDownChangeDelay = 10
            McuPeripheralPllK3Divider = 1
            McuPerPllK3DivStepUpChangeDelay = 10
            McuPerPllK3DivStepDownChangeDelay = 10
            McuFreqSource1ClockDivSelect = DIV_FACTOR_2_BYPASSED_SEL1
            McuPll2DivSelect = MCU_K3_DIV_FACTOR_BYPASSED_SEL1
            McuClockReferencePointFrequency1 = 160000000
            McuClockReferencePointFrequency2 = 200000000
          McuPllDistributionSettingConfig:
            McuClockDistributionInpClockSel = PLL_INPUT_CLOCK_SRC_SELECT_SEL1
            McuLowPowerDivValue = LOW_POWER_DIVIDER_DISABLE_SEL0
            McuSRIFrequency = 300000000
            McuCPU{0..5}Frequency = 300000000
            McuSPBFrequency = 100000000
            McuFSIFrequency = 100000000
            McuFSI2Frequency = 300000000
            McuReferenceFrequency1 = 12500000
            McuReferenceFrequency2 = 6666667
            McuBBBFrequency = 150000000
            McuErayClkEnable = false
            McuErayFrequency = 80000000
            McuGTMFrequency = 200000000
            McuSTMFrequency = 100000000
            McuMscClockSourceSelection = MSC_CLOCK_SOURCE_DISABLED_SEL0
            McuMscFrequency = 0
            McuMCanClockSourceSelection = MCAN_CLOCK_SOURCE_DISABLED_SEL0
            McuMCanFrequency = 0
            McuAscLinFastFrequency = 0
            McuAscLinSlowClockSourceSelection = ASCLINS_CLOCK_SOURCE_DISABLED_SEL0
            McuAscLinSlowFrequency = 0
            McuQspiClockSourceSelection = QSPI_CLOCK_SOURCE_DISABLED_SEL0
            McuQspiFrequency = 100000000
            McuAdcFrequency = 160000000
            McuConvCtrlPhaseSynchConf = PHASE_SYNCH_CONST_ACTIVE_SEL0
            McuI2CFrequency = 100000000
            McuEbuClkEnable = false
            McuEbuFrequency = 160000000
            McuHsctFrequency = 10000000
            McuHspdmClkEnable = false
            McuHspdm160Frequency = 160000000
            McuHspdm320Frequency = 320000000
            McuAdasFrequency = 0
            McuGEthFrequency = 150000000
            McuMcanHFrequency = 100000000
          McuExternalClockOutputConfig:
            McuExtClock0Enable = false
            McuExtClockOutSel0 = FOUT_EXT_CLOCK0_SEL0
            McuExtClock1Enable = false
            McuExtClock1Inverted = false
            McuExtClockOutSel1 = FOUT_EXT_CLOCK1_SEL0
            McuExtClock1Div = 1
          McuClockMonitorConfig:
            McuPll{0..2}ClockMonEnable = false
            McuSpbClockMonEnable = false
            McuBackupClockMonEnable = false
            McuBackupClockRangeMonEnable = false
        McuClockReferencePoint: McuClockRefSelection=MCU_USER_DEFINED_FREQUENCY, McuClockReferencePointFrequency=40000000
    CommonPublishedInformation:
      ArMajorVersion = 4
      ArMinorVersion = 2
      ArPatchVersion = 2
      SwMajorVersion = 10
      SwMinorVersion = 10
      SwPatchVersion = 1
      ModuleId = 101
      VendorId = 17
      Release = _TRICORE_TC397
    McuHardwareResourceAllocationConf
      McuEruAllocationConf
      McuGtmAllocationConf
    McuGeneralConfiguration:
      McuDevErrorDetect = true
      McuMultiCoreErrorDetect = true
      McuGetRamStateApi = false
      McuInitClock = true
      McuNoPll = false
      McuPerformResetApi = false
      McuVersionInfoApi = false
      McuClearColdResetStatusApi = false
      McuGtmSleepModeEnabled = false
      McuIfxLpmApi = false
      McuIfxTrapApi = false
      McuIfxCpuCcuconApi = false
      McuIfxDeInitApi = false
      McuClockSourceFailureNotification = false
      McuSafetyEnable = true
      McuInitCheckApi = false
      McuMainOscillatorFrequency = 20
      McuSystemModeCpuCore = CPU_SYSTEM_CORE0_SEL0
      McuIdleModeCpuCore = INDIVIDUAL_IDLE_CORES_SEL0
      McuStandbyEntryMode = STANDBY_ENTRY_REQ_SLEEP_SEL0
      McuOscillatorMode = EXT_CRYSTAL_CERAMIC_RES_MODE_SEL0
      McuInitDeInitApiMode = MCU_MCAL_SUPERVISOR
      McuRuntimeApiMode = MCU_MCAL_SUPERVISOR
    McuPublishedInformation
