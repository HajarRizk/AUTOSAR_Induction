AUTOSAR XML (schema 4-2-2)
package /ActiveEcuC
  module config Mcu: implementation-config-variant=VARIANT-POST-BUILD, module-description=Mcu_Impl
    McuModuleConfiguration: McuClockSrcFailureNotification=DISABLED, McuNumberOfMcuModes=1, McuRamSectors=0
      GtmGlobalConfiguration
        McuGtmClockManagementConf: GtmCmuGlobalClockNumerator=1, GtmCmuGlobalClockDenominator=1
          GtmFixedClockSetting: GtmCmuFixedClockEnable=true, GtmCmuFixedClockSel=CMU_GLOBAL_CLOCK_SEL0
          GtmExtClockSetting:
            GtmCmuExtClock0Enable = false
            GtmCmuExtClock0Numerator = 1
            GtmCmuExtClock0Denominator = 1
            GtmCmuExtClock1Enable = false
            GtmCmuExtClock1Numerator = 1
            GtmCmuExtClock1Denominator = 1
            GtmCmuExtClock2Enable = false
            GtmCmuExtClock2Numerator = 1
            GtmCmuExtClock2Denominator = 1
          GtmConfigClockSetting:
            GtmCmuConfigClock0Enable = true
            GtmCmuConfigClock0Div = 0
            GtmCmuConfigClock1Enable = true
            GtmCmuConfigClock1Div = 0
            GtmCmuConfigClock2Enable = true
            GtmCmuConfigClock2Div = 0
            GtmCmuConfigClock3Enable = true
            GtmCmuConfigClock3Div = 0
            GtmCmuConfigClock4Enable = true
            GtmCmuConfigClock4Div = 0
            GtmCmuConfigClock5Enable = true
            GtmCmuConfigClock5Div = 0
            GtmCmuConfigClock6Enable = true
            GtmCmuConfigClock6Div = 0
            GtmCmuConfigClock7Enable = true
            GtmCmuConfigClock7Div = 0
      McuTrapSettingConf:
        McuCPU{0..5}ESR0TrapEnable = false
        McuCPU{0..5}ESR1TrapEnable = false
        McuCPU{0..5}Trap2Enable = false
        McuCPU{0..5}SMUTrapEnable = false
      McuEruGlobalConf: McuEruInputFilterRegVal=0
      McuResetSettingConf:
        McuESR0ResetConf = MCU_ESR0_NO_RESET_SEL0
        McuESR1ResetConf = MCU_ESR1_NO_RESET_SEL0
        McuSWResetConf = MCU_SW_NO_RESET_SEL0
        McuSMUResetConf = MCU_SMU_NO_RESET_SEL0
        McuSTM{0..5}ResetConf = MCU_STM{0..5}_NO_RESET_SEL0
        McuSTM{0..5}ResetOnApplResetEnable = true
    CommonPublishedInformation:
      ArMajorVersion = 4
      ArMinorVersion = 2
      ArPatchVersion = 2
      SwMajorVersion = 10
      SwMinorVersion = 10
      SwPatchVersion = 1
      ModuleId = 101
      VendorId = 17
      Release = _TRICORE_TC397
    McuHardwareResourceAllocationConf
      McuEruAllocationConf
      McuGtmAllocationConf
    McuGeneralConfiguration:
      McuDevErrorDetect = true
      McuMultiCoreErrorDetect = true
      McuGetRamStateApi = false
      McuInitClock = true
      McuNoPll = false
      McuPerformResetApi = false
      McuVersionInfoApi = false
      McuClearColdResetStatusApi = false
      McuGtmSleepModeEnabled = false
      McuIfxLpmApi = false
      McuIfxTrapApi = false
      McuIfxCpuCcuconApi = false
      McuIfxDeInitApi = false
      McuClockSourceFailureNotification = false
      McuSafetyEnable = true
      McuInitCheckApi = false
      McuMainOscillatorFrequency = 20
      McuSystemModeCpuCore = CPU_SYSTEM_CORE0_SEL0
      McuIdleModeCpuCore = INDIVIDUAL_IDLE_CORES_SEL0
      McuStandbyEntryMode = STANDBY_ENTRY_REQ_SLEEP_SEL0
      McuOscillatorMode = EXT_CRYSTAL_CERAMIC_RES_MODE_SEL0
      McuInitDeInitApiMode = MCU_MCAL_SUPERVISOR
      McuRuntimeApiMode = MCU_MCAL_SUPERVISOR
    McuPublishedInformation
