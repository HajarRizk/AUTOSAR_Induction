AUTOSAR XML (schema 4-2-2)
package /ActiveEcuC
  module config PduR: implementation-config-variant=VARIANT-PRE-COMPILE, module-description=PduR_Impl
    PduRGeneral:
      PduRDevErrorDetect = true
      PduRVersionInfoApi = false
      PduRMetaDataSupport = false
      PduRPduCallback = false
      PduRSwitching = false
      PduRSafeBswChecks = false
      PduREnableDeferredTransmission = false
      PduREnableDeferredReception = false
      PduRSupportMulticore = false
      PduRRoutingTypeGateway = false
      PduRGeneration:
        PduROutOfBoundsWriteProtectionStrategy = NONE
        PduROutOfBoundsWriteSanitizer = false
        PduROutOfBoundsReadSanitizer = false
        PduRNumericalDataTypeMinimizationStrategy = WITH_CAST
        PduRReduceConstantData2Define = false
        PduRBoolDataInArrayOfStructStrategy = BITMASKING
        PduRDeduplicateIndirectedData = true
        PduRDataDeduplicationStrategy = WITH_CAST
        PduRReduceBoolDataByNegationThreshold = 2
        PduRReduceBoolDataByNumericalComparisonThreshold = 2
        PduRReduceBoolDataByNumericalRelationThreshold = 2
        PduRReduceBoolDataByNumericalOperandStrategy = WITH_ANY_VALUE
        PduRReduceNumericalDataByOffsetThreshold = 2
        PduRReduceNumericalDataByArraySubtractionThreshold = 2
        PduRReduceDataByStreaming = false
        PduRShortSymbols = false
        PduRInterfacesForDeactivatedData = false
        PduRReferringKeysInComments = false
    PduRRoutingTables: PduRConfigurationId=0
      PduRRoutingTable
        6 x PduRRoutingPath, all with PduRMulticoreRoutingPath=false, PduRLockRef=PduRLock_PduRExclusiveArea:
          AmbTempOutCar_PDU_b808f076_Rx: PduRRoutingPathCommunicationType=COMMUNICATION_INTERFACE
            PduRSrcPdu_e3f99b79 (PduRSrcPdu): PduRSourcePduHandleId=1, PduRSrcPduDirection=RECEIVE, PduRSrcPduRef=AmbTempOutCar_PDU_b808f076_Rx, PduRSrcPduPduRBswModulesRef=CanIf
            AmbTempOutCar_PDU_b808f076_Rx_e3f99b79_Rx (PduRDestPdu):
              PduRDestPduHandleId = 1
              PduRDestPduDirection = RECEIVE
              PduRDestPduRoutingType = API_FORWARDING
              PduRDestPduDataProcessing = IMMEDIATE
              PduRPduLengthHandlingStrategy = UNUSED
              PduRTransmissionConfirmation = false
              PduRDestPduRef = AmbTempOutCar_PDU_dccc009c_Rx
              PduRDestPduPduRBswModulesRef = Com
          AmbTempInCar_PDU_74d62fd9_Rx: PduRRoutingPathCommunicationType=COMMUNICATION_INTERFACE
            AmbTempInCar_PDU_74d62fd9_Rx_c8ac1b77_Rx (PduRDestPdu):
              PduRDestPduHandleId = 0
              PduRDestPduDirection = RECEIVE
              PduRDestPduRoutingType = API_FORWARDING
              PduRDestPduDataProcessing = IMMEDIATE
              PduRPduLengthHandlingStrategy = UNUSED
              PduRTransmissionConfirmation = false
              PduRDestPduRef = AmbTempInCar_PDU_5a566260_Rx
              PduRDestPduPduRBswModulesRef = Com
            PduRSrcPdu_c8ac1b77 (PduRSrcPdu): PduRSourcePduHandleId=0, PduRSrcPduDirection=RECEIVE, PduRSrcPduRef=AmbTempInCar_PDU_74d62fd9_Rx, PduRSrcPduPduRBswModulesRef=CanIf
          UserControls_PDU_47f3742d_Rx: PduRRoutingPathCommunicationType=COMMUNICATION_INTERFACE
            UserControls_PDU_47f3742d_Rx_4b41d348_Rx (PduRDestPdu):
              PduRDestPduHandleId = 2
              PduRDestPduDirection = RECEIVE
              PduRDestPduRoutingType = API_FORWARDING
              PduRDestPduDataProcessing = IMMEDIATE
              PduRPduLengthHandlingStrategy = UNUSED
              PduRTransmissionConfirmation = false
              PduRDestPduRef = UserControls_PDU_5c89b54e_Rx
              PduRDestPduPduRBswModulesRef = Com
            PduRSrcPdu_4b41d348 (PduRSrcPdu): PduRSourcePduHandleId=2, PduRSrcPduDirection=RECEIVE, PduRSrcPduRef=UserControls_PDU_47f3742d_Rx, PduRSrcPduPduRBswModulesRef=CanIf
          ACFanSpeed_PDU_9dd02bc4_Tx: PduRRoutingPathCommunicationType=COMMUNICATION_INTERFACE
            ACFanSpeed_PDU_33daf8c1_Tx (PduRDestPdu):
              PduRDestPduHandleId = 0
              PduRDestPduDirection = TRANSMIT
              PduRDestPduRoutingType = API_FORWARDING
              PduRDestPduDataProcessing = IMMEDIATE
              PduRPduLengthHandlingStrategy = UNUSED
              PduRDestPduDataProvision = PDUR_DIRECT
              PduRTransmissionConfirmation = true
              PduRDestPduRef = ACFanSpeed_PDU_33daf8c1_Tx
              PduRDestPduPduRBswModulesRef = CanIf
            PduRSrcPdu_8f6eaf74 (PduRSrcPdu): PduRSourcePduHandleId=0, PduRSrcPduDirection=TRANSMIT, PduRSrcPduRef=ACFanSpeed_PDU_9dd02bc4_Tx, PduRSrcPduPduRBswModulesRef=Com
          PduRRoutingPath_DiagRequest: PduRRoutingPathCommunicationType=TRANSPORT_PROTOCOL
            PduRDestPdu:
              PduRDestPduHandleId = 0
              PduRDestPduDirection = RECEIVE
              PduRDestPduRoutingType = API_FORWARDING
              PduRDestPduDataProcessing = IMMEDIATE
              PduRPduLengthHandlingStrategy = UNUSED
              PduRDestPduRef = DiagRequest_Com
              PduRDestPduPduRBswModulesRef = Dcm
            PduRSrcPdu: PduRSourcePduHandleId=0, PduRSrcPduDirection=RECEIVE, PduRSrcPduRef=DiagRequest_CanTp, PduRSrcPduPduRBswModulesRef=CanTp
          PduRRoutingPath_DiagResponse: PduRRoutingPathCommunicationType=TRANSPORT_PROTOCOL
            PduRDestPdu_1 (PduRDestPdu):
              PduRDestPduHandleId = 0
              PduRDestPduDirection = TRANSMIT
              PduRDestPduRoutingType = API_FORWARDING
              PduRDestPduDataProcessing = IMMEDIATE
              PduRPduLengthHandlingStrategy = UNUSED
              PduRDestPduRef = DiagResponse_CanTp
              PduRDestPduPduRBswModulesRef = CanTp
            PduRSrcPdu_1 (PduRSrcPdu): PduRSourcePduHandleId=1, PduRSrcPduDirection=TRANSMIT, PduRSrcPduRef=DiagResponse_Com, PduRSrcPduPduRBswModulesRef=Dcm
      PduRLock_PduRExclusiveArea (PduRLock)
        PduRExclusiveArea: PduRExclusiveAreaId=0
    4 x PduRBswModules, all with PduRCancelReceive=false, PduRCancelTransmit=false, PduRChangeParameterRequestApi=false, PduRTriggertransmit=false:
      CanIf: PduRCommunicationInterface=true, PduRLowerModule=true, PduRTransportProtocol=false, PduRTxConfirmation=true, PduRUpperModule=false, PduRUseTag=false, PduRBswModuleRef=CanIf
      Com: PduRCommunicationInterface=true, PduRLowerModule=false, PduRTransportProtocol=false, PduRTxConfirmation=true, PduRUpperModule=true, PduRUseTag=false, PduRBswModuleRef=Com
      CanTp: PduRCommunicationInterface=false, PduRLowerModule=true, PduRTransportProtocol=true, PduRTxConfirmation=false, PduRUpperModule=true, PduRUseTag=false, PduRBswModuleRef=CanTp
      Dcm: PduRCommunicationInterface=false, PduRLowerModule=false, PduRTransportProtocol=true, PduRTxConfirmation=false, PduRUpperModule=true, PduRUseTag=true, PduRBswModuleRef=Dcm
