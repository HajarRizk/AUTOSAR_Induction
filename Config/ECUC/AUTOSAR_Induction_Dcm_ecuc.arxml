AUTOSAR XML (schema 4-2-2)
package /ActiveEcuC
  module config Dcm: implementation-config-variant=VARIANT-PRE-COMPILE, module-description=Dcm_Impl
    DcmConfigSet
      DcmGeneral:
        DcmDemApiVersion = DCM_DEM_API_4_03_00
        DcmDevErrorDetect = true
        DcmRequestManufacturerNotificationEnabled = false
        DcmRequestSupplierNotificationEnabled = false
        DcmRespondAllRequest = true
        DcmTaskTime = 0.01
        DcmVersionInfoApi = false
        DcmDspDataDefaultEndianness = LITTLE_ENDIAN
        DcmSafeBswChecks = false
        DcmSupportedIDCalculationSuppressionEnabled = false
        DcmDtrDataProvisionViaDemEnabled = true
        DcmForeignDiagnosticRequestDetectionEnabled = false
        DcmSuppressResponseOnCanTpFuncMixedAddrRequests = false
        DcmSenderReceiverPRPortsEnabled = false
        DcmResetToFblAfterSessionFinalResponseEnabled = false
        DcmFinalResponseToFblEnabled = false
      DcmDsd
        DcmDsdServiceTable
          5 x DcmDsdService:
            ReadDataByIdentifier: DcmDsdSidTabServiceId=34, DcmDsdSidTabSubfuncAvail=false
            DiagnosticSessionControl: DcmDsdSidTabServiceId=16, DcmDsdSidTabSubfuncAvail=true
              DefaultSession (DcmDsdSubService): DcmDsdSubServiceId=1
            WriteDataByIdentifier: DcmDsdSidTabServiceId=46, DcmDsdSidTabSubfuncAvail=false
            TesterPresent: DcmDsdSidTabServiceId=62, DcmDsdSidTabSubfuncAvail=true
              DcmDsdSubService_0x00 (DcmDsdSubService): DcmDsdSubServiceId=0
            RoutineControl: DcmDsdSidTabServiceId=49, DcmDsdSidTabSubfuncAvail=true
      DcmDsl
        DcmDslBuffer: DcmDslBufferSize=50
        DcmDslDiagResp: DcmDslDiagRespMaxNumRespPend=0, DcmDslDiagRespOnSecondDeclinedRequest=false, DcmDslDiagRespMaxNumOfDeclinedRequests=3
        DcmDslProtocol
          DcmDslProtocolRow:
            DcmDslProtocolEndiannessConvEnabled = false
            DcmDslProtocolID = DCM_UDS_ON_CAN
            DcmDslProtocolPreemptTimeout = 0
            DcmDslProtocolPriority = 0
            DcmSendRespPendOnTransToBoot = true
            DcmTimStrP2ServerAdjust = 0
            DcmTimStrP2StarServerAdjust = 0
            DcmDslProtocolRxBufferID = DcmDslBuffer
            DcmDslProtocolSIDTable = DcmDsdServiceTable
            DcmDslProtocolTxBufferID = DcmDslBuffer
            DcmDslConnection
              DcmDslMainConnection: DcmDslProtocolRxTesterSourceAddr=0, DcmDslAddressingType=DCM_NET_ADDR_NORMAL
                DcmDslProtocolRx:
                  DcmDslProtocolRxAddrType = DCM_PHYSICAL_TYPE
                  DcmDslProtocolRxChannelId = 0
                  DcmDslProtocolRxPduId = 0
                  DcmDslProtocolRxPduRef = DiagRequest_Com
                  DcmDslProtocolRxComMChannelRef = Connector_eJAD_AC_ECU_5f730b4d60fd8937_17d2a688
                DcmDslProtocolTx: DcmDslTxConfirmationPduId=0, DcmDslProtocolTxPduRef=DiagResponse_Com
      DcmDsp: DcmDspReadDIDReportsNODIByte=false
        DcmDspSecurity
        DcmDspSession
          DcmDspSessionRow_Default (DcmDspSessionRow): DcmDspSessionForBoot=DCM_NO_BOOT, DcmDspSessionLevel=1, DcmDspSessionP2ServerMax=0.05, DcmDspSessionP2StarServerMax=5
        DcmDspDid_Counter (DcmDspDid): DcmDspDidIdentifier=78, DcmDspDidUsed=true, DcmDspDidUsePort=USE_DATA_ELEMENT_SPECIFIC_INTERFACES, DcmDspDidInfoRef=DcmDspDidInfo_Counter
          DcmDspDidSignal: DcmDspDidDataPos=0, DcmDspDidDataRef=DcmDspData_Counter
        DcmDspDidInfo_Counter (DcmDspDidInfo): DcmDspDidDynamicallyDefined=false
          DcmDspDidAccess
            DcmDspDidRead
            DcmDspDidWrite
        DcmDspData_Counter (DcmDspData):
          DcmDspDataSize = 16
          DcmDspDataUsePort = USE_DATA_SYNCH_CLIENT_SERVER
          DcmDspDataType = UINT16
          DcmDspDataConditionCheckReadFncUsed = false
          DcmDspDataEndianness = LITTLE_ENDIAN
          DcmDspDataInfoRef = DcmDspDataInfo_Counter
        DcmDspDataInfo_Counter (DcmDspDataInfo): DcmDspDataFixedLength=true, DcmDspDataScalingInfoSize=2
        DcmDspDid_CountersValue (DcmDspDid): DcmDspDidIdentifier=4613, DcmDspDidUsed=true, DcmDspDidUsePort=USE_DATA_ELEMENT_SPECIFIC_INTERFACES, DcmDspDidInfoRef=DcmDspDidInfo_CountersValue
          DcmDspDidSignal: DcmDspDidDataPos=0, DcmDspDidDataRef=DcmDspData_CountersValue
        DcmDspDataInfo_CountersValue (DcmDspDataInfo): DcmDspDataFixedLength=true
        DcmDspData_CountersValue (DcmDspData):
          DcmDspDataSize = 320
          DcmDspDataUsePort = USE_DATA_SYNCH_CLIENT_SERVER
          DcmDspDataType = UINT16_N
          DcmDspDataConditionCheckReadFncUsed = false
          DcmDspDataInfoRef = DcmDspDataInfo_CountersValue
        DcmDspDidInfo_CountersValue (DcmDspDidInfo): DcmDspDidDynamicallyDefined=false
          DcmDspDidAccess
            DcmDspDidRead
        DcmDspRoutine_Counter (DcmDspRoutine):
          DcmDspRequestResultsRoutineSupported = true
          DcmDspRoutineFixedLength = true
          DcmDspRoutineIdentifier = 9217
          DcmDspRoutineUsePort = true
          DcmDspRoutineUsed = true
          DcmDspStopRoutineSupported = true
          DcmDspRoutineInfoRef = DcmDspRoutineInfo_Counter
        DcmDspRoutineInfo_Counter (DcmDspRoutineInfo)
          DcmDspRoutineAuthorization
          DcmDspRoutineRequestResOut
            DcmDspRoutineRequestResOutSignal: DcmDspRoutineSignalLength=16, DcmDspRoutineSignalPos=0, DcmDspRoutineSignalType=UINT16, DcmDspRoutineSignalEndianness=LITTLE_ENDIAN
      DcmPageBufferCfg: DcmPagedBufferEnabled=true
