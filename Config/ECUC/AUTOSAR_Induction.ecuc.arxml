AUTOSAR XML (schema 4-2-2)
package /ActiveEcuC
  ecuc value collection ActiveEcuC: ecu-extract=SYSTEM, ecuc-values=[Com, Mcu, Rte, EcuM, VTTMcu, VTTCntrl, Os, PduR, VTTEcuC, CanSM, Can, CanIf, ComXf, Det, ComM, VTTCan, EcuC, BswM, vSet, VTTOs, CanTp, Dcm]
