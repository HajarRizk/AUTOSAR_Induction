AUTOSAR XML (schema 4-2-2)
package /ActiveEcuC
  module config Can: implementation-config-variant=VARIANT-PRE-COMPILE, module-description=Can_Impl
    CanGeneral:
      CanIndex = 0
      CanChangeBaudrateApi = false
      CanDevErrorDetection = true
      CanHardwareCancellation = false
      CanIdenticalIdCancellation = false
      CanMainFunctionBusoffPeriod = 0.01
      CanMainFunctionModePeriod = 0.01
      CanMainFunctionWakeupPeriod = 0.01
      CanMultiplexedTransmission = false
      CanSetBaudrateApi = false
      CanTimeoutDuration = 0.01
      CanVersionInfoApi = false
      CanGenericPrecopy = false
      CanHardwareLoopCheck = true
      CanSecureTempBuffer = false
      CanRxFullCANSupport = false
      CanTxFullCANSupport = false
      CanRxBasicCANSupport = true
      CanUseNestedCANInterrupts = false
      CanHardwareCancelByAppl = false
      CanIndividualProcessing = false
      CanGenericConfirmation = false
      CanRxQueue = false
      CanSupportMixedID = false
      CanRxQueueSize = 10
      CanMultipleBasicCANObjects = false
      CanMultipleBasicCANTxObjects = false
      CanHardwareHandleType = UINT8
      CanOptimizeOneController = true
      CanInterruptCategory = VOIDFUNCVOID
      CanGetStatus = false
      CanInterruptLock = DRIVER
      CanWakeupSupport = false
      CanRamCheck = None
      CanOverrunNotification = DET
      CanReinitStart = false
      CanGenericPreTransmit = false
      CanFdSupport = NONE
      CanRuntimeMeasurementSupport = false
      CanMaxRxDataLen = 8
      CanMaxTxDataLen = 8
      CanUsePeripheralAccessApi = false
      CanMirrorModeSupport = false
      CanUseOsInterruptControl = false
      CanSafeBswChecks = false
      CanSilentModeSupport = false
      CanMcanRevision = M_CAN_REV_315
      CanCounterRef = SystemTimer
      CanMainFunctionRWPeriods: CanMainFunctionReadPeriod=0.01, CanMainFunctionWritePeriod=0.01
    CanConfigSet
      Controller_eJAD_AC_ECU_7f252cc98424769f_6e3aa728 (CanController):
        CanControllerActivation = true
        CanBusoffProcessing = POLLING
        CanControllerBaseAddress = 4028663040
        CanControllerId = 0
        CanRxProcessing = POLLING
        CanTxProcessing = POLLING
        CanWakeupProcessing = POLLING
        CanWakeupSupport = false
        CanWakeupSourceId = 0
        CanBasisAddressEnum = M_CAN1
        CanTxBufferElementSize = ES_8
        CanRxBufferElementSize = ES_8
        CanRxFifo0ElementSize = ES_8
        CanRxFifo1ElementSize = ES_8
        CanMaxNrOfRxFifo0Elements = 64
        CanMaxNrOfRxFifo1Elements = 64
        CanMaxNrOfRxBuffers = 64
        CanMaxNrOfTxBuffers = 32
        CanIsTTCAN = false
        CanIOPort = b_001
        CanControllerDefaultBaudrate = CanControllerBaudrateConfig
        CanControllerSystemRef = Controller_eJAD_AC_ECU_7f252cc98424769f
        CanWakeupSourceRef = Connector_eJAD_AC_ECU_5f730b4d60fd8937_17d2a688
        CanCpuClockRef = McuClockReferencePoint
        CanControllerBaudrateConfig:
          CanControllerBaudRate = 500
          CanControllerPropSeg = 49
          CanControllerSeg1 = 15
          CanControllerSeg2 = 15
          CanControllerBaudRateConfigID = 0
          CanControllerSyncJumpWidth = 15
          CanBaudrateClock = 40000
          CanBaudratePrescaler = 1
        CanFilterMask: CanFilterMaskValue=0, CanFilterCodeValue=0, IsLocked=false
      Connector_eJAD_AC_ECU_5f730b4d60fd8937_6b2462b8_Rx (CanHardwareObject):
        CanHandleType = BASIC
        CanIdType = STANDARD
        CanIdValue = 0
        CanObjectType = RECEIVE
        CanObjectId = 1
        CanHwProcessing = true
        CanObjectHwSize = 6
        CanObjectHwHandle = 96
        CanMaxDataLen = 8
        CanFdPaddingValue = 0
        CanObjectMultiplexedTransmission = false
        CanControllerRef = Controller_eJAD_AC_ECU_7f252cc98424769f_6e3aa728
        CanFilterMaskRef = CanFilterMask
      Connector_eJAD_AC_ECU_5f730b4d60fd8937_17d2a688_Tx (CanHardwareObject):
        CanHandleType = BASIC
        CanIdValue = 0
        CanObjectType = TRANSMIT
        CanIdType = STANDARD
        CanObjectId = 0
        CanHwProcessing = true
        CanObjectHwSize = 1
        CanObjectHwHandle = 0
        CanMaxDataLen = 8
        CanFdPaddingValue = 0
        CanObjectMultiplexedTransmission = false
        CanControllerRef = Controller_eJAD_AC_ECU_7f252cc98424769f_6e3aa728
