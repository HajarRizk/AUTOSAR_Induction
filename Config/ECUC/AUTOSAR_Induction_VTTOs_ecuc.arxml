AUTOSAR XML (schema 4-2-2)
package /ActiveEcuC
  module config VTTOs: implementation-config-variant=VARIANT-PRE-COMPILE, module-description=Os_Impl
    OsOS:
      OsStackMonitoring = true
      OsStatus = EXTENDED
      OsUseGetServiceId = false
      OsUseParameterAccess = false
      OsUseResScheduler = false
      OsForcibleTermination = false
      OsGenerateCalloutStubs = true
      OsGenerateMemMap = COMPLETE
      OsGenerateMemMapForNearAddressing = true
      OsGenerateMemMapForThreads = false
      OsServiceProtection = false
      OsStackUsageMeasurement = false
      OsUseXSignalAsyncApiCalls = false
      OsFpuUsage = NONE
      OsScalabilityClass = SC1
      OsNumberOfCores = 1
      OsMasterCore = OsCore0
      OsSystemTimer = SystemTimer
      OsHooks: OsErrorHook=true, OsPostTaskHook=false, OsPreTaskHook=false, OsShutdownHook=false, OsStartupHook=false
      OsStackSummary
        6 x OsStack, all with OsStackSize=1024, OsStackCore=OsCore0:
          OsCore0_Error: OsStackType=CORE_ERROR_STACK, OsStackUser=OsCore0
          OsCore0_Init: OsStackType=CORE_INIT_STACK, OsStackUser=OsCore0
          OsCore0_Kernel: OsStackType=CORE_KERNEL_STACK, OsStackUser=OsCore0
          OsCore0_Task_Prio4294967295: OsStackType=TASK_SHARED_PRIORITY_STACK, OsStackUser=InitTask
          OsCore0_Isr_Core: OsStackType=ISR_SHARED_CORE_STACK, OsStackUser=CounterIsr_SystemTimer
          OsCore0_Task_Prio0: OsStackType=TASK_SHARED_PRIORITY_STACK, OsStackUser=PeriodicTask
    OsPublishedInformation: OsKernelVersion=7, OsPlatformName=TriCoreAurix
      TC39x (OsDerivativeInformation):
        OsMpuAlignment = 8
        OsStackAlignment = 8
        OsInterruptVectorTableAlignment = 32
        OsExceptionVectorTableAlignment = 32
        OsHardwareManuals = User Manual: TC3XX_ts__TargetSpec_rev1v3v0.pdf V1.3.0, 2016-02 Errata Sheet: TC39x AA_Errata_Sheet_rev1v0_2016-06-08.pdf Rel. 1.0, 2016-06-08
        OsPhysicalCore:
          OsPhysicalCoreId = 1
          OsPhysicalCoreExceptionSources = 0
          OsPhysicalCoreIsAutostart = false
          OsPhysicalCoreMasterStartAllowed = false
          OsPhysicalCorePrivelegedHwAccess = false
        OsHardwareTimer: OsHardwareTimerId=0, OsHardwareTimerUnit=FRT, OsHardwareTimerSize=32, OsHardwareTimerBaseAddress=0
          OsHardwareTimerChannel: OsHardwareTimerChannelId=0, OsHardwareTimerChannelIntSource=0, OsHardwareTimerChannelOffset=0
        OsInterruptSupportedType: OsInterruptSupportedTypeSeparateSources=false, OsInterruptSupportedTypeSeparatePriority=false
        Core0 (OsPhysicalCore):
          OsPhysicalCoreId = 0
          OsPhysicalCoreExceptionSources = 8
          OsPhysicalCoreIsAutostart = true
          OsPhysicalCoreMasterStartAllowed = true
          OsPhysicalCorePrivelegedHwAccess = true
          OsPhysicalCoreDefaultEntrySymbol = _start_tc0
          OsPhysicalCoreType = TC1.6.2P
          OsPhysicalCoreStackProtectionUnit = OsPhysicalCore0DataMpu
          OsPhysicalCore0CodeMpu (OsPhysicalCoreMpu): OsPhysicalCoreMpuId=1, OsPhysicalCoreMpuMaxRegions=10, OsPhysicalCoreMpuType=CODE
          OsPhysicalCore0DataMpu (OsPhysicalCoreMpu): OsPhysicalCoreMpuId=0, OsPhysicalCoreMpuMaxRegions=18, OsPhysicalCoreMpuType=DATA
        AURIXTC3XX_IR (OsSystemIntCtrl): OsSystemIntCtrlMaxSources=8192, OsSystemIntCtrlMaxPrios=255, OsSystemIntCtrlPrioOrder=ASC, OsSystemIntCtrlBaseAddress=4026757120
        OsMemoryRegionSpecifics
          4 x OsMemoryRegionAccess:
            OsMemoryRegionAccess: OsMemoryRegionAccessRights=NONE, OsMemoryRegionAccessType=SUPERVISOR
            PS0_W: OsMemoryRegionAccessRights=W, OsMemoryRegionAccessType=PROTECTION_SET0
            PS0_R: OsMemoryRegionAccessRights=R, OsMemoryRegionAccessType=PROTECTION_SET0
            PS0_X: OsMemoryRegionAccessRights=X, OsMemoryRegionAccessType=PROTECTION_SET0
        STM0 (OsHardwareTimer): OsHardwareTimerId=0, OsHardwareTimerUnit=FRT, OsHardwareTimerSize=32, OsHardwareTimerBaseAddress=4026535936, OsHardwareTimerType=STM
          3 x OsHardwareTimerChannel:
            OsHardwareTimerChannel: OsHardwareTimerChannelId=0, OsHardwareTimerChannelIntSource=0, OsHardwareTimerChannelOffset=0
            STM0_Ch1: OsHardwareTimerChannelId=1, OsHardwareTimerChannelIntSource=772, OsHardwareTimerChannelOffset=1
            STM0_Ch0: OsHardwareTimerChannelId=0, OsHardwareTimerChannelIntSource=768, OsHardwareTimerChannelOffset=0
        GPT (OsHardwareTimer): OsHardwareTimerId=0, OsHardwareTimerUnit=PIT, OsHardwareTimerSize=16, OsHardwareTimerBaseAddress=4026537984, OsHardwareTimerType=PIT
          3 x OsHardwareTimerChannel:
            OsHardwareTimerChannel: OsHardwareTimerChannelId=0, OsHardwareTimerChannelIntSource=0, OsHardwareTimerChannelOffset=0
            GPT_Ch1: OsHardwareTimerChannelId=1, OsHardwareTimerChannelIntSource=756, OsHardwareTimerChannelOffset=1
            GPT_Ch0: OsHardwareTimerChannelId=0, OsHardwareTimerChannelIntSource=744, OsHardwareTimerChannelOffset=0
        DEFAULT (OsInterruptSupportedType): OsInterruptSupportedTypeSeparateSources=false, OsInterruptSupportedTypeSeparatePriority=false
        DMA (OsInterruptSupportedType): OsInterruptSupportedTypeSeparateSources=false, OsInterruptSupportedTypeSeparatePriority=true
    SystemTimer (OsCounter):
      OsCounterMaxAllowedValue = 2147483647
      OsCounterMinCycle = 1
      OsCounterTicksPerBase = 1
      OsCounterType = HARDWARE
      OsSecondsPerTick = 0.001
      OsCounterAccessingApplication = SystemApplication_OsCore0
      OsDriver: OsDriverHighResolution=false, OsDriverHardwareTimerChannelRef=GPT_Ch0, OsDriverIsrRef=CounterIsr_SystemTimer
    OSDEFAULTAPPMODE (OsAppMode)
    OsCore0 (OsCore):
      OsCoreIsAutostart = true
      OsCoreIsAutosar = true
      OsCoreEntrySymbol = _start_tc0
      OsCorePhysicalCoreRef = Core0
      OsCoreIdleTask = InitTask
      OsCoreSystemApplication = SystemApplication_OsCore0
      OsCoreEcucCoreRef = EcucCoreDefinition
      OsCoreStacks:
        OsCoreKernelStackSize = 1024
        OsCoreStartupStackSize = 1024
        OsCoreShutdownStackSize = 1024
        OsCoreErrorStackSize = 1024
        OsCoreProtectionStackSize = 1024
        OsCoreInitStackSize = 1024
    OsCounter:
      OsCounterMaxAllowedValue = 1073741823
      OsCounterMinCycle = 1
      OsCounterTicksPerBase = 1
      OsCounterType = SOFTWARE
      OsSecondsPerTick = 0.001
      OsCounterAccessingApplication = SystemApplication_OsCore0
    OS_APPMODE_ANY (OsAppMode)
    InitTask (OsTask):
      OsTaskActivation = 1
      OsTaskPriority = 4294967295
      OsTaskSchedule = FULL
      OsTaskStackSharing = false
      OsTaskStackSize = 1024
      OsTaskType = AUTO
      OsTaskUsesFpu = false
      OsTaskAccessingApplication = SystemApplication_OsCore0
      OsTaskAutostart: OsTaskAppModeRef=OS_APPMODE_ANY
    SystemApplication_OsCore0 (OsApplication):
      OsTrusted = true
      OsTrustedApplicationDelayTimingViolationCall = false
      OsTrustedApplicationWithProtection = false
      OsApplicationIsPrivileged = true
      OsAppUseTrustedFunctionStubs = false
      OsAppCounterRef = SystemTimer
      OsAppTaskRef = InitTask
      OsAppCounterRef = OsCounter
      OsApplicationCoreRef = EcucCoreDefinition
      OsAppIsrRef = CounterIsr_SystemTimer
      OsAppTaskRef = PeriodicTask
      OsAppScheduleTableRef = MainScheduleTable_PeriodicTask
      OsApplicationHooks: OsAppErrorHook=false, OsAppShutdownHook=false, OsAppStartupHook=false
    CounterIsr_SystemTimer (OsIsr):
      OsIsrCategory = CATEGORY_2
      OsIsrInterruptType = EXTERNAL
      OsIsrInterruptSource = 0
      OsIsrInterruptPriority = 1
      OsIsrStackSize = 1024
      OsIsrEnableNesting = false
      OsIsrUsesFpu = false
      OsIsrInitialEnableInterruptSource = false
      OsIsrSpecialFunctionName = Os_TimerPitIsr
      OsIsrInterruptMapping = DEFAULT
    PeriodicTask (OsTask):
      OsTaskActivation = 1
      OsTaskPriority = 0
      OsTaskSchedule = FULL
      OsTaskStackSharing = false
      OsTaskStackSize = 1024
      OsTaskType = BASIC
      OsTaskUsesFpu = false
      OsTaskAccessingApplication = SystemApplication_OsCore0
      OsTaskResourceRef = OsResource
    OsResource: OsResourceProperty=STANDARD, OsResourceAccessingApplication=SystemApplication_OsCore0
    OsCore1 (OsCore): OsCoreIsAutostart=false, OsCoreIsAutosar=false, OsCorePhysicalCoreRef=OsPhysicalCore, OsCoreEcucCoreRef=EcucCoreDefinition_001
      OsCoreStacks:
        OsCoreKernelStackSize = 1024
        OsCoreStartupStackSize = 1024
        OsCoreShutdownStackSize = 1024
        OsCoreErrorStackSize = 1024
        OsCoreProtectionStackSize = 1024
        OsCoreInitStackSize = 1024
    MainScheduleTable_PeriodicTask (OsScheduleTable):
      OsScheduleTableDuration = 20
      OsScheduleTableRepeating = true
      OsScheduleTableCounterRef = SystemTimer
      OsSchTblAccessingApplication = SystemApplication_OsCore0
      3 x OsScheduleTableExpiryPoint:
        OsScheduleTableExpiryPoint: OsScheduleTblExpPointOffset=1
          OsScheduleTableTaskActivation: OsScheduleTableActivateTaskRef=InitTask
        ExpiryPoint_1: OsScheduleTblExpPointOffset=10
          OsScheduleTableTaskActivation: OsScheduleTableActivateTaskRef=PeriodicTask
        ExpiryPoint_0: OsScheduleTblExpPointOffset=0
          OsScheduleTableTaskActivation: OsScheduleTableActivateTaskRef=PeriodicTask
