AUTOSAR XML (schema 4-2-2)
package /ActiveEcuC
  module config VTTOs: implementation-config-variant=VARIANT-PRE-COMPILE, module-description=Os_Impl
    OsOS:
      OsStackMonitoring = true
      OsStatus = EXTENDED
      OsUseGetServiceId = false
      OsUseParameterAccess = false
      OsUseResScheduler = false
      OsForcibleTermination = false
      OsGenerateCalloutStubs = true
      OsGenerateMemMap = COMPLETE
      OsGenerateMemMapForNearAddressing = true
      OsGenerateMemMapForThreads = false
      OsServiceProtection = false
      OsStackUsageMeasurement = false
      OsUseXSignalAsyncApiCalls = false
      OsFpuUsage = NONE
      OsScalabilityClass = SC1
      OsMasterCore = (unset)
      OsSystemTimer = SystemTimer
      OsHooks: OsErrorHook=true, OsPostTaskHook=false, OsPreTaskHook=false, OsShutdownHook=false, OsStartupHook=false
      OsStackSummary
    OsPublishedInformation: OsKernelVersion=7, OsPlatformName=TriCoreAurix
      TC39x (OsDerivativeInformation):
        OsMpuAlignment = 8
        OsStackAlignment = 8
        OsInterruptVectorTableAlignment = 32
        OsExceptionVectorTableAlignment = 32
        OsHardwareManuals = User Manual: TC3XX_ts__TargetSpec_rev1v3v0.pdf V1.3.0, 2016-02 Errata Sheet: TC39x AA_Errata_Sheet_rev1v0_2016-06-08.pdf Rel. 1.0, 2016-06-08
        OsPhysicalCore:
          OsPhysicalCoreId = 0
          OsPhysicalCoreExceptionSources = 0
          OsPhysicalCoreIsAutostart = false
          OsPhysicalCoreMasterStartAllowed = false
          OsPhysicalCorePrivelegedHwAccess = false
        OsHardwareTimer: OsHardwareTimerId=0, OsHardwareTimerUnit=FRT, OsHardwareTimerSize=32, OsHardwareTimerBaseAddress=0
          OsHardwareTimerChannel: OsHardwareTimerChannelId=0, OsHardwareTimerChannelIntSource=0, OsHardwareTimerChannelOffset=0
        OsInterruptSupportedType: OsInterruptSupportedTypeSeparateSources=false, OsInterruptSupportedTypeSeparatePriority=false
        Core0 (OsPhysicalCore):
          OsPhysicalCoreId = 0
          OsPhysicalCoreExceptionSources = 8
          OsPhysicalCoreIsAutostart = true
          OsPhysicalCoreMasterStartAllowed = true
          OsPhysicalCorePrivelegedHwAccess = true
          OsPhysicalCoreDefaultEntrySymbol = _start_tc0
          OsPhysicalCoreType = TC1.6.2P
          OsPhysicalCoreStackProtectionUnit = OsPhysicalCore0DataMpu
          OsPhysicalCore0CodeMpu (OsPhysicalCoreMpu): OsPhysicalCoreMpuId=1, OsPhysicalCoreMpuMaxRegions=10, OsPhysicalCoreMpuType=CODE
          OsPhysicalCore0DataMpu (OsPhysicalCoreMpu): OsPhysicalCoreMpuId=0, OsPhysicalCoreMpuMaxRegions=18, OsPhysicalCoreMpuType=DATA
        AURIXTC3XX_IR (OsSystemIntCtrl): OsSystemIntCtrlMaxSources=8192, OsSystemIntCtrlMaxPrios=255, OsSystemIntCtrlPrioOrder=ASC, OsSystemIntCtrlBaseAddress=4026757120
        OsMemoryRegionSpecifics
          4 x OsMemoryRegionAccess:
            OsMemoryRegionAccess: OsMemoryRegionAccessRights=NONE, OsMemoryRegionAccessType=SUPERVISOR
            PS0_W: OsMemoryRegionAccessRights=W, OsMemoryRegionAccessType=PROTECTION_SET0
            PS0_R: OsMemoryRegionAccessRights=R, OsMemoryRegionAccessType=PROTECTION_SET0
            PS0_X: OsMemoryRegionAccessRights=X, OsMemoryRegionAccessType=PROTECTION_SET0
        STM0 (OsHardwareTimer): OsHardwareTimerId=0, OsHardwareTimerUnit=FRT, OsHardwareTimerSize=32, OsHardwareTimerBaseAddress=4026535936, OsHardwareTimerType=STM
          3 x OsHardwareTimerChannel:
            OsHardwareTimerChannel: OsHardwareTimerChannelId=0, OsHardwareTimerChannelIntSource=0, OsHardwareTimerChannelOffset=0
            STM0_Ch1: OsHardwareTimerChannelId=1, OsHardwareTimerChannelIntSource=772, OsHardwareTimerChannelOffset=1
            STM0_Ch0: OsHardwareTimerChannelId=0, OsHardwareTimerChannelIntSource=768, OsHardwareTimerChannelOffset=0
        GPT (OsHardwareTimer): OsHardwareTimerId=0, OsHardwareTimerUnit=PIT, OsHardwareTimerSize=16, OsHardwareTimerBaseAddress=4026537984, OsHardwareTimerType=PIT
          3 x OsHardwareTimerChannel:
            OsHardwareTimerChannel: OsHardwareTimerChannelId=0, OsHardwareTimerChannelIntSource=0, OsHardwareTimerChannelOffset=0
            GPT_Ch1: OsHardwareTimerChannelId=1, OsHardwareTimerChannelIntSource=756, OsHardwareTimerChannelOffset=1
            GPT_Ch0: OsHardwareTimerChannelId=0, OsHardwareTimerChannelIntSource=744, OsHardwareTimerChannelOffset=0
        DEFAULT (OsInterruptSupportedType): OsInterruptSupportedTypeSeparateSources=false, OsInterruptSupportedTypeSeparatePriority=false
        DMA (OsInterruptSupportedType): OsInterruptSupportedTypeSeparateSources=false, OsInterruptSupportedTypeSeparatePriority=true
    SystemTimer (OsCounter): OsCounterMaxAllowedValue=2147483647, OsCounterMinCycle=1, OsCounterTicksPerBase=1, OsCounterType=HARDWARE, OsSecondsPerTick=0.001
      OsDriver: OsDriverHighResolution=false, OsDriverHardwareTimerChannelRef=GPT_Ch0, OsDriverIsrRef=(unset)
    OsMemoryProtection
      24 x OsMemoryRegion:
        READ_ALL_Core5: OsMemoryRegionStartAddress=0, OsMemoryRegionEndAddress=0xFFFFFFFF, OsMemoryRegionProtectionUnit=OsPhysicalCore5DataMpu, OsMemoryRegionAccessRights=PS0_R, OsMemoryRegionAccessRights=PS1_R, OsMemoryRegionAccessRights=PS2_R, OsMemoryRegionAccessRights=PS3_R, OsMemoryRegionAccessRights=PS4_R, OsMemoryRegionAccessRights=PS5_R
        TRUSTED_WRITE_ALL_Core5: OsMemoryRegionStartAddress=0x80000000, OsMemoryRegionEndAddress=0xFFFFFFFF, OsMemoryRegionProtectionUnit=OsPhysicalCore5DataMpu, OsMemoryRegionAccessRights=PS0_W
        TRUSTED_WRITE_SPR_Core2: OsMemoryRegionStartAddress=_OS_CORE2_STACKS_END, OsMemoryRegionEndAddress=0x5FFFFFFF, OsMemoryRegionProtectionUnit=OsPhysicalCore2DataMpu, OsMemoryRegionAccessRights=PS0_W
        EXC_ALL_Core3: OsMemoryRegionStartAddress=0, OsMemoryRegionEndAddress=0xFFFFFFFF, OsMemoryRegionProtectionUnit=OsPhysicalCore3CodeMpu, OsMemoryRegionAccessRights=PS0_X, OsMemoryRegionAccessRights=PS1_X, OsMemoryRegionAccessRights=PS2_X, OsMemoryRegionAccessRights=PS3_X, OsMemoryRegionAccessRights=PS4_X, OsMemoryRegionAccessRights=PS5_X
        EXC_ALL_Core4: OsMemoryRegionStartAddress=0, OsMemoryRegionEndAddress=0xFFFFFFFF, OsMemoryRegionProtectionUnit=OsPhysicalCore4CodeMpu, OsMemoryRegionAccessRights=PS0_X, OsMemoryRegionAccessRights=PS1_X, OsMemoryRegionAccessRights=PS2_X, OsMemoryRegionAccessRights=PS3_X, OsMemoryRegionAccessRights=PS4_X, OsMemoryRegionAccessRights=PS5_X
        TRUSTED_WRITE_ALL_Core4: OsMemoryRegionStartAddress=0x80000000, OsMemoryRegionEndAddress=0xFFFFFFFF, OsMemoryRegionProtectionUnit=OsPhysicalCore4DataMpu, OsMemoryRegionAccessRights=PS0_W
        TRUSTED_WRITE_ALL_Core3: OsMemoryRegionStartAddress=0x80000000, OsMemoryRegionEndAddress=0xFFFFFFFF, OsMemoryRegionProtectionUnit=OsPhysicalCore3DataMpu, OsMemoryRegionAccessRights=PS0_W
        READ_ALL_Core3: OsMemoryRegionStartAddress=0, OsMemoryRegionEndAddress=0xFFFFFFFF, OsMemoryRegionProtectionUnit=OsPhysicalCore3DataMpu, OsMemoryRegionAccessRights=PS0_R, OsMemoryRegionAccessRights=PS1_R, OsMemoryRegionAccessRights=PS2_R, OsMemoryRegionAccessRights=PS3_R, OsMemoryRegionAccessRights=PS4_R, OsMemoryRegionAccessRights=PS5_R
        TRUSTED_WRITE_ALL_Core2: OsMemoryRegionStartAddress=0x80000000, OsMemoryRegionEndAddress=0xFFFFFFFF, OsMemoryRegionProtectionUnit=OsPhysicalCore2DataMpu, OsMemoryRegionAccessRights=PS0_W
        EXC_ALL_Core2: OsMemoryRegionStartAddress=0, OsMemoryRegionEndAddress=0xFFFFFFFF, OsMemoryRegionProtectionUnit=OsPhysicalCore2CodeMpu, OsMemoryRegionAccessRights=PS0_X, OsMemoryRegionAccessRights=PS1_X, OsMemoryRegionAccessRights=PS2_X, OsMemoryRegionAccessRights=PS3_X, OsMemoryRegionAccessRights=PS4_X, OsMemoryRegionAccessRights=PS5_X
        EXC_ALL_Core0: OsMemoryRegionStartAddress=0, OsMemoryRegionEndAddress=0xFFFFFFFF, OsMemoryRegionProtectionUnit=OsPhysicalCore0CodeMpu, OsMemoryRegionAccessRights=PS0_X, OsMemoryRegionAccessRights=PS1_X, OsMemoryRegionAccessRights=PS2_X, OsMemoryRegionAccessRights=PS3_X, OsMemoryRegionAccessRights=PS4_X, OsMemoryRegionAccessRights=PS5_X
        READ_ALL_Core0: OsMemoryRegionStartAddress=0, OsMemoryRegionEndAddress=0xFFFFFFFF, OsMemoryRegionProtectionUnit=OsPhysicalCore0DataMpu, OsMemoryRegionAccessRights=PS0_R, OsMemoryRegionAccessRights=PS1_R, OsMemoryRegionAccessRights=PS2_R, OsMemoryRegionAccessRights=PS3_R, OsMemoryRegionAccessRights=PS4_R, OsMemoryRegionAccessRights=PS5_R
        TRUSTED_WRITE_SPR_Core0: OsMemoryRegionStartAddress=_OS_CORE0_STACKS_END, OsMemoryRegionEndAddress=0x7FFFFFFF, OsMemoryRegionProtectionUnit=OsPhysicalCore0DataMpu, OsMemoryRegionAccessRights=PS0_W
        READ_ALL_Core4: OsMemoryRegionStartAddress=0, OsMemoryRegionEndAddress=0xFFFFFFFF, OsMemoryRegionProtectionUnit=OsPhysicalCore4DataMpu, OsMemoryRegionAccessRights=PS0_R, OsMemoryRegionAccessRights=PS1_R, OsMemoryRegionAccessRights=PS2_R, OsMemoryRegionAccessRights=PS3_R, OsMemoryRegionAccessRights=PS4_R, OsMemoryRegionAccessRights=PS5_R
        EXC_ALL_Core1: OsMemoryRegionStartAddress=0, OsMemoryRegionEndAddress=0xFFFFFFFF, OsMemoryRegionProtectionUnit=OsPhysicalCore1CodeMpu, OsMemoryRegionAccessRights=PS0_X, OsMemoryRegionAccessRights=PS1_X, OsMemoryRegionAccessRights=PS2_X, OsMemoryRegionAccessRights=PS3_X, OsMemoryRegionAccessRights=PS4_X, OsMemoryRegionAccessRights=PS5_X
        TRUSTED_WRITE_SPR_Core1: OsMemoryRegionStartAddress=_OS_CORE1_STACKS_END, OsMemoryRegionEndAddress=0x6FFFFFFF, OsMemoryRegionProtectionUnit=OsPhysicalCore1DataMpu, OsMemoryRegionAccessRights=PS0_W
        TRUSTED_WRITE_ALL_Core0: OsMemoryRegionStartAddress=0x80000000, OsMemoryRegionEndAddress=0xFFFFFFFF, OsMemoryRegionProtectionUnit=OsPhysicalCore0DataMpu, OsMemoryRegionAccessRights=PS0_W
        TRUSTED_WRITE_SPR_Core3: OsMemoryRegionStartAddress=_OS_CORE3_STACKS_END, OsMemoryRegionEndAddress=0x4FFFFFFF, OsMemoryRegionProtectionUnit=OsPhysicalCore3DataMpu, OsMemoryRegionAccessRights=PS0_W
        TRUSTED_WRITE_ALL_Core1: OsMemoryRegionStartAddress=0x80000000, OsMemoryRegionEndAddress=0xFFFFFFFF, OsMemoryRegionProtectionUnit=OsPhysicalCore1DataMpu, OsMemoryRegionAccessRights=PS0_W
        EXC_ALL_Core5: OsMemoryRegionStartAddress=0, OsMemoryRegionEndAddress=0xFFFFFFFF, OsMemoryRegionProtectionUnit=OsPhysicalCore5CodeMpu, OsMemoryRegionAccessRights=PS0_X, OsMemoryRegionAccessRights=PS1_X, OsMemoryRegionAccessRights=PS2_X, OsMemoryRegionAccessRights=PS3_X, OsMemoryRegionAccessRights=PS4_X, OsMemoryRegionAccessRights=PS5_X
        TRUSTED_WRITE_SPR_Core4: OsMemoryRegionStartAddress=_OS_CORE4_STACKS_END, OsMemoryRegionEndAddress=0x3FFFFFFF, OsMemoryRegionProtectionUnit=OsPhysicalCore4DataMpu, OsMemoryRegionAccessRights=PS0_W
        TRUSTED_WRITE_SPR_Core5: OsMemoryRegionStartAddress=_OS_CORE5_STACKS_END, OsMemoryRegionEndAddress=0x1FFFFFFF, OsMemoryRegionProtectionUnit=OsPhysicalCore5DataMpu, OsMemoryRegionAccessRights=PS0_W
        READ_ALL_Core1: OsMemoryRegionStartAddress=0, OsMemoryRegionEndAddress=0xFFFFFFFF, OsMemoryRegionProtectionUnit=OsPhysicalCore1DataMpu, OsMemoryRegionAccessRights=PS0_R, OsMemoryRegionAccessRights=PS1_R, OsMemoryRegionAccessRights=PS2_R, OsMemoryRegionAccessRights=PS3_R, OsMemoryRegionAccessRights=PS4_R, OsMemoryRegionAccessRights=PS5_R
        READ_ALL_Core2: OsMemoryRegionStartAddress=0, OsMemoryRegionEndAddress=0xFFFFFFFF, OsMemoryRegionProtectionUnit=OsPhysicalCore2DataMpu, OsMemoryRegionAccessRights=PS0_R, OsMemoryRegionAccessRights=PS1_R, OsMemoryRegionAccessRights=PS2_R, OsMemoryRegionAccessRights=PS3_R, OsMemoryRegionAccessRights=PS4_R, OsMemoryRegionAccessRights=PS5_R
    OSDEFAULTAPPMODE (OsAppMode)
    3 x OsIsr, all with OsIsrCategory=CATEGORY_2, OsIsrInterruptType=EXTERNAL, OsIsrInterruptPriority=0, OsIsrStackSize=1024, OsIsrEnableNesting=false, OsIsrUsesFpu=false, OsIsrInitialEnableInterruptSource=true:
      CanIsrRx_0: OsIsrInterruptSource=0  # /ActiveEcuC/VTTCan PLAIN_TEXT Can RX messages event (common for all controllers)
      CanIsrTx_0: OsIsrInterruptSource=1  # /ActiveEcuC/VTTCan PLAIN_TEXT Can TX messages event (common for all controllers)
      CanIsrErr_0: OsIsrInterruptSource=2  # /ActiveEcuC/VTTCan PLAIN_TEXT Can BusOff event (common for all controllers)
