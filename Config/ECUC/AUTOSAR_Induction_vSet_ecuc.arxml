AUTOSAR XML (schema 4-2-2)
package /ActiveEcuC
  module config vSet: implementation-config-variant=VARIANT-PRE-COMPILE, module-description=vSet_Impl
    vSetCalibration
    vSetGeneral: vSetDummyStatementKind=None
    vSetPlatform:
      vSetSizeOfROMPointer = Size32Bit
      vSetSizeOfInt = Size32Bit
      vSetSizeOfRAMPointer = Size32Bit
      vSetBitOrder = LSB_to_MSB
      vSetByteOrder = LITTLE_ENDIAN
      vSetSizeOfEnum = Size32Bit
      vSetCPUType = CPU32Bit
