AUTOSAR XML (schema 4-2-2)
package /ActiveEcuC
  module config CanTp: implementation-config-variant=VARIANT-PRE-COMPILE, module-description=CanTp_Impl
    CanTpConfig: CanTpMainFunctionPeriod=0.01
      CanTpChannel: CanTpChannelMode=CANTP_MODE_FULL_DUPLEX, CanTpChannelLowerLayer=CANTP_LOWER_LAYER_CANIF
        CanTpRxNSdu:
          CanTpNbr = 0.1
          CanTpRxAddressingFormat = CANTP_STANDARD
          CanTpRxNSduId = 0
          CanTpRxPaddingActivation = CANTP_ON
          CanTpRxTaType = CANTP_PHYSICAL
          CanTpBs = 3
          CanTpNar = 0.05
          CanTpNcr = 0.05
          CanTpRxWftMax = 4
          CanTpSTmin = 0.02
          CanTpRxNSduRef = DiagRequest_CanTp
          CanTpRxNPdu: CanTpRxNPduId=0, CanTpRxNPduRef=Diag_Request_CanIF
          CanTpTxFcNPdu: CanTpTxFcNPduConfirmationPduId=0, CanTpTxFcNPduRef=DiagRespnse_CanIF
        CanTpTxNSdu:
          CanTpNas = 0.1
          CanTpNcs = 0.2
          CanTpTc = false
          CanTpTxAddressingFormat = CANTP_STANDARD
          CanTpTxNSduId = 0
          CanTpTxPaddingActivation = CANTP_ON
          CanTpTxTaType = CANTP_PHYSICAL
          CanTpNbs = 0.2
          CanTpTxNSduRef = DiagResponse_CanTp
          CanTpTxNPdu: CanTpTxNPduConfirmationPduId=0, CanTpTxNPduRef=DiagRespnse_CanIF
          CanTpRxFcNPdu: CanTpRxFcNPduId=0, CanTpRxFcNPduRef=Diag_Request_CanIF
    CanTpGeneral:
      CanTpChangeParameterApi = false
      CanTpDevErrorDetect = true
      CanTpPaddingByte = 204
      CanTpReadParameterApi = false
      CanTpVersionInfoApi = false
      CanTpPaddingActive = true
      CanTpHavePaddingByte = false
      CanTpNumRxChannels = 0
      CanTpNumTxChannels = 0
      CanTpEnableSplitMainFunction = false
      CanTpSupportStandardAddressing = true
      CanTpSupportExtendedAddressing = true
      CanTpSupportMixed11Addressing = true
      CanTpSupportMixed29Addressing = true
      CanTpSupportNormalFixedAddressing = true
      CanTpOnlyNotifyInformedAppl = true
      CanTpRc = false
      CanTpTc = false
      CanTpSafeBswChecks = false
      CanTpSupportedLowerLayers = CANTP_LOWER_LAYER_CANIF
      CanTpEnableSynchronousTransmit = true
