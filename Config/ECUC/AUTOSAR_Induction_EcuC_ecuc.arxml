AUTOSAR XML (schema 4-2-2)
package /ActiveEcuC
  module config EcuC: implementation-config-variant=VARIANT-PRE-COMPILE, module-description=EcuC_Impl
    EcucPduCollection: PduIdTypeEnum=UINT8, PduLengthTypeEnum=UINT8
      8 x Pdu, all with PduLength=8, J1939Requestable=false:
        AmbTempOutCar_PDU_dccc009c_Rx
        AmbTempInCar_PDU_74d62fd9_Rx: SysTPduToFrameMappingRef=PduToFrameMapping_b18a915f7936e63c
        UserControls_PDU_5c89b54e_Rx
        ACFanSpeed_PDU_33daf8c1_Tx: SysTPduToFrameMappingRef=PduToFrameMapping_4b0bcc7affe88c61
        ACFanSpeed_PDU_9dd02bc4_Tx
        AmbTempOutCar_PDU_b808f076_Rx: SysTPduToFrameMappingRef=PduToFrameMapping_3834b85e703fcba0
        AmbTempInCar_PDU_5a566260_Rx
        UserControls_PDU_47f3742d_Rx: SysTPduToFrameMappingRef=PduToFrameMapping_f802b4eaa6c1cd0b
    EcucGeneral:
      CPUType = CPU32Bit
      SizeOfInt = Size32Bit
      ByteOrder = LITTLE_ENDIAN
      BitOrder = LSB_to_MSB
      AtomicBitAccessInBitfield = true
      AtomicVariableAccess = Atomic16BitAccess
      SizeOfEnum = Size32Bit
      SizeOfROMPointer = Size32Bit
      SizeOfRAMPointer = Size32Bit
      BitFieldDataType = INT
      StructAlignment = Auto
      ArrayAlignment = Align8Bit
      StructInArrayAlignment = Auto
      DummyFunction = false
      EcuCSafeBswChecks = false
      DummyStatement = true
      DummyStatementKind = None
      ConditionalGenerating = true
      EcucBswImplementationCodeType = EcuCSourceCode
      EcuCUseStdReturnTypeForRte = true
      PostbuildLoadable: AlignmentFillPattern=255, PBROMStartAddress=0, PBRAMStartAddress=0, PBROMEndAddress=0, PBRAMEndAddress=0
      BswInitialization
        24 x InitFunction:
          BswM_PreInit: Header=BswM.h, InitPhase=INIT_ONE, ConfigType=BswM_ConfigType, ConfigPtrName=BswM_Config_Ptr, ConfigPtrClass=BSWM_INIT_DATA, ModuleRef=BswM
          BswM_InitMemory: Header=BswM.h, InitPhase=INIT_MEMORY, ModuleRef=BswM
          BswM_Init: Header=BswM.h, InitPhase=NO_INIT, ConfigType=BswM_ConfigType, ConfigPtrName=BswM_Config_Ptr, ConfigPtrClass=BSWM_INIT_DATA, ModuleRef=BswM
          CanIf_Init: Header=CanIf.h, InitPhase=INIT_TWO_IF, ConfigType=CanIf_ConfigType, ConfigPtrName=CanIf_Config_Ptr, ConfigPtrClass=CANIF_INIT_DATA, ModuleRef=CanIf
          CanIf_InitMemory: Header=CanIf.h, InitPhase=INIT_MEMORY, ModuleRef=CanIf
          CanSM_Init: Header=CanSM_EcuM.h, InitPhase=INIT_TWO_SM, ConfigType=CanSM_ConfigType, ConfigPtrName=CanSM_Config_Ptr, ConfigPtrClass=CANSM_INIT_DATA, ModuleRef=CanSM
          CanSM_InitMemory: Header=CanSM_EcuM.h, InitPhase=INIT_MEMORY, ModuleRef=CanSM
          Can_Init: Header=Can.h, InitPhase=INIT_TWO_DRV, ConfigType=Can_ConfigType, ConfigPtrName=Can_Config_Ptr, ConfigPtrClass=CAN_INIT_DATA, ModuleRef=Can
          Can_InitMemory: Header=Can.h, InitPhase=INIT_MEMORY, ModuleRef=Can
          ComM_InitMemory: Header=ComM.h, InitPhase=INIT_MEMORY, ModuleRef=ComM
          ComM_Init: Header=ComM.h, InitPhase=INIT_TWO_POST_NVMREADALL, ModuleRef=ComM
          ComXf_Init: Header=ComXf.h, InitPhase=NO_INIT, ModuleRef=ComXf
          Com_InitMemory: Header=Com.h, InitPhase=INIT_MEMORY, ModuleRef=Com
          Com_Init: Header=Com.h, InitPhase=INIT_TWO_COM, ConfigType=Com_ConfigType, ConfigPtrName=Com_Config_Ptr, ConfigPtrClass=COM_INIT_DATA, ModuleRef=Com
          Det_InitMemory: Header=Det.h, InitPhase=INIT_MEMORY, ModuleRef=Det
          Det_Init: Header=Det.h, InitPhase=INIT_ZERO, ConfigType=Det_ConfigType, ConfigPtrName=Det_Config_Ptr, ConfigPtrClass=DET_INIT_DATA, ModuleRef=Det
          EcuM_Init: Header=EcuM.h, InitPhase=NO_INIT, ConfigType=EcuM_PbConfigType, ConfigPtrName=EcuM_Config_Ptr, ConfigPtrClass=ECUM_INIT_DATA, ModuleRef=EcuM
          Mcu_Init: Header=Mcu.h, InitPhase=INIT_ONE_EARLY, ConfigType=Mcu_ConfigType, ConfigPtrName=&Mcu_Config, ConfigPtrClass=const, AdditionalInitCode=Mcu_InitClock(0); while (MCU_PLL_LOCKED != Mcu_GetPllStatus()); Mcu_DistributePllClock();, ModuleRef=Mcu
          PduR_Init: Header=PduR.h, InitPhase=INIT_TWO_COM, ConfigType=PduR_PBConfigType, ConfigPtrName=PduR_Config_Ptr, ConfigPtrClass=PDUR_INIT_DATA, ModuleRef=PduR
          PduR_InitMemory: Header=PduR.h, InitPhase=INIT_MEMORY, ModuleRef=PduR
          SchM_Init: Header=Rte_Main.h, InitPhase=NO_INIT, ModuleRef=Rte
          Rte_StartTiming: Header=Rte_Main.h, InitPhase=NO_INIT, ModuleRef=Rte
          Rte_InitMemory: Header=Rte_Main.h, InitPhase=INIT_MEMORY, ModuleRef=Rte
          Rte_Start: Header=Rte_Main.h, InitPhase=INIT_THREE, ModuleRef=Rte
    EcucHardware
      EcucCoreDefinition: EcucCoreId=0
      EcucCoreDefinition_001 (EcucCoreDefinition): EcucCoreId=1
