AUTOSAR XML (schema 4-2-2)
package /COM/VECTOR/CFG/WORKFLOW/SYSDESC/SYNC
  flat map FLATMAP
    flat instance descriptor CounterSWC: upstream-reference=EcuSwComposition.CounterSWC, ecu-extract-reference=COMPOSITIONTYPE.CounterSWC
