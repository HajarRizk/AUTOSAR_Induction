AUTOSAR XML (schema 00046)
package /COM/VECTOR/CFG/WORKFLOW/SYSDESC/SYNC
  system SYSTEM: category=ECU_EXTRACT
    system mapping MAPPINGS
      data-mappings:
        data-element=CounterSWC.COMPOSITIONTYPE.CounterSignalPI_Tx.Element, system-signal=ACCompPow_274b307919b78395
        data-element=CounterSWC.COMPOSITIONTYPE.CounterSignalPI_Rx.Element, system-signal=AC_UC_AirCirc_4982379d745170f0
    root-software-compositions:
      root sw composition prototype COMPOSITIONTYPE: flat-map=FLATMAP, software-composition=COMPOSITIONTYPE
  composition sw component type COMPOSITIONTYPE  # UB:Derived from original system description
    7 x component:
      ComM: type=ComM
      Det: type=Det
      EcuM: type=EcuM
      BswM: type=BswM
      Os_OsCore0_swc: type=Os_OsCore0_swc
      CounterSWC: type=CounterSWC
      Dcm: type=Dcm
    connect CounterSWC.RoutineServices_Counter -> Dcm.RoutineServices_DcmDspRoutine_Counter
    connect CounterSWC.DataServices_Counter -> Dcm.DataServices_DcmDspData_Counter
    connect CounterSWC.DataServices_DcmDspData_CountersValue -> Dcm.DataServices_DcmDspData_CountersValue
  end to end protection set E2EPROTECTIONSET
  port interface mapping set PORTINTERFACEMAPPINGSET
