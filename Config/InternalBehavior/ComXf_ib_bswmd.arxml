AUTOSAR XML (schema 4-2-2)
package /MICROSAR/ComXf_ib_bswmd/BswModuleDescriptions
  bsw module description ComXf
    bsw internal behavior ComXfBehavior
