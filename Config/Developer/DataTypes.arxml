AUTOSAR XML (schema 00046)
package /Predefined_DEV/ImplementationDataTypes
  impl type NvM_RequestResultType: compu {0=NVM_REQ_OK, 1=NVM_REQ_NOT_OK, 2=NVM_REQ_PENDING, 3=NVM_REQ_INTEGRITY_FAILED, 4=NVM_REQ_BLOCK_SKIPPED, 5=NVM_REQ_NV_INVALIDATED, 6=NVM_REQ_CANCELED, 7=NVM_REQ_REDUNDANCY_FAILED, 8=NVM_REQ_RESTORED_FROM_ROM}, implementation-data-type=uint8
  impl type NvM_ServiceIdType: compu {6=NVM_READ_BLOCK, 7=NVM_WRITE_BLOCK, 8=NVM_RESTORE_BLOCK_DEFAULTS, 9=NVM_ERASE_BLOCK, 11=NVM_INVALIDATE_NV_BLOCK, 12=NVM_READ_ALL}, implementation-data-type=uint8
  impl type Dem_UdsStatusByteType: compu {mask 1: 1=DEM_UDS_STATUS_TF, mask 2: 2=DEM_UDS_STATUS_TFTOC, mask 4: 4=DEM_UDS_STATUS_PDTC, mask 8: 8=DEM_UDS_STATUS_CDTC, mask 16: 16=DEM_UDS_STATUS_TNCSLC, mask 32: 32=DEM_UDS_STATUS_TFSLC, mask 64: 64=DEM_UDS_STATUS_TNCTOC, mask 128: 128=DEM_UDS_STATUS_WIR}, range raw 0..255, implementation-data-type=uint8
package /VectorAutosarExplorerGeneratedObjects/BASE_TYPES
  base type New_BaseType: category=FIXED_LENGTH, base-type-size=16, base-type-encoding=NONE
  base type New_BaseType_1: category=FIXED_LENGTH, base-type-size=16, base-type-encoding=NONE
  base type New_BaseType_2: category=FIXED_LENGTH, base-type-size=16, base-type-encoding=NONE
package /VectorAutosarExplorerGeneratedObjects/COMPUMETHODS
  compu method AC_UC_Power_level_Encoding: 0=AC_UNIT_OFF, 1..4=AC_UNIT_PL1..AC_UNIT_PL4, 5=AC_UNIT_MAX
  compu method AC_UC_TargetTemp_Encoding: phys=raw for raw 18..33
  compu method AC_UC_AirCirc_Encoding: phys=raw for raw 0..1
  compu method AmbTempOutCar_PDU_Signal_Encoding: phys=raw*0.1-127.5 for raw -127.5..126.5
  compu method ACCompPow_Encoding: phys=raw for raw 0..750
