AUTOSAR XML (schema 00046)
package /VectorAutosarExplorerGeneratedObjects/SYSTEM
  system System
    root-software-compositions:
      root sw composition prototype EcuSwComposition: software-composition=ECU_Composition
package /ECUCompositionTypes
  composition sw component type ECU_Composition
    component CounterSWC: type=CounterSWC
package /EndToEndProtections
  end to end protection set EndToEndProtectionSet
