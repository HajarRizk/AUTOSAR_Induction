AUTOSAR XML (schema 4-0-3)
package /DaVinci_Project
  module config Com
    ComConfig
      ACCompPow_b4e01f19_Tx (ComSignal): ComSignalType=UINT16
      AC_UC_AirCirc_e0001df6_Rx (ComSignal): ComNotification=Rte_COMCbk_AC_UC_AirCirc_e0001df6_Rx, ComSignalType=UINT16
  module config Rte
    13 x RteBswModuleInstance:
      BswM
      Can
        5 x RteBswEventToTaskMapping:
          Can_MainFunction_BusOffTimingEvent0
          Can_MainFunction_ModeTimingEvent0
          Can_MainFunction_ReadTimingEvent0
          Can_MainFunction_WakeupTimingEvent0
          Can_MainFunction_WriteTimingEvent0
      CanIf
      CanSM
        CanSM_MainFunctionTimingEvent0 (RteBswEventToTaskMapping)
      CanTp
        CanTp_MainFunctionTimingEvent0 (RteBswEventToTaskMapping)
      Com
        Com_MainFunctionRxTimingEvent0 (RteBswEventToTaskMapping)
        Com_MainFunctionTxTimingEvent0 (RteBswEventToTaskMapping)
      ComM
        ComM_MainFunction_0TimingEvent0 (RteBswEventToTaskMapping)
      ComXf
      Dcm
        Dcm_MainFunctionTimingEvent0 (RteBswEventToTaskMapping)
      Det
      EcuM
        EcuM_MainFunctionTimingEvent0 (RteBswEventToTaskMapping)
      Mcu
      PduR
    7 x RteSwComponentInstance:
      BswM_EcuSwComposition
      ComM_EcuSwComposition
        Timer_ComM_MainFunction_0 (RteEventToTaskMapping)
      CounterSWC_EcuSwComposition
        TMT_CounterMainFunction (RteEventToTaskMapping)
        DRT_CounterRecieveSignal_CounterSignalPI_Rx_Element (RteEventToTaskMapping)
      Dcm_EcuSwComposition
        Timer_Dcm_MainFunction (RteEventToTaskMapping)
      Det_EcuSwComposition
      EcuM_EcuSwComposition
        Timer_EcuM_MainFunction (RteEventToTaskMapping)
      Os_OsCore0_swc_EcuSwComposition
    RteOsInteraction
      MainScheduleTable_PeriodicTask (RteUsedOsActivation): RteExpectedActivationOffset=0, RteActivationOsSchTblRef=Os/MainScheduleTable_PeriodicTask, RteActivationOsTaskRef=PeriodicTask
  module config NvM
  module config Os
    OnEventTask (OsTask): OsTaskActivation=1, OsTaskPriority=0, OsTaskSchedule=FULL
    PeriodicTask (OsTask): OsTaskActivation=1, OsTaskPriority=0, OsTaskSchedule=FULL
    MainScheduleTable_PeriodicTask (OsScheduleTable): OsScheduleTableRepeating=true, OsScheduleTableDuration=10, OsScheduleTableCounterRef=SystemTimer
      ExpiryPoint_0 (OsScheduleTableExpiryPoint): OsScheduleTblExpPointOffset=0
        OsScheduleTableTaskActivation: OsScheduleTableActivateTaskRef=PeriodicTask
  module config EcuC
  ecuc value collection DaVinci_Project: ecuc-values=[Com, Rte, Os, EcuC, NvM]
