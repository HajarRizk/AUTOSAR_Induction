AUTOSAR XML (schema 4-0-3)
package /DaVinci_Project
  module config Rte
    11 x RteBswModuleInstance:
      BswM
      Can
        5 x RteBswEventToTaskMapping:
          Can_MainFunction_BusOffTimingEvent0
          Can_MainFunction_ModeTimingEvent0
          Can_MainFunction_ReadTimingEvent0
          Can_MainFunction_WakeupTimingEvent0
          Can_MainFunction_WriteTimingEvent0
      CanIf
      CanSM
        CanSM_MainFunctionTimingEvent0 (RteBswEventToTaskMapping)
      Com
        Com_MainFunctionRxTimingEvent0 (RteBswEventToTaskMapping)
        Com_MainFunctionTxTimingEvent0 (RteBswEventToTaskMapping)
      ComM
        ComM_MainFunction_0TimingEvent0 (RteBswEventToTaskMapping)
      ComXf
      Det
      EcuM
        EcuM_MainFunctionTimingEvent0 (RteBswEventToTaskMapping)
      Mcu
      PduR
    5 x RteSwComponentInstance:
      BswM_EcuSwComposition
      ComM_EcuSwComposition
        Timer_ComM_MainFunction_0 (RteEventToTaskMapping)
      Det_EcuSwComposition
      EcuM_EcuSwComposition
        Timer_EcuM_MainFunction (RteEventToTaskMapping)
      Os_OsCore0_swc_EcuSwComposition
    RteOsInteraction
      MainScheduleTable_PeriodicTask (RteUsedOsActivation): RteExpectedActivationOffset=0, RteActivationOsSchTblRef=Os/MainScheduleTable_PeriodicTask, RteActivationOsTaskRef=PeriodicTask
  module config NvM
  module config Os
    PeriodicTask (OsTask): OsTaskActivation=1, OsTaskPriority=0, OsTaskSchedule=FULL
    MainScheduleTable_PeriodicTask (OsScheduleTable): OsScheduleTableRepeating=true, OsScheduleTableDuration=20, OsScheduleTableCounterRef=SystemTimer
      ExpiryPoint_0 (OsScheduleTableExpiryPoint): OsScheduleTblExpPointOffset=0
        OsScheduleTableTaskActivation: OsScheduleTableActivateTaskRef=PeriodicTask
      ExpiryPoint_1 (OsScheduleTableExpiryPoint): OsScheduleTblExpPointOffset=10
        OsScheduleTableTaskActivation: OsScheduleTableActivateTaskRef=PeriodicTask
  module config EcuC
  ecuc value collection DaVinci_Project: ecuc-values=[Com, Rte, Os, EcuC, NvM]
